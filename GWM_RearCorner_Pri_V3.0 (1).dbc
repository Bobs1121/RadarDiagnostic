VERSION "created by canmatrix"

NS_ :

BS_:

BU_: RadarRearRight RadarRearLeft

BO_ 810 RRL_Obj13A: 64 Vector__XXX
 SG_ RRL_Obj13A_CRC : 0|16@1+ (1,0) [0|65535] "" Vector__XXX
 SG_ RRL_Obj13A_Ay : 103|9@1+ (0.0625,-16) [-16|15.9375] "m/s^2" Vector__XXX
 SG_ RRL_Obj13A_HeadingYawAngle : 112|9@1+ (0.0175,-4.48) [-3.15|3.15] "rad" Vector__XXX
 SG_ RRL_Obj13A_Length : 121|7@1+ (0.125,0) [0|15.875] "m" Vector__XXX
 SG_ RRL_Obj13A_Width : 128|7@1+ (0.125,0) [0|15.875] "m" Vector__XXX
 SG_ RRL_Obj13A_Height : 135|7@1+ (0.125,0) [0|15.875] "m" Vector__XXX
 SG_ RRL_Obj13A_DxVnce : 142|12@1+ (0.01,0) [0|30] "m^2" Vector__XXX
 SG_ RRL_Obj13A_DyVnce : 154|12@1+ (0.01,0) [0|30] "m^2" Vector__XXX
 SG_ RRL_Obj13A_DzVnce : 166|10@1+ (0.01,0) [0|10] "m^2" Vector__XXX
 SG_ RRL_Obj13A_AliveCtr : 16|8@1+ (1,0) [0|254] "" Vector__XXX
 SG_ RRL_Obj13A_VxVnce : 176|12@1+ (0.01,0) [0|30] "m^2/s^2" Vector__XXX
 SG_ RRL_Obj13A_VyVnce : 188|12@1+ (0.01,0) [0|30] "m^2/s^2" Vector__XXX
 SG_ RRL_Obj13A_AxVnce : 200|12@1+ (0.01,0) [0|30] "m^2/s^4" Vector__XXX
 SG_ RRL_Obj13A_AyVnce : 212|12@1+ (0.01,0) [0|30] "m^2/s^4" Vector__XXX
 SG_ RRL_Obj13A_RefPosIndex : 224|4@1+ (1,0) [0|15] "" Vector__XXX
 SG_ RRL_Obj13A_DxDyCoVnce : 228|12@1+ (0.01,0) [0|30] "m^2" Vector__XXX
 SG_ RRL_Obj13A_DxVxCoVnce : 240|12@1+ (0.01,0) [0|30] "m^2/s" Vector__XXX
 SG_ RRL_Obj13A_BlockCtr : 24|4@1+ (1,0) [0|15] "" Vector__XXX
 SG_ RRL_Obj13A_DyVxCoVnce : 252|12@1+ (0.01,0) [0|30] "m^2/s" Vector__XXX
 SG_ RRL_Obj13A_DxVyCoVnce : 264|12@1+ (0.01,0) [0|30] "m^2/s" Vector__XXX
 SG_ RRL_Obj13A_DyVyCoVnce : 276|12@1+ (0.01,0) [0|30] "m^2/s" Vector__XXX
 SG_ RRL_Obj13A_VxVyCoVnce : 288|12@1+ (0.01,0) [0|30] "m^2/s^2" Vector__XXX
 SG_ RRL_Obj13A_DxAxCoVnce : 300|12@1+ (0.01,0) [0|30] "m^2/s^2" Vector__XXX
 SG_ RRL_Obj13A_DyAxCoVnce : 312|12@1+ (0.01,0) [0|30] "m^2/s^2" Vector__XXX
 SG_ RRL_Obj13A_VxAxCoVnce : 324|12@1+ (0.01,0) [0|30] "m^2/s^3" Vector__XXX
 SG_ RRL_Obj13A_ObjectID : 32|7@1+ (1,0) [0|127] "" Vector__XXX
 SG_ RRL_Obj13A_VyAxCoVnce : 336|12@1+ (0.01,0) [0|30] "m^2/s^3" Vector__XXX
 SG_ RRL_Obj13A_DxAyCoVnce : 348|12@1+ (0.01,0) [0|30] "m^2/s^2" Vector__XXX
 SG_ RRL_Obj13A_DyAyCoVnce : 360|12@1+ (0.01,0) [0|30] "m^2/s^2" Vector__XXX
 SG_ RRL_Obj13A_VxAyCoVnce : 372|12@1+ (0.01,0) [0|30] "m^2/s^3" Vector__XXX
 SG_ RRL_Obj13A_VyAyCoVnce : 384|12@1+ (0.01,0) [0|30] "m^2/s^3" Vector__XXX
 SG_ RRL_Obj13A_AxAyCoVnce : 396|12@1+ (0.01,0) [0|30] "m^2/s^4" Vector__XXX
 SG_ RRL_Obj13A_Measured : 39|1@1+ (1,0) [0|1] "" Vector__XXX
 SG_ RRL_Obj13A_HeadingYawVnce : 408|12@1+ (0.0003,0) [0|1] "rad^2" Vector__XXX
 SG_ RRL_Obj13A_Dx : 40|13@1+ (0.0625,-256) [-256|255.9375] "m" Vector__XXX
 SG_ RRL_Obj13A_LengthVnce : 420|12@1+ (0.01,0) [0|30] "m^2" Vector__XXX
 SG_ RRL_Obj13A_WidthVnce : 432|12@1+ (0.01,0) [0|30] "m^2" Vector__XXX
 SG_ RRL_Obj13A_HeightVnce : 444|12@1+ (0.01,0) [0|30] "m^2" Vector__XXX
 SG_ RRL_Obj13A_ExistProb : 456|6@1+ (2,0) [0|100] "%" Vector__XXX
 SG_ RRL_Obj13A_ProbObstacle : 462|6@1+ (2,0) [0|100] "%" Vector__XXX
 SG_ RRL_Obj13A_ProbNonObstacle : 468|6@1+ (2,0) [0|100] "%" Vector__XXX
 SG_ RRL_Obj13A_ProbMobileObst : 474|6@1+ (2,0) [0|100] "%" Vector__XXX
 SG_ RRL_Obj13A_FV : 487|8@0+ (1,0) [0|255] "" Vector__XXX
 SG_ RRL_Obj13A_MAC : 495|24@0+ (1,0) [0|16777215] "" Vector__XXX
 SG_ RRL_Obj13A_Dz : 53|6@1+ (0.25,-5) [-5|10.75] "m" Vector__XXX
 SG_ RRL_Obj13A_Dy : 59|11@1+ (0.125,-128) [-128|127.875] "m" Vector__XXX
 SG_ RRL_Obj13A_Valid : 70|1@1+ (1,0) [0|1] "" Vector__XXX
 SG_ RRL_Obj13A_Vx : 71|12@1+ (0.0625,-128) [-128|127.9375] "m/s" Vector__XXX
 SG_ RRL_Obj13A_Vy : 83|10@1+ (0.125,-64) [-64|63.875] "m/s" Vector__XXX
 SG_ RRL_Obj13A_Ax : 93|10@1+ (0.03125,-16) [-16|15.96875] "m/s^2" Vector__XXX

BO_ 811 RRL_Obj13B: 16 Vector__XXX
 SG_ RRL_Obj13B_CRC : 0|16@1+ (1,0) [0|65535] "" Vector__XXX
 SG_ RRL_Obj13B_MAC : 111|24@0+ (1,0) [0|16777215] "" Vector__XXX
 SG_ RRL_Obj13B_AliveCtr : 16|8@1+ (1,0) [0|254] "" Vector__XXX
 SG_ RRL_Obj13B_BlockCtr : 24|4@1+ (1,0) [0|15] "" Vector__XXX
 SG_ RRL_Obj13B_ProbMob4PlusWhl : 28|6@1+ (2,0) [0|100] "%" Vector__XXX
 SG_ RRL_Obj13B_ProbMob2Whl : 34|6@1+ (2,0) [0|100] "%" Vector__XXX
 SG_ RRL_Obj13B_ProbMobPed : 40|6@1+ (2,0) [0|100] "%" Vector__XXX
 SG_ RRL_Obj13B_Prob4PlusWhlCAR : 46|6@1+ (2,0) [0|100] "%" Vector__XXX
 SG_ RRL_Obj13B_Prob4PlusWhlbHGV : 52|6@1+ (2,0) [0|100] "%" Vector__XXX
 SG_ RRL_Obj13B_ProbGNDReflex : 58|6@1+ (2,0) [0|100] "%" Vector__XXX
 SG_ RRL_Obj13B_ProbStatBarrier : 64|6@1+ (2,0) [0|100] "%" Vector__XXX
 SG_ RRL_Obj13B_ProbStatObst : 70|6@1+ (2,0) [0|100] "%" Vector__XXX
 SG_ RRL_Obj13B_MovingProbability : 76|6@1+ (2,0) [0|100] "%" Vector__XXX
 SG_ RRL_Obj13B_MovingObserved : 82|6@1+ (2,0) [0|100] "%" Vector__XXX
 SG_ RRL_Obj13B_FV : 103|8@0+ (1,0) [0|255] "" Vector__XXX

BO_ 812 RRL_Obj14A: 64 Vector__XXX
 SG_ RRL_Obj14A_CRC : 0|16@1+ (1,0) [0|65535] "" Vector__XXX
 SG_ RRL_Obj14A_Ay : 103|9@1+ (0.0625,-16) [-16|15.9375] "m/s^2" Vector__XXX
 SG_ RRL_Obj14A_HeadingYawAngle : 112|9@1+ (0.0175,-4.48) [-3.15|3.15] "rad" Vector__XXX
 SG_ RRL_Obj14A_Length : 121|7@1+ (0.125,0) [0|15.875] "m" Vector__XXX
 SG_ RRL_Obj14A_Width : 128|7@1+ (0.125,0) [0|15.875] "m" Vector__XXX
 SG_ RRL_Obj14A_Height : 135|7@1+ (0.125,0) [0|15.875] "m" Vector__XXX
 SG_ RRL_Obj14A_DxVnce : 142|12@1+ (0.01,0) [0|30] "m^2" Vector__XXX
 SG_ RRL_Obj14A_DyVnce : 154|12@1+ (0.01,0) [0|30] "m^2" Vector__XXX
 SG_ RRL_Obj14A_DzVnce : 166|10@1+ (0.01,0) [0|10] "m^2" Vector__XXX
 SG_ RRL_Obj14A_AliveCtr : 16|8@1+ (1,0) [0|254] "" Vector__XXX
 SG_ RRL_Obj14A_VxVnce : 176|12@1+ (0.01,0) [0|30] "m^2/s^2" Vector__XXX
 SG_ RRL_Obj14A_VyVnce : 188|12@1+ (0.01,0) [0|30] "m^2/s^2" Vector__XXX
 SG_ RRL_Obj14A_AxVnce : 200|12@1+ (0.01,0) [0|30] "m^2/s^4" Vector__XXX
 SG_ RRL_Obj14A_AyVnce : 212|12@1+ (0.01,0) [0|30] "m^2/s^4" Vector__XXX
 SG_ RRL_Obj14A_RefPosIndex : 224|4@1+ (1,0) [0|15] "" Vector__XXX
 SG_ RRL_Obj14A_DxDyCoVnce : 228|12@1+ (0.01,0) [0|30] "m^2" Vector__XXX
 SG_ RRL_Obj14A_DxVxCoVnce : 240|12@1+ (0.01,0) [0|30] "m^2/s" Vector__XXX
 SG_ RRL_Obj14A_BlockCtr : 24|4@1+ (1,0) [0|15] "" Vector__XXX
 SG_ RRL_Obj14A_DyVxCoVnce : 252|12@1+ (0.01,0) [0|30] "m^2/s" Vector__XXX
 SG_ RRL_Obj14A_DxVyCoVnce : 264|12@1+ (0.01,0) [0|30] "m^2/s" Vector__XXX
 SG_ RRL_Obj14A_DyVyCoVnce : 276|12@1+ (0.01,0) [0|30] "m^2/s" Vector__XXX
 SG_ RRL_Obj14A_VxVyCoVnce : 288|12@1+ (0.01,0) [0|30] "m^2/s^2" Vector__XXX
 SG_ RRL_Obj14A_DxAxCoVnce : 300|12@1+ (0.01,0) [0|30] "m^2/s^2" Vector__XXX
 SG_ RRL_Obj14A_DyAxCoVnce : 312|12@1+ (0.01,0) [0|30] "m^2/s^2" Vector__XXX
 SG_ RRL_Obj14A_VxAxCoVnce : 324|12@1+ (0.01,0) [0|30] "m^2/s^3" Vector__XXX
 SG_ RRL_Obj14A_ObjectID : 32|7@1+ (1,0) [0|127] "" Vector__XXX
 SG_ RRL_Obj14A_VyAxCoVnce : 336|12@1+ (0.01,0) [0|30] "m^2/s^3" Vector__XXX
 SG_ RRL_Obj14A_DxAyCoVnce : 348|12@1+ (0.01,0) [0|30] "m^2/s^2" Vector__XXX
 SG_ RRL_Obj14A_DyAyCoVnce : 360|12@1+ (0.01,0) [0|30] "m^2/s^2" Vector__XXX
 SG_ RRL_Obj14A_VxAyCoVnce : 372|12@1+ (0.01,0) [0|30] "m^2/s^3" Vector__XXX
 SG_ RRL_Obj14A_VyAyCoVnce : 384|12@1+ (0.01,0) [0|30] "m^2/s^3" Vector__XXX
 SG_ RRL_Obj14A_AxAyCoVnce : 396|12@1+ (0.01,0) [0|30] "m^2/s^4" Vector__XXX
 SG_ RRL_Obj14A_Measured : 39|1@1+ (1,0) [0|1] "" Vector__XXX
 SG_ RRL_Obj14A_HeadingYawVnce : 408|12@1+ (0.0003,0) [0|1] "rad^2" Vector__XXX
 SG_ RRL_Obj14A_Dx : 40|13@1+ (0.0625,-256) [-256|255.9375] "m" Vector__XXX
 SG_ RRL_Obj14A_LengthVnce : 420|12@1+ (0.01,0) [0|30] "m^2" Vector__XXX
 SG_ RRL_Obj14A_WidthVnce : 432|12@1+ (0.01,0) [0|30] "m^2" Vector__XXX
 SG_ RRL_Obj14A_HeightVnce : 444|12@1+ (0.01,0) [0|30] "m^2" Vector__XXX
 SG_ RRL_Obj14A_ExistProb : 456|6@1+ (2,0) [0|100] "%" Vector__XXX
 SG_ RRL_Obj14A_ProbObstacle : 462|6@1+ (2,0) [0|100] "%" Vector__XXX
 SG_ RRL_Obj14A_ProbNonObstacle : 468|6@1+ (2,0) [0|100] "%" Vector__XXX
 SG_ RRL_Obj14A_ProbMobileObst : 474|6@1+ (2,0) [0|100] "%" Vector__XXX
 SG_ RRL_Obj14A_FV : 487|8@0+ (1,0) [0|255] "" Vector__XXX
 SG_ RRL_Obj14A_MAC : 495|24@0+ (1,0) [0|16777215] "" Vector__XXX
 SG_ RRL_Obj14A_Dz : 53|6@1+ (0.25,-5) [-5|10.75] "m" Vector__XXX
 SG_ RRL_Obj14A_Dy : 59|11@1+ (0.125,-128) [-128|127.875] "m" Vector__XXX
 SG_ RRL_Obj14A_Valid : 70|1@1+ (1,0) [0|1] "" Vector__XXX
 SG_ RRL_Obj14A_Vx : 71|12@1+ (0.0625,-128) [-128|127.9375] "m/s" Vector__XXX
 SG_ RRL_Obj14A_Vy : 83|10@1+ (0.125,-64) [-64|63.875] "m/s" Vector__XXX
 SG_ RRL_Obj14A_Ax : 93|10@1+ (0.03125,-16) [-16|15.96875] "m/s^2" Vector__XXX

BO_ 813 RRL_Obj14B: 16 Vector__XXX
 SG_ RRL_Obj14B_CRC : 0|16@1+ (1,0) [0|65535] "" Vector__XXX
 SG_ RRL_Obj14B_MAC : 111|24@0+ (1,0) [0|16777215] "" Vector__XXX
 SG_ RRL_Obj14B_AliveCtr : 16|8@1+ (1,0) [0|254] "" Vector__XXX
 SG_ RRL_Obj14B_BlockCtr : 24|4@1+ (1,0) [0|15] "" Vector__XXX
 SG_ RRL_Obj14B_ProbMob4PlusWhl : 28|6@1+ (2,0) [0|100] "%" Vector__XXX
 SG_ RRL_Obj14B_ProbMob2Whl : 34|6@1+ (2,0) [0|100] "%" Vector__XXX
 SG_ RRL_Obj14B_ProbMobPed : 40|6@1+ (2,0) [0|100] "%" Vector__XXX
 SG_ RRL_Obj14B_Prob4PlusWhlCAR : 46|6@1+ (2,0) [0|100] "%" Vector__XXX
 SG_ RRL_Obj14B_Prob4PlusWhlbHGV : 52|6@1+ (2,0) [0|100] "%" Vector__XXX
 SG_ RRL_Obj14B_ProbGNDReflex : 58|6@1+ (2,0) [0|100] "%" Vector__XXX
 SG_ RRL_Obj14B_ProbStatBarrier : 64|6@1+ (2,0) [0|100] "%" Vector__XXX
 SG_ RRL_Obj14B_ProbStatObst : 70|6@1+ (2,0) [0|100] "%" Vector__XXX
 SG_ RRL_Obj14B_MovingProbability : 76|6@1+ (2,0) [0|100] "%" Vector__XXX
 SG_ RRL_Obj14B_MovingObserved : 82|6@1+ (2,0) [0|100] "%" Vector__XXX
 SG_ RRL_Obj14B_FV : 103|8@0+ (1,0) [0|255] "" Vector__XXX

BO_ 814 RRL_Obj15A: 64 Vector__XXX
 SG_ RRL_Obj15A_CRC : 0|16@1+ (1,0) [0|65535] "" Vector__XXX
 SG_ RRL_Obj15A_Ay : 103|9@1+ (0.0625,-16) [-16|15.9375] "m/s^2" Vector__XXX
 SG_ RRL_Obj15A_HeadingYawAngle : 112|9@1+ (0.0175,-4.48) [-3.15|3.15] "rad" Vector__XXX
 SG_ RRL_Obj15A_Length : 121|7@1+ (0.125,0) [0|15.875] "m" Vector__XXX
 SG_ RRL_Obj15A_Width : 128|7@1+ (0.125,0) [0|15.875] "m" Vector__XXX
 SG_ RRL_Obj15A_Height : 135|7@1+ (0.125,0) [0|15.875] "m" Vector__XXX
 SG_ RRL_Obj15A_DxVnce : 142|12@1+ (0.01,0) [0|30] "m^2" Vector__XXX
 SG_ RRL_Obj15A_DyVnce : 154|12@1+ (0.01,0) [0|30] "m^2" Vector__XXX
 SG_ RRL_Obj15A_DzVnce : 166|10@1+ (0.01,0) [0|10] "m^2" Vector__XXX
 SG_ RRL_Obj15A_AliveCtr : 16|8@1+ (1,0) [0|254] "" Vector__XXX
 SG_ RRL_Obj15A_VxVnce : 176|12@1+ (0.01,0) [0|30] "m^2/s^2" Vector__XXX
 SG_ RRL_Obj15A_VyVnce : 188|12@1+ (0.01,0) [0|30] "m^2/s^2" Vector__XXX
 SG_ RRL_Obj15A_AxVnce : 200|12@1+ (0.01,0) [0|30] "m^2/s^4" Vector__XXX
 SG_ RRL_Obj15A_AyVnce : 212|12@1+ (0.01,0) [0|30] "m^2/s^4" Vector__XXX
 SG_ RRL_Obj15A_RefPosIndex : 224|4@1+ (1,0) [0|15] "" Vector__XXX
 SG_ RRL_Obj15A_DxDyCoVnce : 228|12@1+ (0.01,0) [0|30] "m^2" Vector__XXX
 SG_ RRL_Obj15A_DxVxCoVnce : 240|12@1+ (0.01,0) [0|30] "m^2/s" Vector__XXX
 SG_ RRL_Obj15A_BlockCtr : 24|4@1+ (1,0) [0|15] "" Vector__XXX
 SG_ RRL_Obj15A_DyVxCoVnce : 252|12@1+ (0.01,0) [0|30] "m^2/s" Vector__XXX
 SG_ RRL_Obj15A_DxVyCoVnce : 264|12@1+ (0.01,0) [0|30] "m^2/s" Vector__XXX
 SG_ RRL_Obj15A_DyVyCoVnce : 276|12@1+ (0.01,0) [0|30] "m^2/s" Vector__XXX
 SG_ RRL_Obj15A_VxVyCoVnce : 288|12@1+ (0.01,0) [0|30] "m^2/s^2" Vector__XXX
 SG_ RRL_Obj15A_DxAxCoVnce : 300|12@1+ (0.01,0) [0|30] "m^2/s^2" Vector__XXX
 SG_ RRL_Obj15A_DyAxCoVnce : 312|12@1+ (0.01,0) [0|30] "m^2/s^2" Vector__XXX
 SG_ RRL_Obj15A_VxAxCoVnce : 324|12@1+ (0.01,0) [0|30] "m^2/s^3" Vector__XXX
 SG_ RRL_Obj15A_ObjectID : 32|7@1+ (1,0) [0|127] "" Vector__XXX
 SG_ RRL_Obj15A_VyAxCoVnce : 336|12@1+ (0.01,0) [0|30] "m^2/s^3" Vector__XXX
 SG_ RRL_Obj15A_DxAyCoVnce : 348|12@1+ (0.01,0) [0|30] "m^2/s^2" Vector__XXX
 SG_ RRL_Obj15A_DyAyCoVnce : 360|12@1+ (0.01,0) [0|30] "m^2/s^2" Vector__XXX
 SG_ RRL_Obj15A_VxAyCoVnce : 372|12@1+ (0.01,0) [0|30] "m^2/s^3" Vector__XXX
 SG_ RRL_Obj15A_VyAyCoVnce : 384|12@1+ (0.01,0) [0|30] "m^2/s^3" Vector__XXX
 SG_ RRL_Obj15A_AxAyCoVnce : 396|12@1+ (0.01,0) [0|30] "m^2/s^4" Vector__XXX
 SG_ RRL_Obj15A_Measured : 39|1@1+ (1,0) [0|1] "" Vector__XXX
 SG_ RRL_Obj15A_HeadingYawVnce : 408|12@1+ (0.0003,0) [0|1] "rad^2" Vector__XXX
 SG_ RRL_Obj15A_Dx : 40|13@1+ (0.0625,-256) [-256|255.9375] "m" Vector__XXX
 SG_ RRL_Obj15A_LengthVnce : 420|12@1+ (0.01,0) [0|30] "m^2" Vector__XXX
 SG_ RRL_Obj15A_WidthVnce : 432|12@1+ (0.01,0) [0|30] "m^2" Vector__XXX
 SG_ RRL_Obj15A_HeightVnce : 444|12@1+ (0.01,0) [0|30] "m^2" Vector__XXX
 SG_ RRL_Obj15A_ExistProb : 456|6@1+ (2,0) [0|100] "%" Vector__XXX
 SG_ RRL_Obj15A_ProbObstacle : 462|6@1+ (2,0) [0|100] "%" Vector__XXX
 SG_ RRL_Obj15A_ProbNonObstacle : 468|6@1+ (2,0) [0|100] "%" Vector__XXX
 SG_ RRL_Obj15A_ProbMobileObst : 474|6@1+ (2,0) [0|100] "%" Vector__XXX
 SG_ RRL_Obj15A_FV : 487|8@0+ (1,0) [0|255] "" Vector__XXX
 SG_ RRL_Obj15A_MAC : 495|24@0+ (1,0) [0|16777215] "" Vector__XXX
 SG_ RRL_Obj15A_Dz : 53|6@1+ (0.25,-5) [-5|10.75] "m" Vector__XXX
 SG_ RRL_Obj15A_Dy : 59|11@1+ (0.125,-128) [-128|127.875] "m" Vector__XXX
 SG_ RRL_Obj15A_Valid : 70|1@1+ (1,0) [0|1] "" Vector__XXX
 SG_ RRL_Obj15A_Vx : 71|12@1+ (0.0625,-128) [-128|127.9375] "m/s" Vector__XXX
 SG_ RRL_Obj15A_Vy : 83|10@1+ (0.125,-64) [-64|63.875] "m/s" Vector__XXX
 SG_ RRL_Obj15A_Ax : 93|10@1+ (0.03125,-16) [-16|15.96875] "m/s^2" Vector__XXX

BO_ 815 RRL_Obj15B: 16 Vector__XXX
 SG_ RRL_Obj15B_CRC : 0|16@1+ (1,0) [0|65535] "" Vector__XXX
 SG_ RRL_Obj15B_MAC : 111|24@0+ (1,0) [0|16777215] "" Vector__XXX
 SG_ RRL_Obj15B_AliveCtr : 16|8@1+ (1,0) [0|254] "" Vector__XXX
 SG_ RRL_Obj15B_BlockCtr : 24|4@1+ (1,0) [0|15] "" Vector__XXX
 SG_ RRL_Obj15B_ProbMob4PlusWhl : 28|6@1+ (2,0) [0|100] "%" Vector__XXX
 SG_ RRL_Obj15B_ProbMob2Whl : 34|6@1+ (2,0) [0|100] "%" Vector__XXX
 SG_ RRL_Obj15B_ProbMobPed : 40|6@1+ (2,0) [0|100] "%" Vector__XXX
 SG_ RRL_Obj15B_Prob4PlusWhlCAR : 46|6@1+ (2,0) [0|100] "%" Vector__XXX
 SG_ RRL_Obj15B_Prob4PlusWhlbHGV : 52|6@1+ (2,0) [0|100] "%" Vector__XXX
 SG_ RRL_Obj15B_ProbGNDReflex : 58|6@1+ (2,0) [0|100] "%" Vector__XXX
 SG_ RRL_Obj15B_ProbStatBarrier : 64|6@1+ (2,0) [0|100] "%" Vector__XXX
 SG_ RRL_Obj15B_ProbStatObst : 70|6@1+ (2,0) [0|100] "%" Vector__XXX
 SG_ RRL_Obj15B_MovingProbability : 76|6@1+ (2,0) [0|100] "%" Vector__XXX
 SG_ RRL_Obj15B_MovingObserved : 82|6@1+ (2,0) [0|100] "%" Vector__XXX
 SG_ RRL_Obj15B_FV : 103|8@0+ (1,0) [0|255] "" Vector__XXX

BO_ 816 RRL_Obj16A: 64 Vector__XXX
 SG_ RRL_Obj16A_CRC : 0|16@1+ (1,0) [0|65535] "" Vector__XXX
 SG_ RRL_Obj16A_Ay : 103|9@1+ (0.0625,-16) [-16|15.9375] "m/s^2" Vector__XXX
 SG_ RRL_Obj16A_HeadingYawAngle : 112|9@1+ (0.0175,-4.48) [-3.15|3.15] "rad" Vector__XXX
 SG_ RRL_Obj16A_Length : 121|7@1+ (0.125,0) [0|15.875] "m" Vector__XXX
 SG_ RRL_Obj16A_Width : 128|7@1+ (0.125,0) [0|15.875] "m" Vector__XXX
 SG_ RRL_Obj16A_Height : 135|7@1+ (0.125,0) [0|15.875] "m" Vector__XXX
 SG_ RRL_Obj16A_DxVnce : 142|12@1+ (0.01,0) [0|30] "m^2" Vector__XXX
 SG_ RRL_Obj16A_DyVnce : 154|12@1+ (0.01,0) [0|30] "m^2" Vector__XXX
 SG_ RRL_Obj16A_DzVnce : 166|10@1+ (0.01,0) [0|10] "m^2" Vector__XXX
 SG_ RRL_Obj16A_AliveCtr : 16|8@1+ (1,0) [0|254] "" Vector__XXX
 SG_ RRL_Obj16A_VxVnce : 176|12@1+ (0.01,0) [0|30] "m^2/s^2" Vector__XXX
 SG_ RRL_Obj16A_VyVnce : 188|12@1+ (0.01,0) [0|30] "m^2/s^2" Vector__XXX
 SG_ RRL_Obj16A_AxVnce : 200|12@1+ (0.01,0) [0|30] "m^2/s^4" Vector__XXX
 SG_ RRL_Obj16A_AyVnce : 212|12@1+ (0.01,0) [0|30] "m^2/s^4" Vector__XXX
 SG_ RRL_Obj16A_RefPosIndex : 224|4@1+ (1,0) [0|15] "" Vector__XXX
 SG_ RRL_Obj16A_DxDyCoVnce : 228|12@1+ (0.01,0) [0|30] "m^2" Vector__XXX
 SG_ RRL_Obj16A_DxVxCoVnce : 240|12@1+ (0.01,0) [0|30] "m^2/s" Vector__XXX
 SG_ RRL_Obj16A_BlockCtr : 24|4@1+ (1,0) [0|15] "" Vector__XXX
 SG_ RRL_Obj16A_DyVxCoVnce : 252|12@1+ (0.01,0) [0|30] "m^2/s" Vector__XXX
 SG_ RRL_Obj16A_DxVyCoVnce : 264|12@1+ (0.01,0) [0|30] "m^2/s" Vector__XXX
 SG_ RRL_Obj16A_DyVyCoVnce : 276|12@1+ (0.01,0) [0|30] "m^2/s" Vector__XXX
 SG_ RRL_Obj16A_VxVyCoVnce : 288|12@1+ (0.01,0) [0|30] "m^2/s^2" Vector__XXX
 SG_ RRL_Obj16A_DxAxCoVnce : 300|12@1+ (0.01,0) [0|30] "m^2/s^2" Vector__XXX
 SG_ RRL_Obj16A_DyAxCoVnce : 312|12@1+ (0.01,0) [0|30] "m^2/s^2" Vector__XXX
 SG_ RRL_Obj16A_VxAxCoVnce : 324|12@1+ (0.01,0) [0|30] "m^2/s^3" Vector__XXX
 SG_ RRL_Obj16A_ObjectID : 32|7@1+ (1,0) [0|127] "" Vector__XXX
 SG_ RRL_Obj16A_VyAxCoVnce : 336|12@1+ (0.01,0) [0|30] "m^2/s^3" Vector__XXX
 SG_ RRL_Obj16A_DxAyCoVnce : 348|12@1+ (0.01,0) [0|30] "m^2/s^2" Vector__XXX
 SG_ RRL_Obj16A_DyAyCoVnce : 360|12@1+ (0.01,0) [0|30] "m^2/s^2" Vector__XXX
 SG_ RRL_Obj16A_VxAyCoVnce : 372|12@1+ (0.01,0) [0|30] "m^2/s^3" Vector__XXX
 SG_ RRL_Obj16A_VyAyCoVnce : 384|12@1+ (0.01,0) [0|30] "m^2/s^3" Vector__XXX
 SG_ RRL_Obj16A_AxAyCoVnce : 396|12@1+ (0.01,0) [0|30] "m^2/s^4" Vector__XXX
 SG_ RRL_Obj16A_Measured : 39|1@1+ (1,0) [0|1] "" Vector__XXX
 SG_ RRL_Obj16A_HeadingYawVnce : 408|12@1+ (0.0003,0) [0|1] "rad^2" Vector__XXX
 SG_ RRL_Obj16A_Dx : 40|13@1+ (0.0625,-256) [-256|255.9375] "m" Vector__XXX
 SG_ RRL_Obj16A_LengthVnce : 420|12@1+ (0.01,0) [0|30] "m^2" Vector__XXX
 SG_ RRL_Obj16A_WidthVnce : 432|12@1+ (0.01,0) [0|30] "m^2" Vector__XXX
 SG_ RRL_Obj16A_HeightVnce : 444|12@1+ (0.01,0) [0|30] "m^2" Vector__XXX
 SG_ RRL_Obj16A_ExistProb : 456|6@1+ (2,0) [0|100] "%" Vector__XXX
 SG_ RRL_Obj16A_ProbObstacle : 462|6@1+ (2,0) [0|100] "%" Vector__XXX
 SG_ RRL_Obj16A_ProbNonObstacle : 468|6@1+ (2,0) [0|100] "%" Vector__XXX
 SG_ RRL_Obj16A_ProbMobileObst : 474|6@1+ (2,0) [0|100] "%" Vector__XXX
 SG_ RRL_Obj16A_FV : 487|8@0+ (1,0) [0|255] "" Vector__XXX
 SG_ RRL_Obj16A_MAC : 495|24@0+ (1,0) [0|16777215] "" Vector__XXX
 SG_ RRL_Obj16A_Dz : 53|6@1+ (0.25,-5) [-5|10.75] "m" Vector__XXX
 SG_ RRL_Obj16A_Dy : 59|11@1+ (0.125,-128) [-128|127.875] "m" Vector__XXX
 SG_ RRL_Obj16A_Valid : 70|1@1+ (1,0) [0|1] "" Vector__XXX
 SG_ RRL_Obj16A_Vx : 71|12@1+ (0.0625,-128) [-128|127.9375] "m/s" Vector__XXX
 SG_ RRL_Obj16A_Vy : 83|10@1+ (0.125,-64) [-64|63.875] "m/s" Vector__XXX
 SG_ RRL_Obj16A_Ax : 93|10@1+ (0.03125,-16) [-16|15.96875] "m/s^2" Vector__XXX

BO_ 817 RRL_Obj16B: 16 Vector__XXX
 SG_ RRL_Obj16B_CRC : 0|16@1+ (1,0) [0|65535] "" Vector__XXX
 SG_ RRL_Obj16B_MAC : 111|24@0+ (1,0) [0|16777215] "" Vector__XXX
 SG_ RRL_Obj16B_AliveCtr : 16|8@1+ (1,0) [0|254] "" Vector__XXX
 SG_ RRL_Obj16B_BlockCtr : 24|4@1+ (1,0) [0|15] "" Vector__XXX
 SG_ RRL_Obj16B_ProbMob4PlusWhl : 28|6@1+ (2,0) [0|100] "%" Vector__XXX
 SG_ RRL_Obj16B_ProbMob2Whl : 34|6@1+ (2,0) [0|100] "%" Vector__XXX
 SG_ RRL_Obj16B_ProbMobPed : 40|6@1+ (2,0) [0|100] "%" Vector__XXX
 SG_ RRL_Obj16B_Prob4PlusWhlCAR : 46|6@1+ (2,0) [0|100] "%" Vector__XXX
 SG_ RRL_Obj16B_Prob4PlusWhlbHGV : 52|6@1+ (2,0) [0|100] "%" Vector__XXX
 SG_ RRL_Obj16B_ProbGNDReflex : 58|6@1+ (2,0) [0|100] "%" Vector__XXX
 SG_ RRL_Obj16B_ProbStatBarrier : 64|6@1+ (2,0) [0|100] "%" Vector__XXX
 SG_ RRL_Obj16B_ProbStatObst : 70|6@1+ (2,0) [0|100] "%" Vector__XXX
 SG_ RRL_Obj16B_MovingProbability : 76|6@1+ (2,0) [0|100] "%" Vector__XXX
 SG_ RRL_Obj16B_MovingObserved : 82|6@1+ (2,0) [0|100] "%" Vector__XXX
 SG_ RRL_Obj16B_FV : 103|8@0+ (1,0) [0|255] "" Vector__XXX

BO_ 818 RRL_Obj17A: 64 Vector__XXX
 SG_ RRL_Obj17A_CRC : 0|16@1+ (1,0) [0|65535] "" Vector__XXX
 SG_ RRL_Obj17A_Ay : 103|9@1+ (0.0625,-16) [-16|15.9375] "m/s^2" Vector__XXX
 SG_ RRL_Obj17A_HeadingYawAngle : 112|9@1+ (0.0175,-4.48) [-3.15|3.15] "rad" Vector__XXX
 SG_ RRL_Obj17A_Length : 121|7@1+ (0.125,0) [0|15.875] "m" Vector__XXX
 SG_ RRL_Obj17A_Width : 128|7@1+ (0.125,0) [0|15.875] "m" Vector__XXX
 SG_ RRL_Obj17A_Height : 135|7@1+ (0.125,0) [0|15.875] "m" Vector__XXX
 SG_ RRL_Obj17A_DxVnce : 142|12@1+ (0.01,0) [0|30] "m^2" Vector__XXX
 SG_ RRL_Obj17A_DyVnce : 154|12@1+ (0.01,0) [0|30] "m^2" Vector__XXX
 SG_ RRL_Obj17A_DzVnce : 166|10@1+ (0.01,0) [0|10] "m^2" Vector__XXX
 SG_ RRL_Obj17A_AliveCtr : 16|8@1+ (1,0) [0|254] "" Vector__XXX
 SG_ RRL_Obj17A_VxVnce : 176|12@1+ (0.01,0) [0|30] "m^2/s^2" Vector__XXX
 SG_ RRL_Obj17A_VyVnce : 188|12@1+ (0.01,0) [0|30] "m^2/s^2" Vector__XXX
 SG_ RRL_Obj17A_AxVnce : 200|12@1+ (0.01,0) [0|30] "m^2/s^4" Vector__XXX
 SG_ RRL_Obj17A_AyVnce : 212|12@1+ (0.01,0) [0|30] "m^2/s^4" Vector__XXX
 SG_ RRL_Obj17A_RefPosIndex : 224|4@1+ (1,0) [0|15] "" Vector__XXX
 SG_ RRL_Obj17A_DxDyCoVnce : 228|12@1+ (0.01,0) [0|30] "m^2" Vector__XXX
 SG_ RRL_Obj17A_DxVxCoVnce : 240|12@1+ (0.01,0) [0|30] "m^2/s" Vector__XXX
 SG_ RRL_Obj17A_BlockCtr : 24|4@1+ (1,0) [0|15] "" Vector__XXX
 SG_ RRL_Obj17A_DyVxCoVnce : 252|12@1+ (0.01,0) [0|30] "m^2/s" Vector__XXX
 SG_ RRL_Obj17A_DxVyCoVnce : 264|12@1+ (0.01,0) [0|30] "m^2/s" Vector__XXX
 SG_ RRL_Obj17A_DyVyCoVnce : 276|12@1+ (0.01,0) [0|30] "m^2/s" Vector__XXX
 SG_ RRL_Obj17A_VxVyCoVnce : 288|12@1+ (0.01,0) [0|30] "m^2/s^2" Vector__XXX
 SG_ RRL_Obj17A_DxAxCoVnce : 300|12@1+ (0.01,0) [0|30] "m^2/s^2" Vector__XXX
 SG_ RRL_Obj17A_DyAxCoVnce : 312|12@1+ (0.01,0) [0|30] "m^2/s^2" Vector__XXX
 SG_ RRL_Obj17A_VxAxCoVnce : 324|12@1+ (0.01,0) [0|30] "m^2/s^3" Vector__XXX
 SG_ RRL_Obj17A_ObjectID : 32|7@1+ (1,0) [0|127] "" Vector__XXX
 SG_ RRL_Obj17A_VyAxCoVnce : 336|12@1+ (0.01,0) [0|30] "m^2/s^3" Vector__XXX
 SG_ RRL_Obj17A_DxAyCoVnce : 348|12@1+ (0.01,0) [0|30] "m^2/s^2" Vector__XXX
 SG_ RRL_Obj17A_DyAyCoVnce : 360|12@1+ (0.01,0) [0|30] "m^2/s^2" Vector__XXX
 SG_ RRL_Obj17A_VxAyCoVnce : 372|12@1+ (0.01,0) [0|30] "m^2/s^3" Vector__XXX
 SG_ RRL_Obj17A_VyAyCoVnce : 384|12@1+ (0.01,0) [0|30] "m^2/s^3" Vector__XXX
 SG_ RRL_Obj17A_AxAyCoVnce : 396|12@1+ (0.01,0) [0|30] "m^2/s^4" Vector__XXX
 SG_ RRL_Obj17A_Measured : 39|1@1+ (1,0) [0|1] "" Vector__XXX
 SG_ RRL_Obj17A_HeadingYawVnce : 408|12@1+ (0.0003,0) [0|1] "rad^2" Vector__XXX
 SG_ RRL_Obj17A_Dx : 40|13@1+ (0.0625,-256) [-256|255.9375] "m" Vector__XXX
 SG_ RRL_Obj17A_LengthVnce : 420|12@1+ (0.01,0) [0|30] "m^2" Vector__XXX
 SG_ RRL_Obj17A_WidthVnce : 432|12@1+ (0.01,0) [0|30] "m^2" Vector__XXX
 SG_ RRL_Obj17A_HeightVnce : 444|12@1+ (0.01,0) [0|30] "m^2" Vector__XXX
 SG_ RRL_Obj17A_ExistProb : 456|6@1+ (2,0) [0|100] "%" Vector__XXX
 SG_ RRL_Obj17A_ProbObstacle : 462|6@1+ (2,0) [0|100] "%" Vector__XXX
 SG_ RRL_Obj17A_ProbNonObstacle : 468|6@1+ (2,0) [0|100] "%" Vector__XXX
 SG_ RRL_Obj17A_ProbMobileObst : 474|6@1+ (2,0) [0|100] "%" Vector__XXX
 SG_ RRL_Obj17A_FV : 487|8@0+ (1,0) [0|255] "" Vector__XXX
 SG_ RRL_Obj17A_MAC : 495|24@0+ (1,0) [0|16777215] "" Vector__XXX
 SG_ RRL_Obj17A_Dz : 53|6@1+ (0.25,-5) [-5|10.75] "m" Vector__XXX
 SG_ RRL_Obj17A_Dy : 59|11@1+ (0.125,-128) [-128|127.875] "m" Vector__XXX
 SG_ RRL_Obj17A_Valid : 70|1@1+ (1,0) [0|1] "" Vector__XXX
 SG_ RRL_Obj17A_Vx : 71|12@1+ (0.0625,-128) [-128|127.9375] "m/s" Vector__XXX
 SG_ RRL_Obj17A_Vy : 83|10@1+ (0.125,-64) [-64|63.875] "m/s" Vector__XXX
 SG_ RRL_Obj17A_Ax : 93|10@1+ (0.03125,-16) [-16|15.96875] "m/s^2" Vector__XXX

BO_ 819 RRL_Obj17B: 16 Vector__XXX
 SG_ RRL_Obj17B_CRC : 0|16@1+ (1,0) [0|65535] "" Vector__XXX
 SG_ RRL_Obj17B_MAC : 111|24@0+ (1,0) [0|16777215] "" Vector__XXX
 SG_ RRL_Obj17B_AliveCtr : 16|8@1+ (1,0) [0|254] "" Vector__XXX
 SG_ RRL_Obj17B_BlockCtr : 24|4@1+ (1,0) [0|15] "" Vector__XXX
 SG_ RRL_Obj17B_ProbMob4PlusWhl : 28|6@1+ (2,0) [0|100] "%" Vector__XXX
 SG_ RRL_Obj17B_ProbMob2Whl : 34|6@1+ (2,0) [0|100] "%" Vector__XXX
 SG_ RRL_Obj17B_ProbMobPed : 40|6@1+ (2,0) [0|100] "%" Vector__XXX
 SG_ RRL_Obj17B_Prob4PlusWhlCAR : 46|6@1+ (2,0) [0|100] "%" Vector__XXX
 SG_ RRL_Obj17B_Prob4PlusWhlbHGV : 52|6@1+ (2,0) [0|100] "%" Vector__XXX
 SG_ RRL_Obj17B_ProbGNDReflex : 58|6@1+ (2,0) [0|100] "%" Vector__XXX
 SG_ RRL_Obj17B_ProbStatBarrier : 64|6@1+ (2,0) [0|100] "%" Vector__XXX
 SG_ RRL_Obj17B_ProbStatObst : 70|6@1+ (2,0) [0|100] "%" Vector__XXX
 SG_ RRL_Obj17B_MovingProbability : 76|6@1+ (2,0) [0|100] "%" Vector__XXX
 SG_ RRL_Obj17B_MovingObserved : 82|6@1+ (2,0) [0|100] "%" Vector__XXX
 SG_ RRL_Obj17B_FV : 103|8@0+ (1,0) [0|255] "" Vector__XXX

BO_ 820 RRL_Obj18A: 64 Vector__XXX
 SG_ RRL_Obj18A_CRC : 0|16@1+ (1,0) [0|65535] "" Vector__XXX
 SG_ RRL_Obj18A_Ay : 103|9@1+ (0.0625,-16) [-16|15.9375] "m/s^2" Vector__XXX
 SG_ RRL_Obj18A_HeadingYawAngle : 112|9@1+ (0.0175,-4.48) [-3.15|3.15] "rad" Vector__XXX
 SG_ RRL_Obj18A_Length : 121|7@1+ (0.125,0) [0|15.875] "m" Vector__XXX
 SG_ RRL_Obj18A_Width : 128|7@1+ (0.125,0) [0|15.875] "m" Vector__XXX
 SG_ RRL_Obj18A_Height : 135|7@1+ (0.125,0) [0|15.875] "m" Vector__XXX
 SG_ RRL_Obj18A_DxVnce : 142|12@1+ (0.01,0) [0|30] "m^2" Vector__XXX
 SG_ RRL_Obj18A_DyVnce : 154|12@1+ (0.01,0) [0|30] "m^2" Vector__XXX
 SG_ RRL_Obj18A_DzVnce : 166|10@1+ (0.01,0) [0|10] "m^2" Vector__XXX
 SG_ RRL_Obj18A_AliveCtr : 16|8@1+ (1,0) [0|254] "" Vector__XXX
 SG_ RRL_Obj18A_VxVnce : 176|12@1+ (0.01,0) [0|30] "m^2/s^2" Vector__XXX
 SG_ RRL_Obj18A_VyVnce : 188|12@1+ (0.01,0) [0|30] "m^2/s^2" Vector__XXX
 SG_ RRL_Obj18A_AxVnce : 200|12@1+ (0.01,0) [0|30] "m^2/s^4" Vector__XXX
 SG_ RRL_Obj18A_AyVnce : 212|12@1+ (0.01,0) [0|30] "m^2/s^4" Vector__XXX
 SG_ RRL_Obj18A_RefPosIndex : 224|4@1+ (1,0) [0|15] "" Vector__XXX
 SG_ RRL_Obj18A_DxDyCoVnce : 228|12@1+ (0.01,0) [0|30] "m^2" Vector__XXX
 SG_ RRL_Obj18A_DxVxCoVnce : 240|12@1+ (0.01,0) [0|30] "m^2/s" Vector__XXX
 SG_ RRL_Obj18A_BlockCtr : 24|4@1+ (1,0) [0|15] "" Vector__XXX
 SG_ RRL_Obj18A_DyVxCoVnce : 252|12@1+ (0.01,0) [0|30] "m^2/s" Vector__XXX
 SG_ RRL_Obj18A_DxVyCoVnce : 264|12@1+ (0.01,0) [0|30] "m^2/s" Vector__XXX
 SG_ RRL_Obj18A_DyVyCoVnce : 276|12@1+ (0.01,0) [0|30] "m^2/s" Vector__XXX
 SG_ RRL_Obj18A_VxVyCoVnce : 288|12@1+ (0.01,0) [0|30] "m^2/s^2" Vector__XXX
 SG_ RRL_Obj18A_DxAxCoVnce : 300|12@1+ (0.01,0) [0|30] "m^2/s^2" Vector__XXX
 SG_ RRL_Obj18A_DyAxCoVnce : 312|12@1+ (0.01,0) [0|30] "m^2/s^2" Vector__XXX
 SG_ RRL_Obj18A_VxAxCoVnce : 324|12@1+ (0.01,0) [0|30] "m^2/s^3" Vector__XXX
 SG_ RRL_Obj18A_ObjectID : 32|7@1+ (1,0) [0|127] "" Vector__XXX
 SG_ RRL_Obj18A_VyAxCoVnce : 336|12@1+ (0.01,0) [0|30] "m^2/s^3" Vector__XXX
 SG_ RRL_Obj18A_DxAyCoVnce : 348|12@1+ (0.01,0) [0|30] "m^2/s^2" Vector__XXX
 SG_ RRL_Obj18A_DyAyCoVnce : 360|12@1+ (0.01,0) [0|30] "m^2/s^2" Vector__XXX
 SG_ RRL_Obj18A_VxAyCoVnce : 372|12@1+ (0.01,0) [0|30] "m^2/s^3" Vector__XXX
 SG_ RRL_Obj18A_VyAyCoVnce : 384|12@1+ (0.01,0) [0|30] "m^2/s^3" Vector__XXX
 SG_ RRL_Obj18A_AxAyCoVnce : 396|12@1+ (0.01,0) [0|30] "m^2/s^4" Vector__XXX
 SG_ RRL_Obj18A_Measured : 39|1@1+ (1,0) [0|1] "" Vector__XXX
 SG_ RRL_Obj18A_HeadingYawVnce : 408|12@1+ (0.0003,0) [0|1] "rad^2" Vector__XXX
 SG_ RRL_Obj18A_Dx : 40|13@1+ (0.0625,-256) [-256|255.9375] "m" Vector__XXX
 SG_ RRL_Obj18A_LengthVnce : 420|12@1+ (0.01,0) [0|30] "m^2" Vector__XXX
 SG_ RRL_Obj18A_WidthVnce : 432|12@1+ (0.01,0) [0|30] "m^2" Vector__XXX
 SG_ RRL_Obj18A_HeightVnce : 444|12@1+ (0.01,0) [0|30] "m^2" Vector__XXX
 SG_ RRL_Obj18A_ExistProb : 456|6@1+ (2,0) [0|100] "%" Vector__XXX
 SG_ RRL_Obj18A_ProbObstacle : 462|6@1+ (2,0) [0|100] "%" Vector__XXX
 SG_ RRL_Obj18A_ProbNonObstacle : 468|6@1+ (2,0) [0|100] "%" Vector__XXX
 SG_ RRL_Obj18A_ProbMobileObst : 474|6@1+ (2,0) [0|100] "%" Vector__XXX
 SG_ RRL_Obj18A_FV : 487|8@0+ (1,0) [0|255] "" Vector__XXX
 SG_ RRL_Obj18A_MAC : 495|24@0+ (1,0) [0|16777215] "" Vector__XXX
 SG_ RRL_Obj18A_Dz : 53|6@1+ (0.25,-5) [-5|10.75] "m" Vector__XXX
 SG_ RRL_Obj18A_Dy : 59|11@1+ (0.125,-128) [-128|127.875] "m" Vector__XXX
 SG_ RRL_Obj18A_Valid : 70|1@1+ (1,0) [0|1] "" Vector__XXX
 SG_ RRL_Obj18A_Vx : 71|12@1+ (0.0625,-128) [-128|127.9375] "m/s" Vector__XXX
 SG_ RRL_Obj18A_Vy : 83|10@1+ (0.125,-64) [-64|63.875] "m/s" Vector__XXX
 SG_ RRL_Obj18A_Ax : 93|10@1+ (0.03125,-16) [-16|15.96875] "m/s^2" Vector__XXX

BO_ 821 RRL_Obj18B: 16 Vector__XXX
 SG_ RRL_Obj18B_CRC : 0|16@1+ (1,0) [0|65535] "" Vector__XXX
 SG_ RRL_Obj18B_MAC : 111|24@0+ (1,0) [0|16777215] "" Vector__XXX
 SG_ RRL_Obj18B_AliveCtr : 16|8@1+ (1,0) [0|254] "" Vector__XXX
 SG_ RRL_Obj18B_BlockCtr : 24|4@1+ (1,0) [0|15] "" Vector__XXX
 SG_ RRL_Obj18B_ProbMob4PlusWhl : 28|6@1+ (2,0) [0|100] "%" Vector__XXX
 SG_ RRL_Obj18B_ProbMob2Whl : 34|6@1+ (2,0) [0|100] "%" Vector__XXX
 SG_ RRL_Obj18B_ProbMobPed : 40|6@1+ (2,0) [0|100] "%" Vector__XXX
 SG_ RRL_Obj18B_Prob4PlusWhlCAR : 46|6@1+ (2,0) [0|100] "%" Vector__XXX
 SG_ RRL_Obj18B_Prob4PlusWhlbHGV : 52|6@1+ (2,0) [0|100] "%" Vector__XXX
 SG_ RRL_Obj18B_ProbGNDReflex : 58|6@1+ (2,0) [0|100] "%" Vector__XXX
 SG_ RRL_Obj18B_ProbStatBarrier : 64|6@1+ (2,0) [0|100] "%" Vector__XXX
 SG_ RRL_Obj18B_ProbStatObst : 70|6@1+ (2,0) [0|100] "%" Vector__XXX
 SG_ RRL_Obj18B_MovingProbability : 76|6@1+ (2,0) [0|100] "%" Vector__XXX
 SG_ RRL_Obj18B_MovingObserved : 82|6@1+ (2,0) [0|100] "%" Vector__XXX
 SG_ RRL_Obj18B_FV : 103|8@0+ (1,0) [0|255] "" Vector__XXX

BO_ 822 RRL_Obj19A: 64 Vector__XXX
 SG_ RRL_Obj19A_CRC : 0|16@1+ (1,0) [0|65535] "" Vector__XXX
 SG_ RRL_Obj19A_Ay : 103|9@1+ (0.0625,-16) [-16|15.9375] "m/s^2" Vector__XXX
 SG_ RRL_Obj19A_HeadingYawAngle : 112|9@1+ (0.0175,-4.48) [-3.15|3.15] "rad" Vector__XXX
 SG_ RRL_Obj19A_Length : 121|7@1+ (0.125,0) [0|15.875] "m" Vector__XXX
 SG_ RRL_Obj19A_Width : 128|7@1+ (0.125,0) [0|15.875] "m" Vector__XXX
 SG_ RRL_Obj19A_Height : 135|7@1+ (0.125,0) [0|15.875] "m" Vector__XXX
 SG_ RRL_Obj19A_DxVnce : 142|12@1+ (0.01,0) [0|30] "m^2" Vector__XXX
 SG_ RRL_Obj19A_DyVnce : 154|12@1+ (0.01,0) [0|30] "m^2" Vector__XXX
 SG_ RRL_Obj19A_DzVnce : 166|10@1+ (0.01,0) [0|10] "m^2" Vector__XXX
 SG_ RRL_Obj19A_AliveCtr : 16|8@1+ (1,0) [0|254] "" Vector__XXX
 SG_ RRL_Obj19A_VxVnce : 176|12@1+ (0.01,0) [0|30] "m^2/s^2" Vector__XXX
 SG_ RRL_Obj19A_VyVnce : 188|12@1+ (0.01,0) [0|30] "m^2/s^2" Vector__XXX
 SG_ RRL_Obj19A_AxVnce : 200|12@1+ (0.01,0) [0|30] "m^2/s^4" Vector__XXX
 SG_ RRL_Obj19A_AyVnce : 212|12@1+ (0.01,0) [0|30] "m^2/s^4" Vector__XXX
 SG_ RRL_Obj19A_RefPosIndex : 224|4@1+ (1,0) [0|15] "" Vector__XXX
 SG_ RRL_Obj19A_DxDyCoVnce : 228|12@1+ (0.01,0) [0|30] "m^2" Vector__XXX
 SG_ RRL_Obj19A_DxVxCoVnce : 240|12@1+ (0.01,0) [0|30] "m^2/s" Vector__XXX
 SG_ RRL_Obj19A_BlockCtr : 24|4@1+ (1,0) [0|15] "" Vector__XXX
 SG_ RRL_Obj19A_DyVxCoVnce : 252|12@1+ (0.01,0) [0|30] "m^2/s" Vector__XXX
 SG_ RRL_Obj19A_DxVyCoVnce : 264|12@1+ (0.01,0) [0|30] "m^2/s" Vector__XXX
 SG_ RRL_Obj19A_DyVyCoVnce : 276|12@1+ (0.01,0) [0|30] "m^2/s" Vector__XXX
 SG_ RRL_Obj19A_VxVyCoVnce : 288|12@1+ (0.01,0) [0|30] "m^2/s^2" Vector__XXX
 SG_ RRL_Obj19A_DxAxCoVnce : 300|12@1+ (0.01,0) [0|30] "m^2/s^2" Vector__XXX
 SG_ RRL_Obj19A_DyAxCoVnce : 312|12@1+ (0.01,0) [0|30] "m^2/s^2" Vector__XXX
 SG_ RRL_Obj19A_VxAxCoVnce : 324|12@1+ (0.01,0) [0|30] "m^2/s^3" Vector__XXX
 SG_ RRL_Obj19A_ObjectID : 32|7@1+ (1,0) [0|127] "" Vector__XXX
 SG_ RRL_Obj19A_VyAxCoVnce : 336|12@1+ (0.01,0) [0|30] "m^2/s^3" Vector__XXX
 SG_ RRL_Obj19A_DxAyCoVnce : 348|12@1+ (0.01,0) [0|30] "m^2/s^2" Vector__XXX
 SG_ RRL_Obj19A_DyAyCoVnce : 360|12@1+ (0.01,0) [0|30] "m^2/s^2" Vector__XXX
 SG_ RRL_Obj19A_VxAyCoVnce : 372|12@1+ (0.01,0) [0|30] "m^2/s^3" Vector__XXX
 SG_ RRL_Obj19A_VyAyCoVnce : 384|12@1+ (0.01,0) [0|30] "m^2/s^3" Vector__XXX
 SG_ RRL_Obj19A_AxAyCoVnce : 396|12@1+ (0.01,0) [0|30] "m^2/s^4" Vector__XXX
 SG_ RRL_Obj19A_Measured : 39|1@1+ (1,0) [0|1] "" Vector__XXX
 SG_ RRL_Obj19A_HeadingYawVnce : 408|12@1+ (0.0003,0) [0|1] "rad^2" Vector__XXX
 SG_ RRL_Obj19A_Dx : 40|13@1+ (0.0625,-256) [-256|255.9375] "m" Vector__XXX
 SG_ RRL_Obj19A_LengthVnce : 420|12@1+ (0.01,0) [0|30] "m^2" Vector__XXX
 SG_ RRL_Obj19A_WidthVnce : 432|12@1+ (0.01,0) [0|30] "m^2" Vector__XXX
 SG_ RRL_Obj19A_HeightVnce : 444|12@1+ (0.01,0) [0|30] "m^2" Vector__XXX
 SG_ RRL_Obj19A_ExistProb : 456|6@1+ (2,0) [0|100] "%" Vector__XXX
 SG_ RRL_Obj19A_ProbObstacle : 462|6@1+ (2,0) [0|100] "%" Vector__XXX
 SG_ RRL_Obj19A_ProbNonObstacle : 468|6@1+ (2,0) [0|100] "%" Vector__XXX
 SG_ RRL_Obj19A_ProbMobileObst : 474|6@1+ (2,0) [0|100] "%" Vector__XXX
 SG_ RRL_Obj19A_FV : 487|8@0+ (1,0) [0|255] "" Vector__XXX
 SG_ RRL_Obj19A_MAC : 495|24@0+ (1,0) [0|16777215] "" Vector__XXX
 SG_ RRL_Obj19A_Dz : 53|6@1+ (0.25,-5) [-5|10.75] "m" Vector__XXX
 SG_ RRL_Obj19A_Dy : 59|11@1+ (0.125,-128) [-128|127.875] "m" Vector__XXX
 SG_ RRL_Obj19A_Valid : 70|1@1+ (1,0) [0|1] "" Vector__XXX
 SG_ RRL_Obj19A_Vx : 71|12@1+ (0.0625,-128) [-128|127.9375] "m/s" Vector__XXX
 SG_ RRL_Obj19A_Vy : 83|10@1+ (0.125,-64) [-64|63.875] "m/s" Vector__XXX
 SG_ RRL_Obj19A_Ax : 93|10@1+ (0.03125,-16) [-16|15.96875] "m/s^2" Vector__XXX

BO_ 823 RRL_Obj19B: 16 Vector__XXX
 SG_ RRL_Obj19B_CRC : 0|16@1+ (1,0) [0|65535] "" Vector__XXX
 SG_ RRL_Obj19B_MAC : 111|24@0+ (1,0) [0|16777215] "" Vector__XXX
 SG_ RRL_Obj19B_AliveCtr : 16|8@1+ (1,0) [0|254] "" Vector__XXX
 SG_ RRL_Obj19B_BlockCtr : 24|4@1+ (1,0) [0|15] "" Vector__XXX
 SG_ RRL_Obj19B_ProbMob4PlusWhl : 28|6@1+ (2,0) [0|100] "%" Vector__XXX
 SG_ RRL_Obj19B_ProbMob2Whl : 34|6@1+ (2,0) [0|100] "%" Vector__XXX
 SG_ RRL_Obj19B_ProbMobPed : 40|6@1+ (2,0) [0|100] "%" Vector__XXX
 SG_ RRL_Obj19B_Prob4PlusWhlCAR : 46|6@1+ (2,0) [0|100] "%" Vector__XXX
 SG_ RRL_Obj19B_Prob4PlusWhlbHGV : 52|6@1+ (2,0) [0|100] "%" Vector__XXX
 SG_ RRL_Obj19B_ProbGNDReflex : 58|6@1+ (2,0) [0|100] "%" Vector__XXX
 SG_ RRL_Obj19B_ProbStatBarrier : 64|6@1+ (2,0) [0|100] "%" Vector__XXX
 SG_ RRL_Obj19B_ProbStatObst : 70|6@1+ (2,0) [0|100] "%" Vector__XXX
 SG_ RRL_Obj19B_MovingProbability : 76|6@1+ (2,0) [0|100] "%" Vector__XXX
 SG_ RRL_Obj19B_MovingObserved : 82|6@1+ (2,0) [0|100] "%" Vector__XXX
 SG_ RRL_Obj19B_FV : 103|8@0+ (1,0) [0|255] "" Vector__XXX

BO_ 1280 RRR_Hdr: 32 Vector__XXX
 SG_ RRR_Hdr_CRC : 0|16@1+ (1,0) [0|65535] "" Vector__XXX
 SG_ RRR_Hdr_YawAngleUpper : 105|15@1+ (0.00017,-2.78528) [-1.6|1.6] "rad" Vector__XXX
 SG_ RRR_Hdr_YawMountAngle : 120|16@1+ (0.00017,-5.57056) [-3.2|3.2] "rad" Vector__XXX
 SG_ RRR_Hdr_YawAngleLower : 136|15@1+ (0.00017,-2.78528) [-1.6|1.6] "rad" Vector__XXX
 SG_ RRR_Hdr_ElevOutOfSpec : 151|1@1+ (1,0) [0|1] "" Vector__XXX
 SG_ RRR_Hdr_PitchMountAngle : 152|12@1+ (0.00017,-0.34816) [-0.2|0.2] "rad" Vector__XXX
 SG_ RRR_Hdr_PitchAngleLower : 164|12@1+ (0.00017,-0.34816) [-0.2|0.2] "rad" Vector__XXX
 SG_ RRR_Hdr_AliveCtr : 16|8@1+ (1,0) [0|254] "" Vector__XXX
 SG_ RRR_Hdr_PitchAngleUpper : 176|12@1+ (0.00017,-0.34816) [-0.2|0.2] "rad" Vector__XXX
 SG_ RRR_Hdr_RollMountAngle : 188|12@1+ (0.00017,-0.34816) [-0.2|0.2] "rad" Vector__XXX
 SG_ RRR_Hdr_DetectionRange : 200|9@1+ (1,0) [0|511] "m" Vector__XXX
 SG_ RRR_Hdr_SensorState : 209|4@1+ (1,0) [0|15] "" Vector__XXX
 SG_ RRR_Hdr_FV : 231|8@0+ (1,0) [0|255] "" Vector__XXX
 SG_ RRR_Hdr_MAC : 239|24@0+ (1,0) [0|16777215] "" Vector__XXX
 SG_ RRR_Hdr_BlockCtr : 24|4@1+ (1,0) [0|15] "" Vector__XXX
 SG_ RRR_Hdr_ProtocolVersion : 32|16@1+ (1,0) [0|65535] "" Vector__XXX
 SG_ RRR_Hdr_ObjectCount : 48|6@1+ (1,0) [0|63] "" Vector__XXX
 SG_ RRR_Hdr_TimeSyncFailure : 54|1@1+ (1,0) [0|1] "" Vector__XXX
 SG_ RRR_Hdr_ObjectDownSel : 55|1@1+ (1,0) [0|1] "" Vector__XXX
 SG_ RRR_Hdr_MountingPosY : 56|8@1+ (0.01,-1.28) [-1.28|1.27] "m" Vector__XXX
 SG_ RRR_Hdr_AbsRefTime : 64|26@1+ (0.001,0) [0|65536] "s" Vector__XXX
 SG_ RRR_Hdr_MountingPosZ : 90|5@1+ (0.05,0) [0|1.55] "m" Vector__XXX
 SG_ RRR_Hdr_AziOutOfSpec : 95|1@1+ (1,0) [0|1] "" Vector__XXX
 SG_ RRR_Hdr_MountingPosX : 96|9@1+ (0.02,-5.12) [-5.12|5.1] "m" Vector__XXX

BO_ 1296 RRR_Obj00A: 64 Vector__XXX
 SG_ RRR_Obj00A_CRC : 0|16@1+ (1,0) [0|65535] "" Vector__XXX
 SG_ RRR_Obj00A_Ay : 103|9@1+ (0.0625,-16) [-16|15.9375] "m/s^2" Vector__XXX
 SG_ RRR_Obj00A_HeadingYawAngle : 112|9@1+ (0.0175,-4.48) [-3.15|3.15] "rad" Vector__XXX
 SG_ RRR_Obj00A_Length : 121|7@1+ (0.125,0) [0|15.875] "m" Vector__XXX
 SG_ RRR_Obj00A_Width : 128|7@1+ (0.125,0) [0|15.875] "m" Vector__XXX
 SG_ RRR_Obj00A_Height : 135|7@1+ (0.125,0) [0|15.875] "m" Vector__XXX
 SG_ RRR_Obj00A_DxVnce : 142|12@1+ (0.01,0) [0|30] "m^2" Vector__XXX
 SG_ RRR_Obj00A_DyVnce : 154|12@1+ (0.01,0) [0|30] "m^2" Vector__XXX
 SG_ RRR_Obj00A_DzVnce : 166|10@1+ (0.01,0) [0|10] "m^2" Vector__XXX
 SG_ RRR_Obj00A_AliveCtr : 16|8@1+ (1,0) [0|254] "" Vector__XXX
 SG_ RRR_Obj00A_VxVnce : 176|12@1+ (0.01,0) [0|30] "m^2/s^2" Vector__XXX
 SG_ RRR_Obj00A_VyVnce : 188|12@1+ (0.01,0) [0|30] "m^2/s^2" Vector__XXX
 SG_ RRR_Obj00A_AxVnce : 200|12@1+ (0.01,0) [0|30] "m^2/s^4" Vector__XXX
 SG_ RRR_Obj00A_AyVnce : 212|12@1+ (0.01,0) [0|30] "m^2/s^4" Vector__XXX
 SG_ RRR_Obj00A_RefPosIndex : 224|4@1+ (1,0) [0|15] "" Vector__XXX
 SG_ RRR_Obj00A_DxDyCoVnce : 228|12@1+ (0.01,0) [0|30] "m^2" Vector__XXX
 SG_ RRR_Obj00A_DxVxCoVnce : 240|12@1+ (0.01,0) [0|30] "m^2/s" Vector__XXX
 SG_ RRR_Obj00A_BlockCtr : 24|4@1+ (1,0) [0|15] "" Vector__XXX
 SG_ RRR_Obj00A_DyVxCoVnce : 252|12@1+ (0.01,0) [0|30] "m^2/s" Vector__XXX
 SG_ RRR_Obj00A_DxVyCoVnce : 264|12@1+ (0.01,0) [0|30] "m^2/s" Vector__XXX
 SG_ RRR_Obj00A_DyVyCoVnce : 276|12@1+ (0.01,0) [0|30] "m^2/s" Vector__XXX
 SG_ RRR_Obj00A_VxVyCoVnce : 288|12@1+ (0.01,0) [0|30] "m^2/s^2" Vector__XXX
 SG_ RRR_Obj00A_DxAxCoVnce : 300|12@1+ (0.01,0) [0|30] "m^2/s^2" Vector__XXX
 SG_ RRR_Obj00A_DyAxCoVnce : 312|12@1+ (0.01,0) [0|30] "m^2/s^2" Vector__XXX
 SG_ RRR_Obj00A_VxAxCoVnce : 324|12@1+ (0.01,0) [0|30] "m^2/s^3" Vector__XXX
 SG_ RRR_Obj00A_ObjectID : 32|7@1+ (1,0) [0|127] "" Vector__XXX
 SG_ RRR_Obj00A_VyAxCoVnce : 336|12@1+ (0.01,0) [0|30] "m^2/s^3" Vector__XXX
 SG_ RRR_Obj00A_DxAyCoVnce : 348|12@1+ (0.01,0) [0|30] "m^2/s^2" Vector__XXX
 SG_ RRR_Obj00A_DyAyCoVnce : 360|12@1+ (0.01,0) [0|30] "m^2/s^2" Vector__XXX
 SG_ RRR_Obj00A_VxAyCoVnce : 372|12@1+ (0.01,0) [0|30] "m^2/s^3" Vector__XXX
 SG_ RRR_Obj00A_VyAyCoVnce : 384|12@1+ (0.01,0) [0|30] "m^2/s^3" Vector__XXX
 SG_ RRR_Obj00A_AxAyCoVnce : 396|12@1+ (0.01,0) [0|30] "m^2/s^4" Vector__XXX
 SG_ RRR_Obj00A_Measured : 39|1@1+ (1,0) [0|1] "" Vector__XXX
 SG_ RRR_Obj00A_HeadingYawVnce : 408|12@1+ (0.0003,0) [0|1] "rad^2" Vector__XXX
 SG_ RRR_Obj00A_Dx : 40|13@1+ (0.0625,-256) [-256|255.9375] "m" Vector__XXX
 SG_ RRR_Obj00A_LengthVnce : 420|12@1+ (0.01,0) [0|30] "m^2" Vector__XXX
 SG_ RRR_Obj00A_WidthVnce : 432|12@1+ (0.01,0) [0|30] "m^2" Vector__XXX
 SG_ RRR_Obj00A_HeightVnce : 444|12@1+ (0.01,0) [0|30] "m^2" Vector__XXX
 SG_ RRR_Obj00A_ExistProb : 456|6@1+ (2,0) [0|100] "%" Vector__XXX
 SG_ RRR_Obj00A_ProbObstacle : 462|6@1+ (2,0) [0|100] "%" Vector__XXX
 SG_ RRR_Obj00A_ProbNonObstacle : 468|6@1+ (2,0) [0|100] "%" Vector__XXX
 SG_ RRR_Obj00A_ProbMobileObst : 474|6@1+ (2,0) [0|100] "%" Vector__XXX
 SG_ RRR_Obj00A_FV : 487|8@0+ (1,0) [0|255] "" Vector__XXX
 SG_ RRR_Obj00A_MAC : 495|24@0+ (1,0) [0|16777215] "" Vector__XXX
 SG_ RRR_Obj00A_Dz : 53|6@1+ (0.25,-5) [-5|10.75] "m" Vector__XXX
 SG_ RRR_Obj00A_Dy : 59|11@1+ (0.125,-128) [-128|127.875] "m" Vector__XXX
 SG_ RRR_Obj00A_Valid : 70|1@1+ (1,0) [0|1] "" Vector__XXX
 SG_ RRR_Obj00A_Vx : 71|12@1+ (0.0625,-128) [-128|127.9375] "m/s" Vector__XXX
 SG_ RRR_Obj00A_Vy : 83|10@1+ (0.125,-64) [-64|63.875] "m/s" Vector__XXX
 SG_ RRR_Obj00A_Ax : 93|10@1+ (0.03125,-16) [-16|15.96875] "m/s^2" Vector__XXX

BO_ 1297 RRR_Obj00B: 16 Vector__XXX
 SG_ RRR_Obj00B_CRC : 0|16@1+ (1,0) [0|65535] "" Vector__XXX
 SG_ RRR_Obj00B_MAC : 111|24@0+ (1,0) [0|16777215] "" Vector__XXX
 SG_ RRR_Obj00B_AliveCtr : 16|8@1+ (1,0) [0|254] "" Vector__XXX
 SG_ RRR_Obj00B_BlockCtr : 24|4@1+ (1,0) [0|15] "" Vector__XXX
 SG_ RRR_Obj00B_ProbMob4PlusWhl : 28|6@1+ (2,0) [0|100] "%" Vector__XXX
 SG_ RRR_Obj00B_ProbMob2Whl : 34|6@1+ (2,0) [0|100] "%" Vector__XXX
 SG_ RRR_Obj00B_ProbMobPed : 40|6@1+ (2,0) [0|100] "%" Vector__XXX
 SG_ RRR_Obj00B_Prob4PlusWhlCAR : 46|6@1+ (2,0) [0|100] "%" Vector__XXX
 SG_ RRR_Obj00B_Prob4PlusWhlbHGV : 52|6@1+ (2,0) [0|100] "%" Vector__XXX
 SG_ RRR_Obj00B_ProbGNDReflex : 58|6@1+ (2,0) [0|100] "%" Vector__XXX
 SG_ RRR_Obj00B_ProbStatBarrier : 64|6@1+ (2,0) [0|100] "%" Vector__XXX
 SG_ RRR_Obj00B_ProbStatObst : 70|6@1+ (2,0) [0|100] "%" Vector__XXX
 SG_ RRR_Obj00B_MovingProbability : 76|6@1+ (2,0) [0|100] "%" Vector__XXX
 SG_ RRR_Obj00B_MovingObserved : 82|6@1+ (2,0) [0|100] "%" Vector__XXX
 SG_ RRR_Obj00B_FV : 103|8@0+ (1,0) [0|255] "" Vector__XXX

BO_ 1298 RRR_Obj01A: 64 Vector__XXX
 SG_ RRR_Obj01A_CRC : 0|16@1+ (1,0) [0|65535] "" Vector__XXX
 SG_ RRR_Obj01A_Ay : 103|9@1+ (0.0625,-16) [-16|15.9375] "m/s^2" Vector__XXX
 SG_ RRR_Obj01A_HeadingYawAngle : 112|9@1+ (0.0175,-4.48) [-3.15|3.15] "rad" Vector__XXX
 SG_ RRR_Obj01A_Length : 121|7@1+ (0.125,0) [0|15.875] "m" Vector__XXX
 SG_ RRR_Obj01A_Width : 128|7@1+ (0.125,0) [0|15.875] "m" Vector__XXX
 SG_ RRR_Obj01A_Height : 135|7@1+ (0.125,0) [0|15.875] "m" Vector__XXX
 SG_ RRR_Obj01A_DxVnce : 142|12@1+ (0.01,0) [0|30] "m^2" Vector__XXX
 SG_ RRR_Obj01A_DyVnce : 154|12@1+ (0.01,0) [0|30] "m^2" Vector__XXX
 SG_ RRR_Obj01A_DzVnce : 166|10@1+ (0.01,0) [0|10] "m^2" Vector__XXX
 SG_ RRR_Obj01A_AliveCtr : 16|8@1+ (1,0) [0|254] "" Vector__XXX
 SG_ RRR_Obj01A_VxVnce : 176|12@1+ (0.01,0) [0|30] "m^2/s^2" Vector__XXX
 SG_ RRR_Obj01A_VyVnce : 188|12@1+ (0.01,0) [0|30] "m^2/s^2" Vector__XXX
 SG_ RRR_Obj01A_AxVnce : 200|12@1+ (0.01,0) [0|30] "m^2/s^4" Vector__XXX
 SG_ RRR_Obj01A_AyVnce : 212|12@1+ (0.01,0) [0|30] "m^2/s^4" Vector__XXX
 SG_ RRR_Obj01A_RefPosIndex : 224|4@1+ (1,0) [0|15] "" Vector__XXX
 SG_ RRR_Obj01A_DxDyCoVnce : 228|12@1+ (0.01,0) [0|30] "m^2" Vector__XXX
 SG_ RRR_Obj01A_DxVxCoVnce : 240|12@1+ (0.01,0) [0|30] "m^2/s" Vector__XXX
 SG_ RRR_Obj01A_BlockCtr : 24|4@1+ (1,0) [0|15] "" Vector__XXX
 SG_ RRR_Obj01A_DyVxCoVnce : 252|12@1+ (0.01,0) [0|30] "m^2/s" Vector__XXX
 SG_ RRR_Obj01A_DxVyCoVnce : 264|12@1+ (0.01,0) [0|30] "m^2/s" Vector__XXX
 SG_ RRR_Obj01A_DyVyCoVnce : 276|12@1+ (0.01,0) [0|30] "m^2/s" Vector__XXX
 SG_ RRR_Obj01A_VxVyCoVnce : 288|12@1+ (0.01,0) [0|30] "m^2/s^2" Vector__XXX
 SG_ RRR_Obj01A_DxAxCoVnce : 300|12@1+ (0.01,0) [0|30] "m^2/s^2" Vector__XXX
 SG_ RRR_Obj01A_DyAxCoVnce : 312|12@1+ (0.01,0) [0|30] "m^2/s^2" Vector__XXX
 SG_ RRR_Obj01A_VxAxCoVnce : 324|12@1+ (0.01,0) [0|30] "m^2/s^3" Vector__XXX
 SG_ RRR_Obj01A_ObjectID : 32|7@1+ (1,0) [0|127] "" Vector__XXX
 SG_ RRR_Obj01A_VyAxCoVnce : 336|12@1+ (0.01,0) [0|30] "m^2/s^3" Vector__XXX
 SG_ RRR_Obj01A_DxAyCoVnce : 348|12@1+ (0.01,0) [0|30] "m^2/s^2" Vector__XXX
 SG_ RRR_Obj01A_DyAyCoVnce : 360|12@1+ (0.01,0) [0|30] "m^2/s^2" Vector__XXX
 SG_ RRR_Obj01A_VxAyCoVnce : 372|12@1+ (0.01,0) [0|30] "m^2/s^3" Vector__XXX
 SG_ RRR_Obj01A_VyAyCoVnce : 384|12@1+ (0.01,0) [0|30] "m^2/s^3" Vector__XXX
 SG_ RRR_Obj01A_AxAyCoVnce : 396|12@1+ (0.01,0) [0|30] "m^2/s^4" Vector__XXX
 SG_ RRR_Obj01A_Measured : 39|1@1+ (1,0) [0|1] "" Vector__XXX
 SG_ RRR_Obj01A_HeadingYawVnce : 408|12@1+ (0.0003,0) [0|1] "rad^2" Vector__XXX
 SG_ RRR_Obj01A_Dx : 40|13@1+ (0.0625,-256) [-256|255.9375] "m" Vector__XXX
 SG_ RRR_Obj01A_LengthVnce : 420|12@1+ (0.01,0) [0|30] "m^2" Vector__XXX
 SG_ RRR_Obj01A_WidthVnce : 432|12@1+ (0.01,0) [0|30] "m^2" Vector__XXX
 SG_ RRR_Obj01A_HeightVnce : 444|12@1+ (0.01,0) [0|30] "m^2" Vector__XXX
 SG_ RRR_Obj01A_ExistProb : 456|6@1+ (2,0) [0|100] "%" Vector__XXX
 SG_ RRR_Obj01A_ProbObstacle : 462|6@1+ (2,0) [0|100] "%" Vector__XXX
 SG_ RRR_Obj01A_ProbNonObstacle : 468|6@1+ (2,0) [0|100] "%" Vector__XXX
 SG_ RRR_Obj01A_ProbMobileObst : 474|6@1+ (2,0) [0|100] "%" Vector__XXX
 SG_ RRR_Obj01A_FV : 487|8@0+ (1,0) [0|255] "" Vector__XXX
 SG_ RRR_Obj01A_MAC : 495|24@0+ (1,0) [0|16777215] "" Vector__XXX
 SG_ RRR_Obj01A_Dz : 53|6@1+ (0.25,-5) [-5|10.75] "m" Vector__XXX
 SG_ RRR_Obj01A_Dy : 59|11@1+ (0.125,-128) [-128|127.875] "m" Vector__XXX
 SG_ RRR_Obj01A_Valid : 70|1@1+ (1,0) [0|1] "" Vector__XXX
 SG_ RRR_Obj01A_Vx : 71|12@1+ (0.0625,-128) [-128|127.9375] "m/s" Vector__XXX
 SG_ RRR_Obj01A_Vy : 83|10@1+ (0.125,-64) [-64|63.875] "m/s" Vector__XXX
 SG_ RRR_Obj01A_Ax : 93|10@1+ (0.03125,-16) [-16|15.96875] "m/s^2" Vector__XXX

BO_ 1299 RRR_Obj01B: 16 Vector__XXX
 SG_ RRR_Obj01B_CRC : 0|16@1+ (1,0) [0|65535] "" Vector__XXX
 SG_ RRR_Obj01B_MAC : 111|24@0+ (1,0) [0|16777215] "" Vector__XXX
 SG_ RRR_Obj01B_AliveCtr : 16|8@1+ (1,0) [0|254] "" Vector__XXX
 SG_ RRR_Obj01B_BlockCtr : 24|4@1+ (1,0) [0|15] "" Vector__XXX
 SG_ RRR_Obj01B_ProbMob4PlusWhl : 28|6@1+ (2,0) [0|100] "%" Vector__XXX
 SG_ RRR_Obj01B_ProbMob2Whl : 34|6@1+ (2,0) [0|100] "%" Vector__XXX
 SG_ RRR_Obj01B_ProbMobPed : 40|6@1+ (2,0) [0|100] "%" Vector__XXX
 SG_ RRR_Obj01B_Prob4PlusWhlCAR : 46|6@1+ (2,0) [0|100] "%" Vector__XXX
 SG_ RRR_Obj01B_Prob4PlusWhlbHGV : 52|6@1+ (2,0) [0|100] "%" Vector__XXX
 SG_ RRR_Obj01B_ProbGNDReflex : 58|6@1+ (2,0) [0|100] "%" Vector__XXX
 SG_ RRR_Obj01B_ProbStatBarrier : 64|6@1+ (2,0) [0|100] "%" Vector__XXX
 SG_ RRR_Obj01B_ProbStatObst : 70|6@1+ (2,0) [0|100] "%" Vector__XXX
 SG_ RRR_Obj01B_MovingProbability : 76|6@1+ (2,0) [0|100] "%" Vector__XXX
 SG_ RRR_Obj01B_MovingObserved : 82|6@1+ (2,0) [0|100] "%" Vector__XXX
 SG_ RRR_Obj01B_FV : 103|8@0+ (1,0) [0|255] "" Vector__XXX

BO_ 1300 RRR_Obj02A: 64 Vector__XXX
 SG_ RRR_Obj02A_CRC : 0|16@1+ (1,0) [0|65535] "" Vector__XXX
 SG_ RRR_Obj02A_Ay : 103|9@1+ (0.0625,-16) [-16|15.9375] "m/s^2" Vector__XXX
 SG_ RRR_Obj02A_HeadingYawAngle : 112|9@1+ (0.0175,-4.48) [-3.15|3.15] "rad" Vector__XXX
 SG_ RRR_Obj02A_Length : 121|7@1+ (0.125,0) [0|15.875] "m" Vector__XXX
 SG_ RRR_Obj02A_Width : 128|7@1+ (0.125,0) [0|15.875] "m" Vector__XXX
 SG_ RRR_Obj02A_Height : 135|7@1+ (0.125,0) [0|15.875] "m" Vector__XXX
 SG_ RRR_Obj02A_DxVnce : 142|12@1+ (0.01,0) [0|30] "m^2" Vector__XXX
 SG_ RRR_Obj02A_DyVnce : 154|12@1+ (0.01,0) [0|30] "m^2" Vector__XXX
 SG_ RRR_Obj02A_DzVnce : 166|10@1+ (0.01,0) [0|10] "m^2" Vector__XXX
 SG_ RRR_Obj02A_AliveCtr : 16|8@1+ (1,0) [0|254] "" Vector__XXX
 SG_ RRR_Obj02A_VxVnce : 176|12@1+ (0.01,0) [0|30] "m^2/s^2" Vector__XXX
 SG_ RRR_Obj02A_VyVnce : 188|12@1+ (0.01,0) [0|30] "m^2/s^2" Vector__XXX
 SG_ RRR_Obj02A_AxVnce : 200|12@1+ (0.01,0) [0|30] "m^2/s^4" Vector__XXX
 SG_ RRR_Obj02A_AyVnce : 212|12@1+ (0.01,0) [0|30] "m^2/s^4" Vector__XXX
 SG_ RRR_Obj02A_RefPosIndex : 224|4@1+ (1,0) [0|15] "" Vector__XXX
 SG_ RRR_Obj02A_DxDyCoVnce : 228|12@1+ (0.01,0) [0|30] "m^2" Vector__XXX
 SG_ RRR_Obj02A_DxVxCoVnce : 240|12@1+ (0.01,0) [0|30] "m^2/s" Vector__XXX
 SG_ RRR_Obj02A_BlockCtr : 24|4@1+ (1,0) [0|15] "" Vector__XXX
 SG_ RRR_Obj02A_DyVxCoVnce : 252|12@1+ (0.01,0) [0|30] "m^2/s" Vector__XXX
 SG_ RRR_Obj02A_DxVyCoVnce : 264|12@1+ (0.01,0) [0|30] "m^2/s" Vector__XXX
 SG_ RRR_Obj02A_DyVyCoVnce : 276|12@1+ (0.01,0) [0|30] "m^2/s" Vector__XXX
 SG_ RRR_Obj02A_VxVyCoVnce : 288|12@1+ (0.01,0) [0|30] "m^2/s^2" Vector__XXX
 SG_ RRR_Obj02A_DxAxCoVnce : 300|12@1+ (0.01,0) [0|30] "m^2/s^2" Vector__XXX
 SG_ RRR_Obj02A_DyAxCoVnce : 312|12@1+ (0.01,0) [0|30] "m^2/s^2" Vector__XXX
 SG_ RRR_Obj02A_VxAxCoVnce : 324|12@1+ (0.01,0) [0|30] "m^2/s^3" Vector__XXX
 SG_ RRR_Obj02A_ObjectID : 32|7@1+ (1,0) [0|127] "" Vector__XXX
 SG_ RRR_Obj02A_VyAxCoVnce : 336|12@1+ (0.01,0) [0|30] "m^2/s^3" Vector__XXX
 SG_ RRR_Obj02A_DxAyCoVnce : 348|12@1+ (0.01,0) [0|30] "m^2/s^2" Vector__XXX
 SG_ RRR_Obj02A_DyAyCoVnce : 360|12@1+ (0.01,0) [0|30] "m^2/s^2" Vector__XXX
 SG_ RRR_Obj02A_VxAyCoVnce : 372|12@1+ (0.01,0) [0|30] "m^2/s^3" Vector__XXX
 SG_ RRR_Obj02A_VyAyCoVnce : 384|12@1+ (0.01,0) [0|30] "m^2/s^3" Vector__XXX
 SG_ RRR_Obj02A_AxAyCoVnce : 396|12@1+ (0.01,0) [0|30] "m^2/s^4" Vector__XXX
 SG_ RRR_Obj02A_Measured : 39|1@1+ (1,0) [0|1] "" Vector__XXX
 SG_ RRR_Obj02A_HeadingYawVnce : 408|12@1+ (0.0003,0) [0|1] "rad^2" Vector__XXX
 SG_ RRR_Obj02A_Dx : 40|13@1+ (0.0625,-256) [-256|255.9375] "m" Vector__XXX
 SG_ RRR_Obj02A_LengthVnce : 420|12@1+ (0.01,0) [0|30] "m^2" Vector__XXX
 SG_ RRR_Obj02A_WidthVnce : 432|12@1+ (0.01,0) [0|30] "m^2" Vector__XXX
 SG_ RRR_Obj02A_HeightVnce : 444|12@1+ (0.01,0) [0|30] "m^2" Vector__XXX
 SG_ RRR_Obj02A_ExistProb : 456|6@1+ (2,0) [0|100] "%" Vector__XXX
 SG_ RRR_Obj02A_ProbObstacle : 462|6@1+ (2,0) [0|100] "%" Vector__XXX
 SG_ RRR_Obj02A_ProbNonObstacle : 468|6@1+ (2,0) [0|100] "%" Vector__XXX
 SG_ RRR_Obj02A_ProbMobileObst : 474|6@1+ (2,0) [0|100] "%" Vector__XXX
 SG_ RRR_Obj02A_FV : 487|8@0+ (1,0) [0|255] "" Vector__XXX
 SG_ RRR_Obj02A_MAC : 495|24@0+ (1,0) [0|16777215] "" Vector__XXX
 SG_ RRR_Obj02A_Dz : 53|6@1+ (0.25,-5) [-5|10.75] "m" Vector__XXX
 SG_ RRR_Obj02A_Dy : 59|11@1+ (0.125,-128) [-128|127.875] "m" Vector__XXX
 SG_ RRR_Obj02A_Valid : 70|1@1+ (1,0) [0|1] "" Vector__XXX
 SG_ RRR_Obj02A_Vx : 71|12@1+ (0.0625,-128) [-128|127.9375] "m/s" Vector__XXX
 SG_ RRR_Obj02A_Vy : 83|10@1+ (0.125,-64) [-64|63.875] "m/s" Vector__XXX
 SG_ RRR_Obj02A_Ax : 93|10@1+ (0.03125,-16) [-16|15.96875] "m/s^2" Vector__XXX

BO_ 1301 RRR_Obj02B: 16 Vector__XXX
 SG_ RRR_Obj02B_CRC : 0|16@1+ (1,0) [0|65535] "" Vector__XXX
 SG_ RRR_Obj02B_MAC : 111|24@0+ (1,0) [0|16777215] "" Vector__XXX
 SG_ RRR_Obj02B_AliveCtr : 16|8@1+ (1,0) [0|254] "" Vector__XXX
 SG_ RRR_Obj02B_BlockCtr : 24|4@1+ (1,0) [0|15] "" Vector__XXX
 SG_ RRR_Obj02B_ProbMob4PlusWhl : 28|6@1+ (2,0) [0|100] "%" Vector__XXX
 SG_ RRR_Obj02B_ProbMob2Whl : 34|6@1+ (2,0) [0|100] "%" Vector__XXX
 SG_ RRR_Obj02B_ProbMobPed : 40|6@1+ (2,0) [0|100] "%" Vector__XXX
 SG_ RRR_Obj02B_Prob4PlusWhlCAR : 46|6@1+ (2,0) [0|100] "%" Vector__XXX
 SG_ RRR_Obj02B_Prob4PlusWhlbHGV : 52|6@1+ (2,0) [0|100] "%" Vector__XXX
 SG_ RRR_Obj02B_ProbGNDReflex : 58|6@1+ (2,0) [0|100] "%" Vector__XXX
 SG_ RRR_Obj02B_ProbStatBarrier : 64|6@1+ (2,0) [0|100] "%" Vector__XXX
 SG_ RRR_Obj02B_ProbStatObst : 70|6@1+ (2,0) [0|100] "%" Vector__XXX
 SG_ RRR_Obj02B_MovingProbability : 76|6@1+ (2,0) [0|100] "%" Vector__XXX
 SG_ RRR_Obj02B_MovingObserved : 82|6@1+ (2,0) [0|100] "%" Vector__XXX
 SG_ RRR_Obj02B_FV : 103|8@0+ (1,0) [0|255] "" Vector__XXX

BO_ 1302 RRR_Obj03A: 64 Vector__XXX
 SG_ RRR_Obj03A_CRC : 0|16@1+ (1,0) [0|65535] "" Vector__XXX
 SG_ RRR_Obj03A_Ay : 103|9@1+ (0.0625,-16) [-16|15.9375] "m/s^2" Vector__XXX
 SG_ RRR_Obj03A_HeadingYawAngle : 112|9@1+ (0.0175,-4.48) [-3.15|3.15] "rad" Vector__XXX
 SG_ RRR_Obj03A_Length : 121|7@1+ (0.125,0) [0|15.875] "m" Vector__XXX
 SG_ RRR_Obj03A_Width : 128|7@1+ (0.125,0) [0|15.875] "m" Vector__XXX
 SG_ RRR_Obj03A_Height : 135|7@1+ (0.125,0) [0|15.875] "m" Vector__XXX
 SG_ RRR_Obj03A_DxVnce : 142|12@1+ (0.01,0) [0|30] "m^2" Vector__XXX
 SG_ RRR_Obj03A_DyVnce : 154|12@1+ (0.01,0) [0|30] "m^2" Vector__XXX
 SG_ RRR_Obj03A_DzVnce : 166|10@1+ (0.01,0) [0|10] "m^2" Vector__XXX
 SG_ RRR_Obj03A_AliveCtr : 16|8@1+ (1,0) [0|254] "" Vector__XXX
 SG_ RRR_Obj03A_VxVnce : 176|12@1+ (0.01,0) [0|30] "m^2/s^2" Vector__XXX
 SG_ RRR_Obj03A_VyVnce : 188|12@1+ (0.01,0) [0|30] "m^2/s^2" Vector__XXX
 SG_ RRR_Obj03A_AxVnce : 200|12@1+ (0.01,0) [0|30] "m^2/s^4" Vector__XXX
 SG_ RRR_Obj03A_AyVnce : 212|12@1+ (0.01,0) [0|30] "m^2/s^4" Vector__XXX
 SG_ RRR_Obj03A_RefPosIndex : 224|4@1+ (1,0) [0|15] "" Vector__XXX
 SG_ RRR_Obj03A_DxDyCoVnce : 228|12@1+ (0.01,0) [0|30] "m^2" Vector__XXX
 SG_ RRR_Obj03A_DxVxCoVnce : 240|12@1+ (0.01,0) [0|30] "m^2/s" Vector__XXX
 SG_ RRR_Obj03A_BlockCtr : 24|4@1+ (1,0) [0|15] "" Vector__XXX
 SG_ RRR_Obj03A_DyVxCoVnce : 252|12@1+ (0.01,0) [0|30] "m^2/s" Vector__XXX
 SG_ RRR_Obj03A_DxVyCoVnce : 264|12@1+ (0.01,0) [0|30] "m^2/s" Vector__XXX
 SG_ RRR_Obj03A_DyVyCoVnce : 276|12@1+ (0.01,0) [0|30] "m^2/s" Vector__XXX
 SG_ RRR_Obj03A_VxVyCoVnce : 288|12@1+ (0.01,0) [0|30] "m^2/s^2" Vector__XXX
 SG_ RRR_Obj03A_DxAxCoVnce : 300|12@1+ (0.01,0) [0|30] "m^2/s^2" Vector__XXX
 SG_ RRR_Obj03A_DyAxCoVnce : 312|12@1+ (0.01,0) [0|30] "m^2/s^2" Vector__XXX
 SG_ RRR_Obj03A_VxAxCoVnce : 324|12@1+ (0.01,0) [0|30] "m^2/s^3" Vector__XXX
 SG_ RRR_Obj03A_ObjectID : 32|7@1+ (1,0) [0|127] "" Vector__XXX
 SG_ RRR_Obj03A_VyAxCoVnce : 336|12@1+ (0.01,0) [0|30] "m^2/s^3" Vector__XXX
 SG_ RRR_Obj03A_DxAyCoVnce : 348|12@1+ (0.01,0) [0|30] "m^2/s^2" Vector__XXX
 SG_ RRR_Obj03A_DyAyCoVnce : 360|12@1+ (0.01,0) [0|30] "m^2/s^2" Vector__XXX
 SG_ RRR_Obj03A_VxAyCoVnce : 372|12@1+ (0.01,0) [0|30] "m^2/s^3" Vector__XXX
 SG_ RRR_Obj03A_VyAyCoVnce : 384|12@1+ (0.01,0) [0|30] "m^2/s^3" Vector__XXX
 SG_ RRR_Obj03A_AxAyCoVnce : 396|12@1+ (0.01,0) [0|30] "m^2/s^4" Vector__XXX
 SG_ RRR_Obj03A_Measured : 39|1@1+ (1,0) [0|1] "" Vector__XXX
 SG_ RRR_Obj03A_HeadingYawVnce : 408|12@1+ (0.0003,0) [0|1] "rad^2" Vector__XXX
 SG_ RRR_Obj03A_Dx : 40|13@1+ (0.0625,-256) [-256|255.9375] "m" Vector__XXX
 SG_ RRR_Obj03A_LengthVnce : 420|12@1+ (0.01,0) [0|30] "m^2" Vector__XXX
 SG_ RRR_Obj03A_WidthVnce : 432|12@1+ (0.01,0) [0|30] "m^2" Vector__XXX
 SG_ RRR_Obj03A_HeightVnce : 444|12@1+ (0.01,0) [0|30] "m^2" Vector__XXX
 SG_ RRR_Obj03A_ExistProb : 456|6@1+ (2,0) [0|100] "%" Vector__XXX
 SG_ RRR_Obj03A_ProbObstacle : 462|6@1+ (2,0) [0|100] "%" Vector__XXX
 SG_ RRR_Obj03A_ProbNonObstacle : 468|6@1+ (2,0) [0|100] "%" Vector__XXX
 SG_ RRR_Obj03A_ProbMobileObst : 474|6@1+ (2,0) [0|100] "%" Vector__XXX
 SG_ RRR_Obj03A_FV : 487|8@0+ (1,0) [0|255] "" Vector__XXX
 SG_ RRR_Obj03A_MAC : 495|24@0+ (1,0) [0|16777215] "" Vector__XXX
 SG_ RRR_Obj03A_Dz : 53|6@1+ (0.25,-5) [-5|10.75] "m" Vector__XXX
 SG_ RRR_Obj03A_Dy : 59|11@1+ (0.125,-128) [-128|127.875] "m" Vector__XXX
 SG_ RRR_Obj03A_Valid : 70|1@1+ (1,0) [0|1] "" Vector__XXX
 SG_ RRR_Obj03A_Vx : 71|12@1+ (0.0625,-128) [-128|127.9375] "m/s" Vector__XXX
 SG_ RRR_Obj03A_Vy : 83|10@1+ (0.125,-64) [-64|63.875] "m/s" Vector__XXX
 SG_ RRR_Obj03A_Ax : 93|10@1+ (0.03125,-16) [-16|15.96875] "m/s^2" Vector__XXX

BO_ 1303 RRR_Obj03B: 16 Vector__XXX
 SG_ RRR_Obj03B_CRC : 0|16@1+ (1,0) [0|65535] "" Vector__XXX
 SG_ RRR_Obj03B_MAC : 111|24@0+ (1,0) [0|16777215] "" Vector__XXX
 SG_ RRR_Obj03B_AliveCtr : 16|8@1+ (1,0) [0|254] "" Vector__XXX
 SG_ RRR_Obj03B_BlockCtr : 24|4@1+ (1,0) [0|15] "" Vector__XXX
 SG_ RRR_Obj03B_ProbMob4PlusWhl : 28|6@1+ (2,0) [0|100] "%" Vector__XXX
 SG_ RRR_Obj03B_ProbMob2Whl : 34|6@1+ (2,0) [0|100] "%" Vector__XXX
 SG_ RRR_Obj03B_ProbMobPed : 40|6@1+ (2,0) [0|100] "%" Vector__XXX
 SG_ RRR_Obj03B_Prob4PlusWhlCAR : 46|6@1+ (2,0) [0|100] "%" Vector__XXX
 SG_ RRR_Obj03B_Prob4PlusWhlbHGV : 52|6@1+ (2,0) [0|100] "%" Vector__XXX
 SG_ RRR_Obj03B_ProbGNDReflex : 58|6@1+ (2,0) [0|100] "%" Vector__XXX
 SG_ RRR_Obj03B_ProbStatBarrier : 64|6@1+ (2,0) [0|100] "%" Vector__XXX
 SG_ RRR_Obj03B_ProbStatObst : 70|6@1+ (2,0) [0|100] "%" Vector__XXX
 SG_ RRR_Obj03B_MovingProbability : 76|6@1+ (2,0) [0|100] "%" Vector__XXX
 SG_ RRR_Obj03B_MovingObserved : 82|6@1+ (2,0) [0|100] "%" Vector__XXX
 SG_ RRR_Obj03B_FV : 103|8@0+ (1,0) [0|255] "" Vector__XXX

BO_ 1304 RRR_Obj04A: 64 Vector__XXX
 SG_ RRR_Obj04A_CRC : 0|16@1+ (1,0) [0|65535] "" Vector__XXX
 SG_ RRR_Obj04A_Ay : 103|9@1+ (0.0625,-16) [-16|15.9375] "m/s^2" Vector__XXX
 SG_ RRR_Obj04A_HeadingYawAngle : 112|9@1+ (0.0175,-4.48) [-3.15|3.15] "rad" Vector__XXX
 SG_ RRR_Obj04A_Length : 121|7@1+ (0.125,0) [0|15.875] "m" Vector__XXX
 SG_ RRR_Obj04A_Width : 128|7@1+ (0.125,0) [0|15.875] "m" Vector__XXX
 SG_ RRR_Obj04A_Height : 135|7@1+ (0.125,0) [0|15.875] "m" Vector__XXX
 SG_ RRR_Obj04A_DxVnce : 142|12@1+ (0.01,0) [0|30] "m^2" Vector__XXX
 SG_ RRR_Obj04A_DyVnce : 154|12@1+ (0.01,0) [0|30] "m^2" Vector__XXX
 SG_ RRR_Obj04A_DzVnce : 166|10@1+ (0.01,0) [0|10] "m^2" Vector__XXX
 SG_ RRR_Obj04A_AliveCtr : 16|8@1+ (1,0) [0|254] "" Vector__XXX
 SG_ RRR_Obj04A_VxVnce : 176|12@1+ (0.01,0) [0|30] "m^2/s^2" Vector__XXX
 SG_ RRR_Obj04A_VyVnce : 188|12@1+ (0.01,0) [0|30] "m^2/s^2" Vector__XXX
 SG_ RRR_Obj04A_AxVnce : 200|12@1+ (0.01,0) [0|30] "m^2/s^4" Vector__XXX
 SG_ RRR_Obj04A_AyVnce : 212|12@1+ (0.01,0) [0|30] "m^2/s^4" Vector__XXX
 SG_ RRR_Obj04A_RefPosIndex : 224|4@1+ (1,0) [0|15] "" Vector__XXX
 SG_ RRR_Obj04A_DxDyCoVnce : 228|12@1+ (0.01,0) [0|30] "m^2" Vector__XXX
 SG_ RRR_Obj04A_DxVxCoVnce : 240|12@1+ (0.01,0) [0|30] "m^2/s" Vector__XXX
 SG_ RRR_Obj04A_BlockCtr : 24|4@1+ (1,0) [0|15] "" Vector__XXX
 SG_ RRR_Obj04A_DyVxCoVnce : 252|12@1+ (0.01,0) [0|30] "m^2/s" Vector__XXX
 SG_ RRR_Obj04A_DxVyCoVnce : 264|12@1+ (0.01,0) [0|30] "m^2/s" Vector__XXX
 SG_ RRR_Obj04A_DyVyCoVnce : 276|12@1+ (0.01,0) [0|30] "m^2/s" Vector__XXX
 SG_ RRR_Obj04A_VxVyCoVnce : 288|12@1+ (0.01,0) [0|30] "m^2/s^2" Vector__XXX
 SG_ RRR_Obj04A_DxAxCoVnce : 300|12@1+ (0.01,0) [0|30] "m^2/s^2" Vector__XXX
 SG_ RRR_Obj04A_DyAxCoVnce : 312|12@1+ (0.01,0) [0|30] "m^2/s^2" Vector__XXX
 SG_ RRR_Obj04A_VxAxCoVnce : 324|12@1+ (0.01,0) [0|30] "m^2/s^3" Vector__XXX
 SG_ RRR_Obj04A_ObjectID : 32|7@1+ (1,0) [0|127] "" Vector__XXX
 SG_ RRR_Obj04A_VyAxCoVnce : 336|12@1+ (0.01,0) [0|30] "m^2/s^3" Vector__XXX
 SG_ RRR_Obj04A_DxAyCoVnce : 348|12@1+ (0.01,0) [0|30] "m^2/s^2" Vector__XXX
 SG_ RRR_Obj04A_DyAyCoVnce : 360|12@1+ (0.01,0) [0|30] "m^2/s^2" Vector__XXX
 SG_ RRR_Obj04A_VxAyCoVnce : 372|12@1+ (0.01,0) [0|30] "m^2/s^3" Vector__XXX
 SG_ RRR_Obj04A_VyAyCoVnce : 384|12@1+ (0.01,0) [0|30] "m^2/s^3" Vector__XXX
 SG_ RRR_Obj04A_AxAyCoVnce : 396|12@1+ (0.01,0) [0|30] "m^2/s^4" Vector__XXX
 SG_ RRR_Obj04A_Measured : 39|1@1+ (1,0) [0|1] "" Vector__XXX
 SG_ RRR_Obj04A_HeadingYawVnce : 408|12@1+ (0.0003,0) [0|1] "rad^2" Vector__XXX
 SG_ RRR_Obj04A_Dx : 40|13@1+ (0.0625,-256) [-256|255.9375] "m" Vector__XXX
 SG_ RRR_Obj04A_LengthVnce : 420|12@1+ (0.01,0) [0|30] "m^2" Vector__XXX
 SG_ RRR_Obj04A_WidthVnce : 432|12@1+ (0.01,0) [0|30] "m^2" Vector__XXX
 SG_ RRR_Obj04A_HeightVnce : 444|12@1+ (0.01,0) [0|30] "m^2" Vector__XXX
 SG_ RRR_Obj04A_ExistProb : 456|6@1+ (2,0) [0|100] "%" Vector__XXX
 SG_ RRR_Obj04A_ProbObstacle : 462|6@1+ (2,0) [0|100] "%" Vector__XXX
 SG_ RRR_Obj04A_ProbNonObstacle : 468|6@1+ (2,0) [0|100] "%" Vector__XXX
 SG_ RRR_Obj04A_ProbMobileObst : 474|6@1+ (2,0) [0|100] "%" Vector__XXX
 SG_ RRR_Obj04A_FV : 487|8@0+ (1,0) [0|255] "" Vector__XXX
 SG_ RRR_Obj04A_MAC : 495|24@0+ (1,0) [0|16777215] "" Vector__XXX
 SG_ RRR_Obj04A_Dz : 53|6@1+ (0.25,-5) [-5|10.75] "m" Vector__XXX
 SG_ RRR_Obj04A_Dy : 59|11@1+ (0.125,-128) [-128|127.875] "m" Vector__XXX
 SG_ RRR_Obj04A_Valid : 70|1@1+ (1,0) [0|1] "" Vector__XXX
 SG_ RRR_Obj04A_Vx : 71|12@1+ (0.0625,-128) [-128|127.9375] "m/s" Vector__XXX
 SG_ RRR_Obj04A_Vy : 83|10@1+ (0.125,-64) [-64|63.875] "m/s" Vector__XXX
 SG_ RRR_Obj04A_Ax : 93|10@1+ (0.03125,-16) [-16|15.96875] "m/s^2" Vector__XXX

BO_ 1305 RRR_Obj04B: 16 Vector__XXX
 SG_ RRR_Obj04B_CRC : 0|16@1+ (1,0) [0|65535] "" Vector__XXX
 SG_ RRR_Obj04B_MAC : 111|24@0+ (1,0) [0|16777215] "" Vector__XXX
 SG_ RRR_Obj04B_AliveCtr : 16|8@1+ (1,0) [0|254] "" Vector__XXX
 SG_ RRR_Obj04B_BlockCtr : 24|4@1+ (1,0) [0|15] "" Vector__XXX
 SG_ RRR_Obj04B_ProbMob4PlusWhl : 28|6@1+ (2,0) [0|100] "%" Vector__XXX
 SG_ RRR_Obj04B_ProbMob2Whl : 34|6@1+ (2,0) [0|100] "%" Vector__XXX
 SG_ RRR_Obj04B_ProbMobPed : 40|6@1+ (2,0) [0|100] "%" Vector__XXX
 SG_ RRR_Obj04B_Prob4PlusWhlCAR : 46|6@1+ (2,0) [0|100] "%" Vector__XXX
 SG_ RRR_Obj04B_Prob4PlusWhlbHGV : 52|6@1+ (2,0) [0|100] "%" Vector__XXX
 SG_ RRR_Obj04B_ProbGNDReflex : 58|6@1+ (2,0) [0|100] "%" Vector__XXX
 SG_ RRR_Obj04B_ProbStatBarrier : 64|6@1+ (2,0) [0|100] "%" Vector__XXX
 SG_ RRR_Obj04B_ProbStatObst : 70|6@1+ (2,0) [0|100] "%" Vector__XXX
 SG_ RRR_Obj04B_MovingProbability : 76|6@1+ (2,0) [0|100] "%" Vector__XXX
 SG_ RRR_Obj04B_MovingObserved : 82|6@1+ (2,0) [0|100] "%" Vector__XXX
 SG_ RRR_Obj04B_FV : 103|8@0+ (1,0) [0|255] "" Vector__XXX

BO_ 1306 RRR_Obj05A: 64 Vector__XXX
 SG_ RRR_Obj05A_CRC : 0|16@1+ (1,0) [0|65535] "" Vector__XXX
 SG_ RRR_Obj05A_Ay : 103|9@1+ (0.0625,-16) [-16|15.9375] "m/s^2" Vector__XXX
 SG_ RRR_Obj05A_HeadingYawAngle : 112|9@1+ (0.0175,-4.48) [-3.15|3.15] "rad" Vector__XXX
 SG_ RRR_Obj05A_Length : 121|7@1+ (0.125,0) [0|15.875] "m" Vector__XXX
 SG_ RRR_Obj05A_Width : 128|7@1+ (0.125,0) [0|15.875] "m" Vector__XXX
 SG_ RRR_Obj05A_Height : 135|7@1+ (0.125,0) [0|15.875] "m" Vector__XXX
 SG_ RRR_Obj05A_DxVnce : 142|12@1+ (0.01,0) [0|30] "m^2" Vector__XXX
 SG_ RRR_Obj05A_DyVnce : 154|12@1+ (0.01,0) [0|30] "m^2" Vector__XXX
 SG_ RRR_Obj05A_DzVnce : 166|10@1+ (0.01,0) [0|10] "m^2" Vector__XXX
 SG_ RRR_Obj05A_AliveCtr : 16|8@1+ (1,0) [0|254] "" Vector__XXX
 SG_ RRR_Obj05A_VxVnce : 176|12@1+ (0.01,0) [0|30] "m^2/s^2" Vector__XXX
 SG_ RRR_Obj05A_VyVnce : 188|12@1+ (0.01,0) [0|30] "m^2/s^2" Vector__XXX
 SG_ RRR_Obj05A_AxVnce : 200|12@1+ (0.01,0) [0|30] "m^2/s^4" Vector__XXX
 SG_ RRR_Obj05A_AyVnce : 212|12@1+ (0.01,0) [0|30] "m^2/s^4" Vector__XXX
 SG_ RRR_Obj05A_RefPosIndex : 224|4@1+ (1,0) [0|15] "" Vector__XXX
 SG_ RRR_Obj05A_DxDyCoVnce : 228|12@1+ (0.01,0) [0|30] "m^2" Vector__XXX
 SG_ RRR_Obj05A_DxVxCoVnce : 240|12@1+ (0.01,0) [0|30] "m^2/s" Vector__XXX
 SG_ RRR_Obj05A_BlockCtr : 24|4@1+ (1,0) [0|15] "" Vector__XXX
 SG_ RRR_Obj05A_DyVxCoVnce : 252|12@1+ (0.01,0) [0|30] "m^2/s" Vector__XXX
 SG_ RRR_Obj05A_DxVyCoVnce : 264|12@1+ (0.01,0) [0|30] "m^2/s" Vector__XXX
 SG_ RRR_Obj05A_DyVyCoVnce : 276|12@1+ (0.01,0) [0|30] "m^2/s" Vector__XXX
 SG_ RRR_Obj05A_VxVyCoVnce : 288|12@1+ (0.01,0) [0|30] "m^2/s^2" Vector__XXX
 SG_ RRR_Obj05A_DxAxCoVnce : 300|12@1+ (0.01,0) [0|30] "m^2/s^2" Vector__XXX
 SG_ RRR_Obj05A_DyAxCoVnce : 312|12@1+ (0.01,0) [0|30] "m^2/s^2" Vector__XXX
 SG_ RRR_Obj05A_VxAxCoVnce : 324|12@1+ (0.01,0) [0|30] "m^2/s^3" Vector__XXX
 SG_ RRR_Obj05A_ObjectID : 32|7@1+ (1,0) [0|127] "" Vector__XXX
 SG_ RRR_Obj05A_VyAxCoVnce : 336|12@1+ (0.01,0) [0|30] "m^2/s^3" Vector__XXX
 SG_ RRR_Obj05A_DxAyCoVnce : 348|12@1+ (0.01,0) [0|30] "m^2/s^2" Vector__XXX
 SG_ RRR_Obj05A_DyAyCoVnce : 360|12@1+ (0.01,0) [0|30] "m^2/s^2" Vector__XXX
 SG_ RRR_Obj05A_VxAyCoVnce : 372|12@1+ (0.01,0) [0|30] "m^2/s^3" Vector__XXX
 SG_ RRR_Obj05A_VyAyCoVnce : 384|12@1+ (0.01,0) [0|30] "m^2/s^3" Vector__XXX
 SG_ RRR_Obj05A_AxAyCoVnce : 396|12@1+ (0.01,0) [0|30] "m^2/s^4" Vector__XXX
 SG_ RRR_Obj05A_Measured : 39|1@1+ (1,0) [0|1] "" Vector__XXX
 SG_ RRR_Obj05A_HeadingYawVnce : 408|12@1+ (0.0003,0) [0|1] "rad^2" Vector__XXX
 SG_ RRR_Obj05A_Dx : 40|13@1+ (0.0625,-256) [-256|255.9375] "m" Vector__XXX
 SG_ RRR_Obj05A_LengthVnce : 420|12@1+ (0.01,0) [0|30] "m^2" Vector__XXX
 SG_ RRR_Obj05A_WidthVnce : 432|12@1+ (0.01,0) [0|30] "m^2" Vector__XXX
 SG_ RRR_Obj05A_HeightVnce : 444|12@1+ (0.01,0) [0|30] "m^2" Vector__XXX
 SG_ RRR_Obj05A_ExistProb : 456|6@1+ (2,0) [0|100] "%" Vector__XXX
 SG_ RRR_Obj05A_ProbObstacle : 462|6@1+ (2,0) [0|100] "%" Vector__XXX
 SG_ RRR_Obj05A_ProbNonObstacle : 468|6@1+ (2,0) [0|100] "%" Vector__XXX
 SG_ RRR_Obj05A_ProbMobileObst : 474|6@1+ (2,0) [0|100] "%" Vector__XXX
 SG_ RRR_Obj05A_FV : 487|8@0+ (1,0) [0|255] "" Vector__XXX
 SG_ RRR_Obj05A_MAC : 495|24@0+ (1,0) [0|16777215] "" Vector__XXX
 SG_ RRR_Obj05A_Dz : 53|6@1+ (0.25,-5) [-5|10.75] "m" Vector__XXX
 SG_ RRR_Obj05A_Dy : 59|11@1+ (0.125,-128) [-128|127.875] "m" Vector__XXX
 SG_ RRR_Obj05A_Valid : 70|1@1+ (1,0) [0|1] "" Vector__XXX
 SG_ RRR_Obj05A_Vx : 71|12@1+ (0.0625,-128) [-128|127.9375] "m/s" Vector__XXX
 SG_ RRR_Obj05A_Vy : 83|10@1+ (0.125,-64) [-64|63.875] "m/s" Vector__XXX
 SG_ RRR_Obj05A_Ax : 93|10@1+ (0.03125,-16) [-16|15.96875] "m/s^2" Vector__XXX

BO_ 1307 RRR_Obj05B: 16 Vector__XXX
 SG_ RRR_Obj05B_CRC : 0|16@1+ (1,0) [0|65535] "" Vector__XXX
 SG_ RRR_Obj05B_MAC : 111|24@0+ (1,0) [0|16777215] "" Vector__XXX
 SG_ RRR_Obj05B_AliveCtr : 16|8@1+ (1,0) [0|254] "" Vector__XXX
 SG_ RRR_Obj05B_BlockCtr : 24|4@1+ (1,0) [0|15] "" Vector__XXX
 SG_ RRR_Obj05B_ProbMob4PlusWhl : 28|6@1+ (2,0) [0|100] "%" Vector__XXX
 SG_ RRR_Obj05B_ProbMob2Whl : 34|6@1+ (2,0) [0|100] "%" Vector__XXX
 SG_ RRR_Obj05B_ProbMobPed : 40|6@1+ (2,0) [0|100] "%" Vector__XXX
 SG_ RRR_Obj05B_Prob4PlusWhlCAR : 46|6@1+ (2,0) [0|100] "%" Vector__XXX
 SG_ RRR_Obj05B_Prob4PlusWhlbHGV : 52|6@1+ (2,0) [0|100] "%" Vector__XXX
 SG_ RRR_Obj05B_ProbGNDReflex : 58|6@1+ (2,0) [0|100] "%" Vector__XXX
 SG_ RRR_Obj05B_ProbStatBarrier : 64|6@1+ (2,0) [0|100] "%" Vector__XXX
 SG_ RRR_Obj05B_ProbStatObst : 70|6@1+ (2,0) [0|100] "%" Vector__XXX
 SG_ RRR_Obj05B_MovingProbability : 76|6@1+ (2,0) [0|100] "%" Vector__XXX
 SG_ RRR_Obj05B_MovingObserved : 82|6@1+ (2,0) [0|100] "%" Vector__XXX
 SG_ RRR_Obj05B_FV : 103|8@0+ (1,0) [0|255] "" Vector__XXX

BO_ 1308 RRR_Obj06A: 64 Vector__XXX
 SG_ RRR_Obj06A_CRC : 0|16@1+ (1,0) [0|65535] "" Vector__XXX
 SG_ RRR_Obj06A_Ay : 103|9@1+ (0.0625,-16) [-16|15.9375] "m/s^2" Vector__XXX
 SG_ RRR_Obj06A_HeadingYawAngle : 112|9@1+ (0.0175,-4.48) [-3.15|3.15] "rad" Vector__XXX
 SG_ RRR_Obj06A_Length : 121|7@1+ (0.125,0) [0|15.875] "m" Vector__XXX
 SG_ RRR_Obj06A_Width : 128|7@1+ (0.125,0) [0|15.875] "m" Vector__XXX
 SG_ RRR_Obj06A_Height : 135|7@1+ (0.125,0) [0|15.875] "m" Vector__XXX
 SG_ RRR_Obj06A_DxVnce : 142|12@1+ (0.01,0) [0|30] "m^2" Vector__XXX
 SG_ RRR_Obj06A_DyVnce : 154|12@1+ (0.01,0) [0|30] "m^2" Vector__XXX
 SG_ RRR_Obj06A_DzVnce : 166|10@1+ (0.01,0) [0|10] "m^2" Vector__XXX
 SG_ RRR_Obj06A_AliveCtr : 16|8@1+ (1,0) [0|254] "" Vector__XXX
 SG_ RRR_Obj06A_VxVnce : 176|12@1+ (0.01,0) [0|30] "m^2/s^2" Vector__XXX
 SG_ RRR_Obj06A_VyVnce : 188|12@1+ (0.01,0) [0|30] "m^2/s^2" Vector__XXX
 SG_ RRR_Obj06A_AxVnce : 200|12@1+ (0.01,0) [0|30] "m^2/s^4" Vector__XXX
 SG_ RRR_Obj06A_AyVnce : 212|12@1+ (0.01,0) [0|30] "m^2/s^4" Vector__XXX
 SG_ RRR_Obj06A_RefPosIndex : 224|4@1+ (1,0) [0|15] "" Vector__XXX
 SG_ RRR_Obj06A_DxDyCoVnce : 228|12@1+ (0.01,0) [0|30] "m^2" Vector__XXX
 SG_ RRR_Obj06A_DxVxCoVnce : 240|12@1+ (0.01,0) [0|30] "m^2/s" Vector__XXX
 SG_ RRR_Obj06A_BlockCtr : 24|4@1+ (1,0) [0|15] "" Vector__XXX
 SG_ RRR_Obj06A_DyVxCoVnce : 252|12@1+ (0.01,0) [0|30] "m^2/s" Vector__XXX
 SG_ RRR_Obj06A_DxVyCoVnce : 264|12@1+ (0.01,0) [0|30] "m^2/s" Vector__XXX
 SG_ RRR_Obj06A_DyVyCoVnce : 276|12@1+ (0.01,0) [0|30] "m^2/s" Vector__XXX
 SG_ RRR_Obj06A_VxVyCoVnce : 288|12@1+ (0.01,0) [0|30] "m^2/s^2" Vector__XXX
 SG_ RRR_Obj06A_DxAxCoVnce : 300|12@1+ (0.01,0) [0|30] "m^2/s^2" Vector__XXX
 SG_ RRR_Obj06A_DyAxCoVnce : 312|12@1+ (0.01,0) [0|30] "m^2/s^2" Vector__XXX
 SG_ RRR_Obj06A_VxAxCoVnce : 324|12@1+ (0.01,0) [0|30] "m^2/s^3" Vector__XXX
 SG_ RRR_Obj06A_ObjectID : 32|7@1+ (1,0) [0|127] "" Vector__XXX
 SG_ RRR_Obj06A_VyAxCoVnce : 336|12@1+ (0.01,0) [0|30] "m^2/s^3" Vector__XXX
 SG_ RRR_Obj06A_DxAyCoVnce : 348|12@1+ (0.01,0) [0|30] "m^2/s^2" Vector__XXX
 SG_ RRR_Obj06A_DyAyCoVnce : 360|12@1+ (0.01,0) [0|30] "m^2/s^2" Vector__XXX
 SG_ RRR_Obj06A_VxAyCoVnce : 372|12@1+ (0.01,0) [0|30] "m^2/s^3" Vector__XXX
 SG_ RRR_Obj06A_VyAyCoVnce : 384|12@1+ (0.01,0) [0|30] "m^2/s^3" Vector__XXX
 SG_ RRR_Obj06A_AxAyCoVnce : 396|12@1+ (0.01,0) [0|30] "m^2/s^4" Vector__XXX
 SG_ RRR_Obj06A_Measured : 39|1@1+ (1,0) [0|1] "" Vector__XXX
 SG_ RRR_Obj06A_HeadingYawVnce : 408|12@1+ (0.0003,0) [0|1] "rad^2" Vector__XXX
 SG_ RRR_Obj06A_Dx : 40|13@1+ (0.0625,-256) [-256|255.9375] "m" Vector__XXX
 SG_ RRR_Obj06A_LengthVnce : 420|12@1+ (0.01,0) [0|30] "m^2" Vector__XXX
 SG_ RRR_Obj06A_WidthVnce : 432|12@1+ (0.01,0) [0|30] "m^2" Vector__XXX
 SG_ RRR_Obj06A_HeightVnce : 444|12@1+ (0.01,0) [0|30] "m^2" Vector__XXX
 SG_ RRR_Obj06A_ExistProb : 456|6@1+ (2,0) [0|100] "%" Vector__XXX
 SG_ RRR_Obj06A_ProbObstacle : 462|6@1+ (2,0) [0|100] "%" Vector__XXX
 SG_ RRR_Obj06A_ProbNonObstacle : 468|6@1+ (2,0) [0|100] "%" Vector__XXX
 SG_ RRR_Obj06A_ProbMobileObst : 474|6@1+ (2,0) [0|100] "%" Vector__XXX
 SG_ RRR_Obj06A_FV : 487|8@0+ (1,0) [0|255] "" Vector__XXX
 SG_ RRR_Obj06A_MAC : 495|24@0+ (1,0) [0|16777215] "" Vector__XXX
 SG_ RRR_Obj06A_Dz : 53|6@1+ (0.25,-5) [-5|10.75] "m" Vector__XXX
 SG_ RRR_Obj06A_Dy : 59|11@1+ (0.125,-128) [-128|127.875] "m" Vector__XXX
 SG_ RRR_Obj06A_Valid : 70|1@1+ (1,0) [0|1] "" Vector__XXX
 SG_ RRR_Obj06A_Vx : 71|12@1+ (0.0625,-128) [-128|127.9375] "m/s" Vector__XXX
 SG_ RRR_Obj06A_Vy : 83|10@1+ (0.125,-64) [-64|63.875] "m/s" Vector__XXX
 SG_ RRR_Obj06A_Ax : 93|10@1+ (0.03125,-16) [-16|15.96875] "m/s^2" Vector__XXX

BO_ 1309 RRR_Obj06B: 16 Vector__XXX
 SG_ RRR_Obj06B_CRC : 0|16@1+ (1,0) [0|65535] "" Vector__XXX
 SG_ RRR_Obj06B_MAC : 111|24@0+ (1,0) [0|16777215] "" Vector__XXX
 SG_ RRR_Obj06B_AliveCtr : 16|8@1+ (1,0) [0|254] "" Vector__XXX
 SG_ RRR_Obj06B_BlockCtr : 24|4@1+ (1,0) [0|15] "" Vector__XXX
 SG_ RRR_Obj06B_ProbMob4PlusWhl : 28|6@1+ (2,0) [0|100] "%" Vector__XXX
 SG_ RRR_Obj06B_ProbMob2Whl : 34|6@1+ (2,0) [0|100] "%" Vector__XXX
 SG_ RRR_Obj06B_ProbMobPed : 40|6@1+ (2,0) [0|100] "%" Vector__XXX
 SG_ RRR_Obj06B_Prob4PlusWhlCAR : 46|6@1+ (2,0) [0|100] "%" Vector__XXX
 SG_ RRR_Obj06B_Prob4PlusWhlbHGV : 52|6@1+ (2,0) [0|100] "%" Vector__XXX
 SG_ RRR_Obj06B_ProbGNDReflex : 58|6@1+ (2,0) [0|100] "%" Vector__XXX
 SG_ RRR_Obj06B_ProbStatBarrier : 64|6@1+ (2,0) [0|100] "%" Vector__XXX
 SG_ RRR_Obj06B_ProbStatObst : 70|6@1+ (2,0) [0|100] "%" Vector__XXX
 SG_ RRR_Obj06B_MovingProbability : 76|6@1+ (2,0) [0|100] "%" Vector__XXX
 SG_ RRR_Obj06B_MovingObserved : 82|6@1+ (2,0) [0|100] "%" Vector__XXX
 SG_ RRR_Obj06B_FV : 103|8@0+ (1,0) [0|255] "" Vector__XXX

CM_ SG_ 810 RRL_Obj13A_CRC "CRC - Autosar E2E Profile 5";
CM_ SG_ 810 RRL_Obj13A_Ay "Object acceleration in Y direction";
CM_ SG_ 810 RRL_Obj13A_HeadingYawAngle "Object heading yaw angle";
CM_ SG_ 810 RRL_Obj13A_Length "Object Length";
CM_ SG_ 810 RRL_Obj13A_Width "Object Width";
CM_ SG_ 810 RRL_Obj13A_Height "Object Height";
CM_ SG_ 810 RRL_Obj13A_DxVnce "Variance of object position in X direction";
CM_ SG_ 810 RRL_Obj13A_DyVnce "Variance of object position in Y direction";
CM_ SG_ 810 RRL_Obj13A_DzVnce "Variance of object position in Z direction";
CM_ SG_ 810 RRL_Obj13A_AliveCtr "Alive counter - Autosar E2E Profile 5";
CM_ SG_ 810 RRL_Obj13A_VxVnce "Variance of object velocity in X direction";
CM_ SG_ 810 RRL_Obj13A_VyVnce "Variance of object velocity in Y direction";
CM_ SG_ 810 RRL_Obj13A_AxVnce "Variance of object acceleration in X direction";
CM_ SG_ 810 RRL_Obj13A_AyVnce "Variance of object acceleration in Y direction";
CM_ SG_ 810 RRL_Obj13A_RefPosIndex "Reference Position of the detected objects";
CM_ SG_ 810 RRL_Obj13A_DxDyCoVnce "Correlation coefficient of Dx and Dy";
CM_ SG_ 810 RRL_Obj13A_DxVxCoVnce "Correlation coefficient of Dx and Vx";
CM_ SG_ 810 RRL_Obj13A_BlockCtr "Block-Counter";
CM_ SG_ 810 RRL_Obj13A_DyVxCoVnce "Correlation coefficient of Dy and Ax";
CM_ SG_ 810 RRL_Obj13A_DxVyCoVnce "Correlation coefficient of Dx and Vy";
CM_ SG_ 810 RRL_Obj13A_DyVyCoVnce "Correlation coefficient of Dy and Vy";
CM_ SG_ 810 RRL_Obj13A_VxVyCoVnce "Correlation coefficient of Vx and Vy";
CM_ SG_ 810 RRL_Obj13A_DxAxCoVnce "Correlation coefficient of Dx and Ax";
CM_ SG_ 810 RRL_Obj13A_DyAxCoVnce "Correlation coefficient of Dy and Ax";
CM_ SG_ 810 RRL_Obj13A_VxAxCoVnce "Correlation coefficient of Vx and Ax";
CM_ SG_ 810 RRL_Obj13A_ObjectID "Unique Object ID";
CM_ SG_ 810 RRL_Obj13A_VyAxCoVnce "Correlation coefficient of Vy and Ax";
CM_ SG_ 810 RRL_Obj13A_DxAyCoVnce "Correlation coefficient of Dx and Ay";
CM_ SG_ 810 RRL_Obj13A_DyAyCoVnce "Correlation coefficient of Dy and Ay";
CM_ SG_ 810 RRL_Obj13A_VxAyCoVnce "Correlation coefficient of Vx and Ay";
CM_ SG_ 810 RRL_Obj13A_VyAyCoVnce "Correlation coefficient of Vy and Ay";
CM_ SG_ 810 RRL_Obj13A_AxAyCoVnce "Correlation coefficient of Ax and Ay";
CM_ SG_ 810 RRL_Obj13A_Measured "Object is measured or not";
CM_ SG_ 810 RRL_Obj13A_HeadingYawVnce "Variance of Object heading yaw angle";
CM_ SG_ 810 RRL_Obj13A_Dx "Object position in X direction";
CM_ SG_ 810 RRL_Obj13A_LengthVnce "Variance of Object Length";
CM_ SG_ 810 RRL_Obj13A_WidthVnce "Variance of Object Width";
CM_ SG_ 810 RRL_Obj13A_HeightVnce "Variance of Object Height";
CM_ SG_ 810 RRL_Obj13A_ExistProb "Existence probability of object";
CM_ SG_ 810 RRL_Obj13A_ProbObstacle "Probability of the object being an Obstacle";
CM_ SG_ 810 RRL_Obj13A_ProbNonObstacle "Probability of the object being a Non-Obstacle";
CM_ SG_ 810 RRL_Obj13A_ProbMobileObst "Probability of the object being a mobile obstacle";
CM_ SG_ 810 RRL_Obj13A_FV "SecOC Freshness Value (Profile 1)";
CM_ SG_ 810 RRL_Obj13A_MAC "SecOC MAC (Profile 1)";
CM_ SG_ 810 RRL_Obj13A_Dz "Object position in Z direction";
CM_ SG_ 810 RRL_Obj13A_Dy "Object position in Y direction";
CM_ SG_ 810 RRL_Obj13A_Valid "Object is valid or not";
CM_ SG_ 810 RRL_Obj13A_Vx "Object velocity in X direction";
CM_ SG_ 810 RRL_Obj13A_Vy "Object velocity in Y direction";
CM_ SG_ 810 RRL_Obj13A_Ax "Object acceleration in X direction";
CM_ SG_ 811 RRL_Obj13B_CRC "CRC - Autosar E2E Profile 5";
CM_ SG_ 811 RRL_Obj13B_MAC "SecOC MAC (Profile 1)";
CM_ SG_ 811 RRL_Obj13B_AliveCtr "Alive counter - Autosar E2E Profile 5";
CM_ SG_ 811 RRL_Obj13B_BlockCtr "Block-Counter";
CM_ SG_ 811 RRL_Obj13B_ProbMob4PlusWhl "Probability of a mobile object which has 4 or more wheels";
CM_ SG_ 811 RRL_Obj13B_ProbMob2Whl "Probability of a mobile object being 2-wheels vehicle";
CM_ SG_ 811 RRL_Obj13B_ProbMobPed "Probability of a mobile object being a pedestrian";
CM_ SG_ 811 RRL_Obj13B_Prob4PlusWhlCAR "Probability of a mobile object which has 4 or more wheels--passenger car";
CM_ SG_ 811 RRL_Obj13B_Prob4PlusWhlbHGV "Probability of a mobile object which has 4 or more wheels--commercial vehicle(Turck)";
CM_ SG_ 811 RRL_Obj13B_ProbGNDReflex "Probability of the object being a ground reflex";
CM_ SG_ 811 RRL_Obj13B_ProbStatBarrier "Probability of the object being a stationary road barrier";
CM_ SG_ 811 RRL_Obj13B_ProbStatObst "Probability of the object being a stationary obstacle";
CM_ SG_ 811 RRL_Obj13B_MovingProbability "Object has been observed moving over the ground";
CM_ SG_ 811 RRL_Obj13B_MovingObserved "Object has been observed moving over the ground since it was first detected";
CM_ SG_ 811 RRL_Obj13B_FV "SecOC Freshness Value (Profile 1)";
CM_ SG_ 812 RRL_Obj14A_CRC "CRC - Autosar E2E Profile 5";
CM_ SG_ 812 RRL_Obj14A_Ay "Object acceleration in Y direction";
CM_ SG_ 812 RRL_Obj14A_HeadingYawAngle "Object heading yaw angle";
CM_ SG_ 812 RRL_Obj14A_Length "Object Length";
CM_ SG_ 812 RRL_Obj14A_Width "Object Width";
CM_ SG_ 812 RRL_Obj14A_Height "Object Height";
CM_ SG_ 812 RRL_Obj14A_DxVnce "Variance of object position in X direction";
CM_ SG_ 812 RRL_Obj14A_DyVnce "Variance of object position in Y direction";
CM_ SG_ 812 RRL_Obj14A_DzVnce "Variance of object position in Z direction";
CM_ SG_ 812 RRL_Obj14A_AliveCtr "Alive counter - Autosar E2E Profile 5";
CM_ SG_ 812 RRL_Obj14A_VxVnce "Variance of object velocity in X direction";
CM_ SG_ 812 RRL_Obj14A_VyVnce "Variance of object velocity in Y direction";
CM_ SG_ 812 RRL_Obj14A_AxVnce "Variance of object acceleration in X direction";
CM_ SG_ 812 RRL_Obj14A_AyVnce "Variance of object acceleration in Y direction";
CM_ SG_ 812 RRL_Obj14A_RefPosIndex "Reference Position of the detected objects";
CM_ SG_ 812 RRL_Obj14A_DxDyCoVnce "Correlation coefficient of Dx and Dy";
CM_ SG_ 812 RRL_Obj14A_DxVxCoVnce "Correlation coefficient of Dx and Vx";
CM_ SG_ 812 RRL_Obj14A_BlockCtr "Block-Counter";
CM_ SG_ 812 RRL_Obj14A_DyVxCoVnce "Correlation coefficient of Dy and Ax";
CM_ SG_ 812 RRL_Obj14A_DxVyCoVnce "Correlation coefficient of Dx and Vy";
CM_ SG_ 812 RRL_Obj14A_DyVyCoVnce "Correlation coefficient of Dy and Vy";
CM_ SG_ 812 RRL_Obj14A_VxVyCoVnce "Correlation coefficient of Vx and Vy";
CM_ SG_ 812 RRL_Obj14A_DxAxCoVnce "Correlation coefficient of Dx and Ax";
CM_ SG_ 812 RRL_Obj14A_DyAxCoVnce "Correlation coefficient of Dy and Ax";
CM_ SG_ 812 RRL_Obj14A_VxAxCoVnce "Correlation coefficient of Vx and Ax";
CM_ SG_ 812 RRL_Obj14A_ObjectID "Unique Object ID";
CM_ SG_ 812 RRL_Obj14A_VyAxCoVnce "Correlation coefficient of Vy and Ax";
CM_ SG_ 812 RRL_Obj14A_DxAyCoVnce "Correlation coefficient of Dx and Ay";
CM_ SG_ 812 RRL_Obj14A_DyAyCoVnce "Correlation coefficient of Dy and Ay";
CM_ SG_ 812 RRL_Obj14A_VxAyCoVnce "Correlation coefficient of Vx and Ay";
CM_ SG_ 812 RRL_Obj14A_VyAyCoVnce "Correlation coefficient of Vy and Ay";
CM_ SG_ 812 RRL_Obj14A_AxAyCoVnce "Correlation coefficient of Ax and Ay";
CM_ SG_ 812 RRL_Obj14A_Measured "Object is measured or not";
CM_ SG_ 812 RRL_Obj14A_HeadingYawVnce "Variance of Object heading yaw angle";
CM_ SG_ 812 RRL_Obj14A_Dx "Object position in X direction";
CM_ SG_ 812 RRL_Obj14A_LengthVnce "Variance of Object Length";
CM_ SG_ 812 RRL_Obj14A_WidthVnce "Variance of Object Width";
CM_ SG_ 812 RRL_Obj14A_HeightVnce "Variance of Object Height";
CM_ SG_ 812 RRL_Obj14A_ExistProb "Existence probability of object";
CM_ SG_ 812 RRL_Obj14A_ProbObstacle "Probability of the object being an Obstacle";
CM_ SG_ 812 RRL_Obj14A_ProbNonObstacle "Probability of the object being a Non-Obstacle";
CM_ SG_ 812 RRL_Obj14A_ProbMobileObst "Probability of the object being a mobile obstacle";
CM_ SG_ 812 RRL_Obj14A_FV "SecOC Freshness Value (Profile 1)";
CM_ SG_ 812 RRL_Obj14A_MAC "SecOC MAC (Profile 1)";
CM_ SG_ 812 RRL_Obj14A_Dz "Object position in Z direction";
CM_ SG_ 812 RRL_Obj14A_Dy "Object position in Y direction";
CM_ SG_ 812 RRL_Obj14A_Valid "Object is valid or not";
CM_ SG_ 812 RRL_Obj14A_Vx "Object velocity in X direction";
CM_ SG_ 812 RRL_Obj14A_Vy "Object velocity in Y direction";
CM_ SG_ 812 RRL_Obj14A_Ax "Object acceleration in X direction";
CM_ SG_ 813 RRL_Obj14B_CRC "CRC - Autosar E2E Profile 5";
CM_ SG_ 813 RRL_Obj14B_MAC "SecOC MAC (Profile 1)";
CM_ SG_ 813 RRL_Obj14B_AliveCtr "Alive counter - Autosar E2E Profile 5";
CM_ SG_ 813 RRL_Obj14B_BlockCtr "Block-Counter";
CM_ SG_ 813 RRL_Obj14B_ProbMob4PlusWhl "Probability of a mobile object which has 4 or more wheels";
CM_ SG_ 813 RRL_Obj14B_ProbMob2Whl "Probability of a mobile object being 2-wheels vehicle";
CM_ SG_ 813 RRL_Obj14B_ProbMobPed "Probability of a mobile object being a pedestrian";
CM_ SG_ 813 RRL_Obj14B_Prob4PlusWhlCAR "Probability of a mobile object which has 4 or more wheels--passenger car";
CM_ SG_ 813 RRL_Obj14B_Prob4PlusWhlbHGV "Probability of a mobile object which has 4 or more wheels--commercial vehicle(Turck)";
CM_ SG_ 813 RRL_Obj14B_ProbGNDReflex "Probability of the object being a ground reflex";
CM_ SG_ 813 RRL_Obj14B_ProbStatBarrier "Probability of the object being a stationary road barrier";
CM_ SG_ 813 RRL_Obj14B_ProbStatObst "Probability of the object being a stationary obstacle";
CM_ SG_ 813 RRL_Obj14B_MovingProbability "Object has been observed moving over the ground";
CM_ SG_ 813 RRL_Obj14B_MovingObserved "Object has been observed moving over the ground since it was first detected";
CM_ SG_ 813 RRL_Obj14B_FV "SecOC Freshness Value (Profile 1)";
CM_ SG_ 814 RRL_Obj15A_CRC "CRC - Autosar E2E Profile 5";
CM_ SG_ 814 RRL_Obj15A_Ay "Object acceleration in Y direction";
CM_ SG_ 814 RRL_Obj15A_HeadingYawAngle "Object heading yaw angle";
CM_ SG_ 814 RRL_Obj15A_Length "Object Length";
CM_ SG_ 814 RRL_Obj15A_Width "Object Width";
CM_ SG_ 814 RRL_Obj15A_Height "Object Height";
CM_ SG_ 814 RRL_Obj15A_DxVnce "Variance of object position in X direction";
CM_ SG_ 814 RRL_Obj15A_DyVnce "Variance of object position in Y direction";
CM_ SG_ 814 RRL_Obj15A_DzVnce "Variance of object position in Z direction";
CM_ SG_ 814 RRL_Obj15A_AliveCtr "Alive counter - Autosar E2E Profile 5";
CM_ SG_ 814 RRL_Obj15A_VxVnce "Variance of object velocity in X direction";
CM_ SG_ 814 RRL_Obj15A_VyVnce "Variance of object velocity in Y direction";
CM_ SG_ 814 RRL_Obj15A_AxVnce "Variance of object acceleration in X direction";
CM_ SG_ 814 RRL_Obj15A_AyVnce "Variance of object acceleration in Y direction";
CM_ SG_ 814 RRL_Obj15A_RefPosIndex "Reference Position of the detected objects";
CM_ SG_ 814 RRL_Obj15A_DxDyCoVnce "Correlation coefficient of Dx and Dy";
CM_ SG_ 814 RRL_Obj15A_DxVxCoVnce "Correlation coefficient of Dx and Vx";
CM_ SG_ 814 RRL_Obj15A_BlockCtr "Block-Counter";
CM_ SG_ 814 RRL_Obj15A_DyVxCoVnce "Correlation coefficient of Dy and Ax";
CM_ SG_ 814 RRL_Obj15A_DxVyCoVnce "Correlation coefficient of Dx and Vy";
CM_ SG_ 814 RRL_Obj15A_DyVyCoVnce "Correlation coefficient of Dy and Vy";
CM_ SG_ 814 RRL_Obj15A_VxVyCoVnce "Correlation coefficient of Vx and Vy";
CM_ SG_ 814 RRL_Obj15A_DxAxCoVnce "Correlation coefficient of Dx and Ax";
CM_ SG_ 814 RRL_Obj15A_DyAxCoVnce "Correlation coefficient of Dy and Ax";
CM_ SG_ 814 RRL_Obj15A_VxAxCoVnce "Correlation coefficient of Vx and Ax";
CM_ SG_ 814 RRL_Obj15A_ObjectID "Unique Object ID";
CM_ SG_ 814 RRL_Obj15A_VyAxCoVnce "Correlation coefficient of Vy and Ax";
CM_ SG_ 814 RRL_Obj15A_DxAyCoVnce "Correlation coefficient of Dx and Ay";
CM_ SG_ 814 RRL_Obj15A_DyAyCoVnce "Correlation coefficient of Dy and Ay";
CM_ SG_ 814 RRL_Obj15A_VxAyCoVnce "Correlation coefficient of Vx and Ay";
CM_ SG_ 814 RRL_Obj15A_VyAyCoVnce "Correlation coefficient of Vy and Ay";
CM_ SG_ 814 RRL_Obj15A_AxAyCoVnce "Correlation coefficient of Ax and Ay";
CM_ SG_ 814 RRL_Obj15A_Measured "Object is measured or not";
CM_ SG_ 814 RRL_Obj15A_HeadingYawVnce "Variance of Object heading yaw angle";
CM_ SG_ 814 RRL_Obj15A_Dx "Object position in X direction";
CM_ SG_ 814 RRL_Obj15A_LengthVnce "Variance of Object Length";
CM_ SG_ 814 RRL_Obj15A_WidthVnce "Variance of Object Width";
CM_ SG_ 814 RRL_Obj15A_HeightVnce "Variance of Object Height";
CM_ SG_ 814 RRL_Obj15A_ExistProb "Existence probability of object";
CM_ SG_ 814 RRL_Obj15A_ProbObstacle "Probability of the object being an Obstacle";
CM_ SG_ 814 RRL_Obj15A_ProbNonObstacle "Probability of the object being a Non-Obstacle";
CM_ SG_ 814 RRL_Obj15A_ProbMobileObst "Probability of the object being a mobile obstacle";
CM_ SG_ 814 RRL_Obj15A_FV "SecOC Freshness Value (Profile 1)";
CM_ SG_ 814 RRL_Obj15A_MAC "SecOC MAC (Profile 1)";
CM_ SG_ 814 RRL_Obj15A_Dz "Object position in Z direction";
CM_ SG_ 814 RRL_Obj15A_Dy "Object position in Y direction";
CM_ SG_ 814 RRL_Obj15A_Valid "Object is valid or not";
CM_ SG_ 814 RRL_Obj15A_Vx "Object velocity in X direction";
CM_ SG_ 814 RRL_Obj15A_Vy "Object velocity in Y direction";
CM_ SG_ 814 RRL_Obj15A_Ax "Object acceleration in X direction";
CM_ SG_ 815 RRL_Obj15B_CRC "CRC - Autosar E2E Profile 5";
CM_ SG_ 815 RRL_Obj15B_MAC "SecOC MAC (Profile 1)";
CM_ SG_ 815 RRL_Obj15B_AliveCtr "Alive counter - Autosar E2E Profile 5";
CM_ SG_ 815 RRL_Obj15B_BlockCtr "Block-Counter";
CM_ SG_ 815 RRL_Obj15B_ProbMob4PlusWhl "Probability of a mobile object which has 4 or more wheels";
CM_ SG_ 815 RRL_Obj15B_ProbMob2Whl "Probability of a mobile object being 2-wheels vehicle";
CM_ SG_ 815 RRL_Obj15B_ProbMobPed "Probability of a mobile object being a pedestrian";
CM_ SG_ 815 RRL_Obj15B_Prob4PlusWhlCAR "Probability of a mobile object which has 4 or more wheels--passenger car";
CM_ SG_ 815 RRL_Obj15B_Prob4PlusWhlbHGV "Probability of a mobile object which has 4 or more wheels--commercial vehicle(Turck)";
CM_ SG_ 815 RRL_Obj15B_ProbGNDReflex "Probability of the object being a ground reflex";
CM_ SG_ 815 RRL_Obj15B_ProbStatBarrier "Probability of the object being a stationary road barrier";
CM_ SG_ 815 RRL_Obj15B_ProbStatObst "Probability of the object being a stationary obstacle";
CM_ SG_ 815 RRL_Obj15B_MovingProbability "Object has been observed moving over the ground";
CM_ SG_ 815 RRL_Obj15B_MovingObserved "Object has been observed moving over the ground since it was first detected";
CM_ SG_ 815 RRL_Obj15B_FV "SecOC Freshness Value (Profile 1)";
CM_ SG_ 816 RRL_Obj16A_CRC "CRC - Autosar E2E Profile 5";
CM_ SG_ 816 RRL_Obj16A_Ay "Object acceleration in Y direction";
CM_ SG_ 816 RRL_Obj16A_HeadingYawAngle "Object heading yaw angle";
CM_ SG_ 816 RRL_Obj16A_Length "Object Length";
CM_ SG_ 816 RRL_Obj16A_Width "Object Width";
CM_ SG_ 816 RRL_Obj16A_Height "Object Height";
CM_ SG_ 816 RRL_Obj16A_DxVnce "Variance of object position in X direction";
CM_ SG_ 816 RRL_Obj16A_DyVnce "Variance of object position in Y direction";
CM_ SG_ 816 RRL_Obj16A_DzVnce "Variance of object position in Z direction";
CM_ SG_ 816 RRL_Obj16A_AliveCtr "Alive counter - Autosar E2E Profile 5";
CM_ SG_ 816 RRL_Obj16A_VxVnce "Variance of object velocity in X direction";
CM_ SG_ 816 RRL_Obj16A_VyVnce "Variance of object velocity in Y direction";
CM_ SG_ 816 RRL_Obj16A_AxVnce "Variance of object acceleration in X direction";
CM_ SG_ 816 RRL_Obj16A_AyVnce "Variance of object acceleration in Y direction";
CM_ SG_ 816 RRL_Obj16A_RefPosIndex "Reference Position of the detected objects";
CM_ SG_ 816 RRL_Obj16A_DxDyCoVnce "Correlation coefficient of Dx and Dy";
CM_ SG_ 816 RRL_Obj16A_DxVxCoVnce "Correlation coefficient of Dx and Vx";
CM_ SG_ 816 RRL_Obj16A_BlockCtr "Block-Counter";
CM_ SG_ 816 RRL_Obj16A_DyVxCoVnce "Correlation coefficient of Dy and Ax";
CM_ SG_ 816 RRL_Obj16A_DxVyCoVnce "Correlation coefficient of Dx and Vy";
CM_ SG_ 816 RRL_Obj16A_DyVyCoVnce "Correlation coefficient of Dy and Vy";
CM_ SG_ 816 RRL_Obj16A_VxVyCoVnce "Correlation coefficient of Vx and Vy";
CM_ SG_ 816 RRL_Obj16A_DxAxCoVnce "Correlation coefficient of Dx and Ax";
CM_ SG_ 816 RRL_Obj16A_DyAxCoVnce "Correlation coefficient of Dy and Ax";
CM_ SG_ 816 RRL_Obj16A_VxAxCoVnce "Correlation coefficient of Vx and Ax";
CM_ SG_ 816 RRL_Obj16A_ObjectID "Unique Object ID";
CM_ SG_ 816 RRL_Obj16A_VyAxCoVnce "Correlation coefficient of Vy and Ax";
CM_ SG_ 816 RRL_Obj16A_DxAyCoVnce "Correlation coefficient of Dx and Ay";
CM_ SG_ 816 RRL_Obj16A_DyAyCoVnce "Correlation coefficient of Dy and Ay";
CM_ SG_ 816 RRL_Obj16A_VxAyCoVnce "Correlation coefficient of Vx and Ay";
CM_ SG_ 816 RRL_Obj16A_VyAyCoVnce "Correlation coefficient of Vy and Ay";
CM_ SG_ 816 RRL_Obj16A_AxAyCoVnce "Correlation coefficient of Ax and Ay";
CM_ SG_ 816 RRL_Obj16A_Measured "Object is measured or not";
CM_ SG_ 816 RRL_Obj16A_HeadingYawVnce "Variance of Object heading yaw angle";
CM_ SG_ 816 RRL_Obj16A_Dx "Object position in X direction";
CM_ SG_ 816 RRL_Obj16A_LengthVnce "Variance of Object Length";
CM_ SG_ 816 RRL_Obj16A_WidthVnce "Variance of Object Width";
CM_ SG_ 816 RRL_Obj16A_HeightVnce "Variance of Object Height";
CM_ SG_ 816 RRL_Obj16A_ExistProb "Existence probability of object";
CM_ SG_ 816 RRL_Obj16A_ProbObstacle "Probability of the object being an Obstacle";
CM_ SG_ 816 RRL_Obj16A_ProbNonObstacle "Probability of the object being a Non-Obstacle";
CM_ SG_ 816 RRL_Obj16A_ProbMobileObst "Probability of the object being a mobile obstacle";
CM_ SG_ 816 RRL_Obj16A_FV "SecOC Freshness Value (Profile 1)";
CM_ SG_ 816 RRL_Obj16A_MAC "SecOC MAC (Profile 1)";
CM_ SG_ 816 RRL_Obj16A_Dz "Object position in Z direction";
CM_ SG_ 816 RRL_Obj16A_Dy "Object position in Y direction";
CM_ SG_ 816 RRL_Obj16A_Valid "Object is valid or not";
CM_ SG_ 816 RRL_Obj16A_Vx "Object velocity in X direction";
CM_ SG_ 816 RRL_Obj16A_Vy "Object velocity in Y direction";
CM_ SG_ 816 RRL_Obj16A_Ax "Object acceleration in X direction";
CM_ SG_ 817 RRL_Obj16B_CRC "CRC - Autosar E2E Profile 5";
CM_ SG_ 817 RRL_Obj16B_MAC "SecOC MAC (Profile 1)";
CM_ SG_ 817 RRL_Obj16B_AliveCtr "Alive counter - Autosar E2E Profile 5";
CM_ SG_ 817 RRL_Obj16B_BlockCtr "Block-Counter";
CM_ SG_ 817 RRL_Obj16B_ProbMob4PlusWhl "Probability of a mobile object which has 4 or more wheels";
CM_ SG_ 817 RRL_Obj16B_ProbMob2Whl "Probability of a mobile object being 2-wheels vehicle";
CM_ SG_ 817 RRL_Obj16B_ProbMobPed "Probability of a mobile object being a pedestrian";
CM_ SG_ 817 RRL_Obj16B_Prob4PlusWhlCAR "Probability of a mobile object which has 4 or more wheels--passenger car";
CM_ SG_ 817 RRL_Obj16B_Prob4PlusWhlbHGV "Probability of a mobile object which has 4 or more wheels--commercial vehicle(Turck)";
CM_ SG_ 817 RRL_Obj16B_ProbGNDReflex "Probability of the object being a ground reflex";
CM_ SG_ 817 RRL_Obj16B_ProbStatBarrier "Probability of the object being a stationary road barrier";
CM_ SG_ 817 RRL_Obj16B_ProbStatObst "Probability of the object being a stationary obstacle";
CM_ SG_ 817 RRL_Obj16B_MovingProbability "Object has been observed moving over the ground";
CM_ SG_ 817 RRL_Obj16B_MovingObserved "Object has been observed moving over the ground since it was first detected";
CM_ SG_ 817 RRL_Obj16B_FV "SecOC Freshness Value (Profile 1)";
CM_ SG_ 818 RRL_Obj17A_CRC "CRC - Autosar E2E Profile 5";
CM_ SG_ 818 RRL_Obj17A_Ay "Object acceleration in Y direction";
CM_ SG_ 818 RRL_Obj17A_HeadingYawAngle "Object heading yaw angle";
CM_ SG_ 818 RRL_Obj17A_Length "Object Length";
CM_ SG_ 818 RRL_Obj17A_Width "Object Width";
CM_ SG_ 818 RRL_Obj17A_Height "Object Height";
CM_ SG_ 818 RRL_Obj17A_DxVnce "Variance of object position in X direction";
CM_ SG_ 818 RRL_Obj17A_DyVnce "Variance of object position in Y direction";
CM_ SG_ 818 RRL_Obj17A_DzVnce "Variance of object position in Z direction";
CM_ SG_ 818 RRL_Obj17A_AliveCtr "Alive counter - Autosar E2E Profile 5";
CM_ SG_ 818 RRL_Obj17A_VxVnce "Variance of object velocity in X direction";
CM_ SG_ 818 RRL_Obj17A_VyVnce "Variance of object velocity in Y direction";
CM_ SG_ 818 RRL_Obj17A_AxVnce "Variance of object acceleration in X direction";
CM_ SG_ 818 RRL_Obj17A_AyVnce "Variance of object acceleration in Y direction";
CM_ SG_ 818 RRL_Obj17A_RefPosIndex "Reference Position of the detected objects";
CM_ SG_ 818 RRL_Obj17A_DxDyCoVnce "Correlation coefficient of Dx and Dy";
CM_ SG_ 818 RRL_Obj17A_DxVxCoVnce "Correlation coefficient of Dx and Vx";
CM_ SG_ 818 RRL_Obj17A_BlockCtr "Block-Counter";
CM_ SG_ 818 RRL_Obj17A_DyVxCoVnce "Correlation coefficient of Dy and Ax";
CM_ SG_ 818 RRL_Obj17A_DxVyCoVnce "Correlation coefficient of Dx and Vy";
CM_ SG_ 818 RRL_Obj17A_DyVyCoVnce "Correlation coefficient of Dy and Vy";
CM_ SG_ 818 RRL_Obj17A_VxVyCoVnce "Correlation coefficient of Vx and Vy";
CM_ SG_ 818 RRL_Obj17A_DxAxCoVnce "Correlation coefficient of Dx and Ax";
CM_ SG_ 818 RRL_Obj17A_DyAxCoVnce "Correlation coefficient of Dy and Ax";
CM_ SG_ 818 RRL_Obj17A_VxAxCoVnce "Correlation coefficient of Vx and Ax";
CM_ SG_ 818 RRL_Obj17A_ObjectID "Unique Object ID";
CM_ SG_ 818 RRL_Obj17A_VyAxCoVnce "Correlation coefficient of Vy and Ax";
CM_ SG_ 818 RRL_Obj17A_DxAyCoVnce "Correlation coefficient of Dx and Ay";
CM_ SG_ 818 RRL_Obj17A_DyAyCoVnce "Correlation coefficient of Dy and Ay";
CM_ SG_ 818 RRL_Obj17A_VxAyCoVnce "Correlation coefficient of Vx and Ay";
CM_ SG_ 818 RRL_Obj17A_VyAyCoVnce "Correlation coefficient of Vy and Ay";
CM_ SG_ 818 RRL_Obj17A_AxAyCoVnce "Correlation coefficient of Ax and Ay";
CM_ SG_ 818 RRL_Obj17A_Measured "Object is measured or not";
CM_ SG_ 818 RRL_Obj17A_HeadingYawVnce "Variance of Object heading yaw angle";
CM_ SG_ 818 RRL_Obj17A_Dx "Object position in X direction";
CM_ SG_ 818 RRL_Obj17A_LengthVnce "Variance of Object Length";
CM_ SG_ 818 RRL_Obj17A_WidthVnce "Variance of Object Width";
CM_ SG_ 818 RRL_Obj17A_HeightVnce "Variance of Object Height";
CM_ SG_ 818 RRL_Obj17A_ExistProb "Existence probability of object";
CM_ SG_ 818 RRL_Obj17A_ProbObstacle "Probability of the object being an Obstacle";
CM_ SG_ 818 RRL_Obj17A_ProbNonObstacle "Probability of the object being a Non-Obstacle";
CM_ SG_ 818 RRL_Obj17A_ProbMobileObst "Probability of the object being a mobile obstacle";
CM_ SG_ 818 RRL_Obj17A_FV "SecOC Freshness Value (Profile 1)";
CM_ SG_ 818 RRL_Obj17A_MAC "SecOC MAC (Profile 1)";
CM_ SG_ 818 RRL_Obj17A_Dz "Object position in Z direction";
CM_ SG_ 818 RRL_Obj17A_Dy "Object position in Y direction";
CM_ SG_ 818 RRL_Obj17A_Valid "Object is valid or not";
CM_ SG_ 818 RRL_Obj17A_Vx "Object velocity in X direction";
CM_ SG_ 818 RRL_Obj17A_Vy "Object velocity in Y direction";
CM_ SG_ 818 RRL_Obj17A_Ax "Object acceleration in X direction";
CM_ SG_ 819 RRL_Obj17B_CRC "CRC - Autosar E2E Profile 5";
CM_ SG_ 819 RRL_Obj17B_MAC "SecOC MAC (Profile 1)";
CM_ SG_ 819 RRL_Obj17B_AliveCtr "Alive counter - Autosar E2E Profile 5";
CM_ SG_ 819 RRL_Obj17B_BlockCtr "Block-Counter";
CM_ SG_ 819 RRL_Obj17B_ProbMob4PlusWhl "Probability of a mobile object which has 4 or more wheels";
CM_ SG_ 819 RRL_Obj17B_ProbMob2Whl "Probability of a mobile object being 2-wheels vehicle";
CM_ SG_ 819 RRL_Obj17B_ProbMobPed "Probability of a mobile object being a pedestrian";
CM_ SG_ 819 RRL_Obj17B_Prob4PlusWhlCAR "Probability of a mobile object which has 4 or more wheels--passenger car";
CM_ SG_ 819 RRL_Obj17B_Prob4PlusWhlbHGV "Probability of a mobile object which has 4 or more wheels--commercial vehicle(Turck)";
CM_ SG_ 819 RRL_Obj17B_ProbGNDReflex "Probability of the object being a ground reflex";
CM_ SG_ 819 RRL_Obj17B_ProbStatBarrier "Probability of the object being a stationary road barrier";
CM_ SG_ 819 RRL_Obj17B_ProbStatObst "Probability of the object being a stationary obstacle";
CM_ SG_ 819 RRL_Obj17B_MovingProbability "Object has been observed moving over the ground";
CM_ SG_ 819 RRL_Obj17B_MovingObserved "Object has been observed moving over the ground since it was first detected";
CM_ SG_ 819 RRL_Obj17B_FV "SecOC Freshness Value (Profile 1)";
CM_ SG_ 820 RRL_Obj18A_CRC "CRC - Autosar E2E Profile 5";
CM_ SG_ 820 RRL_Obj18A_Ay "Object acceleration in Y direction";
CM_ SG_ 820 RRL_Obj18A_HeadingYawAngle "Object heading yaw angle";
CM_ SG_ 820 RRL_Obj18A_Length "Object Length";
CM_ SG_ 820 RRL_Obj18A_Width "Object Width";
CM_ SG_ 820 RRL_Obj18A_Height "Object Height";
CM_ SG_ 820 RRL_Obj18A_DxVnce "Variance of object position in X direction";
CM_ SG_ 820 RRL_Obj18A_DyVnce "Variance of object position in Y direction";
CM_ SG_ 820 RRL_Obj18A_DzVnce "Variance of object position in Z direction";
CM_ SG_ 820 RRL_Obj18A_AliveCtr "Alive counter - Autosar E2E Profile 5";
CM_ SG_ 820 RRL_Obj18A_VxVnce "Variance of object velocity in X direction";
CM_ SG_ 820 RRL_Obj18A_VyVnce "Variance of object velocity in Y direction";
CM_ SG_ 820 RRL_Obj18A_AxVnce "Variance of object acceleration in X direction";
CM_ SG_ 820 RRL_Obj18A_AyVnce "Variance of object acceleration in Y direction";
CM_ SG_ 820 RRL_Obj18A_RefPosIndex "Reference Position of the detected objects";
CM_ SG_ 820 RRL_Obj18A_DxDyCoVnce "Correlation coefficient of Dx and Dy";
CM_ SG_ 820 RRL_Obj18A_DxVxCoVnce "Correlation coefficient of Dx and Vx";
CM_ SG_ 820 RRL_Obj18A_BlockCtr "Block-Counter";
CM_ SG_ 820 RRL_Obj18A_DyVxCoVnce "Correlation coefficient of Dy and Ax";
CM_ SG_ 820 RRL_Obj18A_DxVyCoVnce "Correlation coefficient of Dx and Vy";
CM_ SG_ 820 RRL_Obj18A_DyVyCoVnce "Correlation coefficient of Dy and Vy";
CM_ SG_ 820 RRL_Obj18A_VxVyCoVnce "Correlation coefficient of Vx and Vy";
CM_ SG_ 820 RRL_Obj18A_DxAxCoVnce "Correlation coefficient of Dx and Ax";
CM_ SG_ 820 RRL_Obj18A_DyAxCoVnce "Correlation coefficient of Dy and Ax";
CM_ SG_ 820 RRL_Obj18A_VxAxCoVnce "Correlation coefficient of Vx and Ax";
CM_ SG_ 820 RRL_Obj18A_ObjectID "Unique Object ID";
CM_ SG_ 820 RRL_Obj18A_VyAxCoVnce "Correlation coefficient of Vy and Ax";
CM_ SG_ 820 RRL_Obj18A_DxAyCoVnce "Correlation coefficient of Dx and Ay";
CM_ SG_ 820 RRL_Obj18A_DyAyCoVnce "Correlation coefficient of Dy and Ay";
CM_ SG_ 820 RRL_Obj18A_VxAyCoVnce "Correlation coefficient of Vx and Ay";
CM_ SG_ 820 RRL_Obj18A_VyAyCoVnce "Correlation coefficient of Vy and Ay";
CM_ SG_ 820 RRL_Obj18A_AxAyCoVnce "Correlation coefficient of Ax and Ay";
CM_ SG_ 820 RRL_Obj18A_Measured "Object is measured or not";
CM_ SG_ 820 RRL_Obj18A_HeadingYawVnce "Variance of Object heading yaw angle";
CM_ SG_ 820 RRL_Obj18A_Dx "Object position in X direction";
CM_ SG_ 820 RRL_Obj18A_LengthVnce "Variance of Object Length";
CM_ SG_ 820 RRL_Obj18A_WidthVnce "Variance of Object Width";
CM_ SG_ 820 RRL_Obj18A_HeightVnce "Variance of Object Height";
CM_ SG_ 820 RRL_Obj18A_ExistProb "Existence probability of object";
CM_ SG_ 820 RRL_Obj18A_ProbObstacle "Probability of the object being an Obstacle";
CM_ SG_ 820 RRL_Obj18A_ProbNonObstacle "Probability of the object being a Non-Obstacle";
CM_ SG_ 820 RRL_Obj18A_ProbMobileObst "Probability of the object being a mobile obstacle";
CM_ SG_ 820 RRL_Obj18A_FV "SecOC Freshness Value (Profile 1)";
CM_ SG_ 820 RRL_Obj18A_MAC "SecOC MAC (Profile 1)";
CM_ SG_ 820 RRL_Obj18A_Dz "Object position in Z direction";
CM_ SG_ 820 RRL_Obj18A_Dy "Object position in Y direction";
CM_ SG_ 820 RRL_Obj18A_Valid "Object is valid or not";
CM_ SG_ 820 RRL_Obj18A_Vx "Object velocity in X direction";
CM_ SG_ 820 RRL_Obj18A_Vy "Object velocity in Y direction";
CM_ SG_ 820 RRL_Obj18A_Ax "Object acceleration in X direction";
CM_ SG_ 821 RRL_Obj18B_CRC "CRC - Autosar E2E Profile 5";
CM_ SG_ 821 RRL_Obj18B_MAC "SecOC MAC (Profile 1)";
CM_ SG_ 821 RRL_Obj18B_AliveCtr "Alive counter - Autosar E2E Profile 5";
CM_ SG_ 821 RRL_Obj18B_BlockCtr "Block-Counter";
CM_ SG_ 821 RRL_Obj18B_ProbMob4PlusWhl "Probability of a mobile object which has 4 or more wheels";
CM_ SG_ 821 RRL_Obj18B_ProbMob2Whl "Probability of a mobile object being 2-wheels vehicle";
CM_ SG_ 821 RRL_Obj18B_ProbMobPed "Probability of a mobile object being a pedestrian";
CM_ SG_ 821 RRL_Obj18B_Prob4PlusWhlCAR "Probability of a mobile object which has 4 or more wheels--passenger car";
CM_ SG_ 821 RRL_Obj18B_Prob4PlusWhlbHGV "Probability of a mobile object which has 4 or more wheels--commercial vehicle(Turck)";
CM_ SG_ 821 RRL_Obj18B_ProbGNDReflex "Probability of the object being a ground reflex";
CM_ SG_ 821 RRL_Obj18B_ProbStatBarrier "Probability of the object being a stationary road barrier";
CM_ SG_ 821 RRL_Obj18B_ProbStatObst "Probability of the object being a stationary obstacle";
CM_ SG_ 821 RRL_Obj18B_MovingProbability "Object has been observed moving over the ground";
CM_ SG_ 821 RRL_Obj18B_MovingObserved "Object has been observed moving over the ground since it was first detected";
CM_ SG_ 821 RRL_Obj18B_FV "SecOC Freshness Value (Profile 1)";
CM_ SG_ 822 RRL_Obj19A_CRC "CRC - Autosar E2E Profile 5";
CM_ SG_ 822 RRL_Obj19A_Ay "Object acceleration in Y direction";
CM_ SG_ 822 RRL_Obj19A_HeadingYawAngle "Object heading yaw angle";
CM_ SG_ 822 RRL_Obj19A_Length "Object Length";
CM_ SG_ 822 RRL_Obj19A_Width "Object Width";
CM_ SG_ 822 RRL_Obj19A_Height "Object Height";
CM_ SG_ 822 RRL_Obj19A_DxVnce "Variance of object position in X direction";
CM_ SG_ 822 RRL_Obj19A_DyVnce "Variance of object position in Y direction";
CM_ SG_ 822 RRL_Obj19A_DzVnce "Variance of object position in Z direction";
CM_ SG_ 822 RRL_Obj19A_AliveCtr "Alive counter - Autosar E2E Profile 5";
CM_ SG_ 822 RRL_Obj19A_VxVnce "Variance of object velocity in X direction";
CM_ SG_ 822 RRL_Obj19A_VyVnce "Variance of object velocity in Y direction";
CM_ SG_ 822 RRL_Obj19A_AxVnce "Variance of object acceleration in X direction";
CM_ SG_ 822 RRL_Obj19A_AyVnce "Variance of object acceleration in Y direction";
CM_ SG_ 822 RRL_Obj19A_RefPosIndex "Reference Position of the detected objects";
CM_ SG_ 822 RRL_Obj19A_DxDyCoVnce "Correlation coefficient of Dx and Dy";
CM_ SG_ 822 RRL_Obj19A_DxVxCoVnce "Correlation coefficient of Dx and Vx";
CM_ SG_ 822 RRL_Obj19A_BlockCtr "Block-Counter";
CM_ SG_ 822 RRL_Obj19A_DyVxCoVnce "Correlation coefficient of Dy and Ax";
CM_ SG_ 822 RRL_Obj19A_DxVyCoVnce "Correlation coefficient of Dx and Vy";
CM_ SG_ 822 RRL_Obj19A_DyVyCoVnce "Correlation coefficient of Dy and Vy";
CM_ SG_ 822 RRL_Obj19A_VxVyCoVnce "Correlation coefficient of Vx and Vy";
CM_ SG_ 822 RRL_Obj19A_DxAxCoVnce "Correlation coefficient of Dx and Ax";
CM_ SG_ 822 RRL_Obj19A_DyAxCoVnce "Correlation coefficient of Dy and Ax";
CM_ SG_ 822 RRL_Obj19A_VxAxCoVnce "Correlation coefficient of Vx and Ax";
CM_ SG_ 822 RRL_Obj19A_ObjectID "Unique Object ID";
CM_ SG_ 822 RRL_Obj19A_VyAxCoVnce "Correlation coefficient of Vy and Ax";
CM_ SG_ 822 RRL_Obj19A_DxAyCoVnce "Correlation coefficient of Dx and Ay";
CM_ SG_ 822 RRL_Obj19A_DyAyCoVnce "Correlation coefficient of Dy and Ay";
CM_ SG_ 822 RRL_Obj19A_VxAyCoVnce "Correlation coefficient of Vx and Ay";
CM_ SG_ 822 RRL_Obj19A_VyAyCoVnce "Correlation coefficient of Vy and Ay";
CM_ SG_ 822 RRL_Obj19A_AxAyCoVnce "Correlation coefficient of Ax and Ay";
CM_ SG_ 822 RRL_Obj19A_Measured "Object is measured or not";
CM_ SG_ 822 RRL_Obj19A_HeadingYawVnce "Variance of Object heading yaw angle";
CM_ SG_ 822 RRL_Obj19A_Dx "Object position in X direction";
CM_ SG_ 822 RRL_Obj19A_LengthVnce "Variance of Object Length";
CM_ SG_ 822 RRL_Obj19A_WidthVnce "Variance of Object Width";
CM_ SG_ 822 RRL_Obj19A_HeightVnce "Variance of Object Height";
CM_ SG_ 822 RRL_Obj19A_ExistProb "Existence probability of object";
CM_ SG_ 822 RRL_Obj19A_ProbObstacle "Probability of the object being an Obstacle";
CM_ SG_ 822 RRL_Obj19A_ProbNonObstacle "Probability of the object being a Non-Obstacle";
CM_ SG_ 822 RRL_Obj19A_ProbMobileObst "Probability of the object being a mobile obstacle";
CM_ SG_ 822 RRL_Obj19A_FV "SecOC Freshness Value (Profile 1)";
CM_ SG_ 822 RRL_Obj19A_MAC "SecOC MAC (Profile 1)";
CM_ SG_ 822 RRL_Obj19A_Dz "Object position in Z direction";
CM_ SG_ 822 RRL_Obj19A_Dy "Object position in Y direction";
CM_ SG_ 822 RRL_Obj19A_Valid "Object is valid or not";
CM_ SG_ 822 RRL_Obj19A_Vx "Object velocity in X direction";
CM_ SG_ 822 RRL_Obj19A_Vy "Object velocity in Y direction";
CM_ SG_ 822 RRL_Obj19A_Ax "Object acceleration in X direction";
CM_ SG_ 823 RRL_Obj19B_CRC "CRC - Autosar E2E Profile 5";
CM_ SG_ 823 RRL_Obj19B_MAC "SecOC MAC (Profile 1)";
CM_ SG_ 823 RRL_Obj19B_AliveCtr "Alive counter - Autosar E2E Profile 5";
CM_ SG_ 823 RRL_Obj19B_BlockCtr "Block-Counter";
CM_ SG_ 823 RRL_Obj19B_ProbMob4PlusWhl "Probability of a mobile object which has 4 or more wheels";
CM_ SG_ 823 RRL_Obj19B_ProbMob2Whl "Probability of a mobile object being 2-wheels vehicle";
CM_ SG_ 823 RRL_Obj19B_ProbMobPed "Probability of a mobile object being a pedestrian";
CM_ SG_ 823 RRL_Obj19B_Prob4PlusWhlCAR "Probability of a mobile object which has 4 or more wheels--passenger car";
CM_ SG_ 823 RRL_Obj19B_Prob4PlusWhlbHGV "Probability of a mobile object which has 4 or more wheels--commercial vehicle(Turck)";
CM_ SG_ 823 RRL_Obj19B_ProbGNDReflex "Probability of the object being a ground reflex";
CM_ SG_ 823 RRL_Obj19B_ProbStatBarrier "Probability of the object being a stationary road barrier";
CM_ SG_ 823 RRL_Obj19B_ProbStatObst "Probability of the object being a stationary obstacle";
CM_ SG_ 823 RRL_Obj19B_MovingProbability "Object has been observed moving over the ground";
CM_ SG_ 823 RRL_Obj19B_MovingObserved "Object has been observed moving over the ground since it was first detected";
CM_ SG_ 823 RRL_Obj19B_FV "SecOC Freshness Value (Profile 1)";
CM_ SG_ 1280 RRR_Hdr_CRC "CRC - Autosar E2E Profile 5";
CM_ SG_ 1280 RRR_Hdr_YawAngleUpper "Upper angle of the field of view Alimuth";
CM_ SG_ 1280 RRR_Hdr_YawMountAngle "angle between sensor mounting direction and vehicle longitudinal axis, Azimuth";
CM_ SG_ 1280 RRR_Hdr_YawAngleLower "Lower angle of the fied of view Azimuth";
CM_ SG_ 1280 RRR_Hdr_ElevOutOfSpec "The sensor was detected to be out-of-spec due to misalignment in elevation";
CM_ SG_ 1280 RRR_Hdr_PitchMountAngle "angle between sensor mounting direction and vehicle longitudinal axis, Elevation";
CM_ SG_ 1280 RRR_Hdr_PitchAngleLower "Lower angle of the fied of view Elevation";
CM_ SG_ 1280 RRR_Hdr_AliveCtr "Alive counter - Autosar E2E Profile 5";
CM_ SG_ 1280 RRR_Hdr_PitchAngleUpper "Upper angle of the field of view Elevation";
CM_ SG_ 1280 RRR_Hdr_RollMountAngle "Tilt of the mounting sensor";
CM_ SG_ 1280 RRR_Hdr_DetectionRange "Estimated detection range of the sensor";
CM_ SG_ 1280 RRR_Hdr_SensorState "The sensor shall provide its operation state.
In case of multiple errors the most severe state shall be sent.";
CM_ SG_ 1280 RRR_Hdr_FV "SecOC Freshness Value (Profile 1)";
CM_ SG_ 1280 RRR_Hdr_MAC "SecOC MAC (Profile 1)";
CM_ SG_ 1280 RRR_Hdr_BlockCtr "Block-Counter";
CM_ SG_ 1280 RRR_Hdr_ProtocolVersion "Protocol version to be send: 0x0102 = V1.2 (Checked-In Version)";
CM_ SG_ 1280 RRR_Hdr_ObjectCount "number of detected VALID Objects that have been sent to the bus";
CM_ SG_ 1280 RRR_Hdr_TimeSyncFailure "In case of time sync mechanism failure, the Front Radar Ecu time stamp shall be send and the time sync fail flag shall be set to 1.";
CM_ SG_ 1280 RRR_Hdr_ObjectDownSel "the detected number of objects exceeded the number of max. objects that can be transmitted";
CM_ SG_ 1280 RRR_Hdr_MountingPosY "mount offset of sensor in lateral direction relative to mid axis of vehicle";
CM_ SG_ 1280 RRR_Hdr_AbsRefTime "time stamp";
CM_ SG_ 1280 RRR_Hdr_MountingPosZ "mount offset of sensor in elevation direction relative to GROUND";
CM_ SG_ 1280 RRR_Hdr_AziOutOfSpec "The sensor was detected to be out-of-spec due to misalignment in azimuth";
CM_ SG_ 1280 RRR_Hdr_MountingPosX "mount offset of sensor in longitudinal direction relative to rear axis of vehicle";
CM_ SG_ 1296 RRR_Obj00A_CRC "CRC - Autosar E2E Profile 5";
CM_ SG_ 1296 RRR_Obj00A_Ay "Object acceleration in Y direction";
CM_ SG_ 1296 RRR_Obj00A_HeadingYawAngle "Object heading yaw angle";
CM_ SG_ 1296 RRR_Obj00A_Length "Object Length";
CM_ SG_ 1296 RRR_Obj00A_Width "Object Width";
CM_ SG_ 1296 RRR_Obj00A_Height "Object Height";
CM_ SG_ 1296 RRR_Obj00A_DxVnce "Variance of object position in X direction";
CM_ SG_ 1296 RRR_Obj00A_DyVnce "Variance of object position in Y direction";
CM_ SG_ 1296 RRR_Obj00A_DzVnce "Variance of object position in Z direction";
CM_ SG_ 1296 RRR_Obj00A_AliveCtr "Alive counter - Autosar E2E Profile 5";
CM_ SG_ 1296 RRR_Obj00A_VxVnce "Variance of object velocity in X direction";
CM_ SG_ 1296 RRR_Obj00A_VyVnce "Variance of object velocity in Y direction";
CM_ SG_ 1296 RRR_Obj00A_AxVnce "Variance of object acceleration in X direction";
CM_ SG_ 1296 RRR_Obj00A_AyVnce "Variance of object acceleration in Y direction";
CM_ SG_ 1296 RRR_Obj00A_RefPosIndex "Reference Position of the detected objects";
CM_ SG_ 1296 RRR_Obj00A_DxDyCoVnce "Correlation coefficient of Dx and Dy";
CM_ SG_ 1296 RRR_Obj00A_DxVxCoVnce "Correlation coefficient of Dx and Vx";
CM_ SG_ 1296 RRR_Obj00A_BlockCtr "Block-Counter";
CM_ SG_ 1296 RRR_Obj00A_DyVxCoVnce "Correlation coefficient of Dy and Ax";
CM_ SG_ 1296 RRR_Obj00A_DxVyCoVnce "Correlation coefficient of Dx and Vy";
CM_ SG_ 1296 RRR_Obj00A_DyVyCoVnce "Correlation coefficient of Dy and Vy";
CM_ SG_ 1296 RRR_Obj00A_VxVyCoVnce "Correlation coefficient of Vx and Vy";
CM_ SG_ 1296 RRR_Obj00A_DxAxCoVnce "Correlation coefficient of Dx and Ax";
CM_ SG_ 1296 RRR_Obj00A_DyAxCoVnce "Correlation coefficient of Dy and Ax";
CM_ SG_ 1296 RRR_Obj00A_VxAxCoVnce "Correlation coefficient of Vx and Ax";
CM_ SG_ 1296 RRR_Obj00A_ObjectID "Unique Object ID";
CM_ SG_ 1296 RRR_Obj00A_VyAxCoVnce "Correlation coefficient of Vy and Ax";
CM_ SG_ 1296 RRR_Obj00A_DxAyCoVnce "Correlation coefficient of Dx and Ay";
CM_ SG_ 1296 RRR_Obj00A_DyAyCoVnce "Correlation coefficient of Dy and Ay";
CM_ SG_ 1296 RRR_Obj00A_VxAyCoVnce "Correlation coefficient of Vx and Ay";
CM_ SG_ 1296 RRR_Obj00A_VyAyCoVnce "Correlation coefficient of Vy and Ay";
CM_ SG_ 1296 RRR_Obj00A_AxAyCoVnce "Correlation coefficient of Ax and Ay";
CM_ SG_ 1296 RRR_Obj00A_Measured "Object is measured or not";
CM_ SG_ 1296 RRR_Obj00A_HeadingYawVnce "Variance of Object heading yaw angle";
CM_ SG_ 1296 RRR_Obj00A_Dx "Object position in X direction";
CM_ SG_ 1296 RRR_Obj00A_LengthVnce "Variance of Object Length";
CM_ SG_ 1296 RRR_Obj00A_WidthVnce "Variance of Object Width";
CM_ SG_ 1296 RRR_Obj00A_HeightVnce "Variance of Object Height";
CM_ SG_ 1296 RRR_Obj00A_ExistProb "Existence probability of object";
CM_ SG_ 1296 RRR_Obj00A_ProbObstacle "Probability of the object being an Obstacle";
CM_ SG_ 1296 RRR_Obj00A_ProbNonObstacle "Probability of the object being a Non-Obstacle";
CM_ SG_ 1296 RRR_Obj00A_ProbMobileObst "Probability of the object being a mobile obstacle";
CM_ SG_ 1296 RRR_Obj00A_FV "SecOC Freshness Value (Profile 1)";
CM_ SG_ 1296 RRR_Obj00A_MAC "SecOC MAC (Profile 1)";
CM_ SG_ 1296 RRR_Obj00A_Dz "Object position in Z direction";
CM_ SG_ 1296 RRR_Obj00A_Dy "Object position in Y direction";
CM_ SG_ 1296 RRR_Obj00A_Valid "Object is valid or not";
CM_ SG_ 1296 RRR_Obj00A_Vx "Object velocity in X direction";
CM_ SG_ 1296 RRR_Obj00A_Vy "Object velocity in Y direction";
CM_ SG_ 1296 RRR_Obj00A_Ax "Object acceleration in X direction";
CM_ SG_ 1297 RRR_Obj00B_CRC "CRC - Autosar E2E Profile 5";
CM_ SG_ 1297 RRR_Obj00B_MAC "SecOC MAC (Profile 1)";
CM_ SG_ 1297 RRR_Obj00B_AliveCtr "Alive counter - Autosar E2E Profile 5";
CM_ SG_ 1297 RRR_Obj00B_BlockCtr "Block-Counter";
CM_ SG_ 1297 RRR_Obj00B_ProbMob4PlusWhl "Probability of a mobile object which has 4 or more wheels";
CM_ SG_ 1297 RRR_Obj00B_ProbMob2Whl "Probability of a mobile object being 2-wheels vehicle";
CM_ SG_ 1297 RRR_Obj00B_ProbMobPed "Probability of a mobile object being a pedestrian";
CM_ SG_ 1297 RRR_Obj00B_Prob4PlusWhlCAR "Probability of a mobile object which has 4 or more wheels--passenger car";
CM_ SG_ 1297 RRR_Obj00B_Prob4PlusWhlbHGV "Probability of a mobile object which has 4 or more wheels--commercial vehicle(Turck)";
CM_ SG_ 1297 RRR_Obj00B_ProbGNDReflex "Probability of the object being a ground reflex";
CM_ SG_ 1297 RRR_Obj00B_ProbStatBarrier "Probability of the object being a stationary road barrier";
CM_ SG_ 1297 RRR_Obj00B_ProbStatObst "Probability of the object being a stationary obstacle";
CM_ SG_ 1297 RRR_Obj00B_MovingProbability "Object has been observed moving over the ground";
CM_ SG_ 1297 RRR_Obj00B_MovingObserved "Object has been observed moving over the ground since it was first detected";
CM_ SG_ 1297 RRR_Obj00B_FV "SecOC Freshness Value (Profile 1)";
CM_ SG_ 1298 RRR_Obj01A_CRC "CRC - Autosar E2E Profile 5";
CM_ SG_ 1298 RRR_Obj01A_Ay "Object acceleration in Y direction";
CM_ SG_ 1298 RRR_Obj01A_HeadingYawAngle "Object heading yaw angle";
CM_ SG_ 1298 RRR_Obj01A_Length "Object Length";
CM_ SG_ 1298 RRR_Obj01A_Width "Object Width";
CM_ SG_ 1298 RRR_Obj01A_Height "Object Height";
CM_ SG_ 1298 RRR_Obj01A_DxVnce "Variance of object position in X direction";
CM_ SG_ 1298 RRR_Obj01A_DyVnce "Variance of object position in Y direction";
CM_ SG_ 1298 RRR_Obj01A_DzVnce "Variance of object position in Z direction";
CM_ SG_ 1298 RRR_Obj01A_AliveCtr "Alive counter - Autosar E2E Profile 5";
CM_ SG_ 1298 RRR_Obj01A_VxVnce "Variance of object velocity in X direction";
CM_ SG_ 1298 RRR_Obj01A_VyVnce "Variance of object velocity in Y direction";
CM_ SG_ 1298 RRR_Obj01A_AxVnce "Variance of object acceleration in X direction";
CM_ SG_ 1298 RRR_Obj01A_AyVnce "Variance of object acceleration in Y direction";
CM_ SG_ 1298 RRR_Obj01A_RefPosIndex "Reference Position of the detected objects";
CM_ SG_ 1298 RRR_Obj01A_DxDyCoVnce "Correlation coefficient of Dx and Dy";
CM_ SG_ 1298 RRR_Obj01A_DxVxCoVnce "Correlation coefficient of Dx and Vx";
CM_ SG_ 1298 RRR_Obj01A_BlockCtr "Block-Counter";
CM_ SG_ 1298 RRR_Obj01A_DyVxCoVnce "Correlation coefficient of Dy and Ax";
CM_ SG_ 1298 RRR_Obj01A_DxVyCoVnce "Correlation coefficient of Dx and Vy";
CM_ SG_ 1298 RRR_Obj01A_DyVyCoVnce "Correlation coefficient of Dy and Vy";
CM_ SG_ 1298 RRR_Obj01A_VxVyCoVnce "Correlation coefficient of Vx and Vy";
CM_ SG_ 1298 RRR_Obj01A_DxAxCoVnce "Correlation coefficient of Dx and Ax";
CM_ SG_ 1298 RRR_Obj01A_DyAxCoVnce "Correlation coefficient of Dy and Ax";
CM_ SG_ 1298 RRR_Obj01A_VxAxCoVnce "Correlation coefficient of Vx and Ax";
CM_ SG_ 1298 RRR_Obj01A_ObjectID "Unique Object ID";
CM_ SG_ 1298 RRR_Obj01A_VyAxCoVnce "Correlation coefficient of Vy and Ax";
CM_ SG_ 1298 RRR_Obj01A_DxAyCoVnce "Correlation coefficient of Dx and Ay";
CM_ SG_ 1298 RRR_Obj01A_DyAyCoVnce "Correlation coefficient of Dy and Ay";
CM_ SG_ 1298 RRR_Obj01A_VxAyCoVnce "Correlation coefficient of Vx and Ay";
CM_ SG_ 1298 RRR_Obj01A_VyAyCoVnce "Correlation coefficient of Vy and Ay";
CM_ SG_ 1298 RRR_Obj01A_AxAyCoVnce "Correlation coefficient of Ax and Ay";
CM_ SG_ 1298 RRR_Obj01A_Measured "Object is measured or not";
CM_ SG_ 1298 RRR_Obj01A_HeadingYawVnce "Variance of Object heading yaw angle";
CM_ SG_ 1298 RRR_Obj01A_Dx "Object position in X direction";
CM_ SG_ 1298 RRR_Obj01A_LengthVnce "Variance of Object Length";
CM_ SG_ 1298 RRR_Obj01A_WidthVnce "Variance of Object Width";
CM_ SG_ 1298 RRR_Obj01A_HeightVnce "Variance of Object Height";
CM_ SG_ 1298 RRR_Obj01A_ExistProb "Existence probability of object";
CM_ SG_ 1298 RRR_Obj01A_ProbObstacle "Probability of the object being an Obstacle";
CM_ SG_ 1298 RRR_Obj01A_ProbNonObstacle "Probability of the object being a Non-Obstacle";
CM_ SG_ 1298 RRR_Obj01A_ProbMobileObst "Probability of the object being a mobile obstacle";
CM_ SG_ 1298 RRR_Obj01A_FV "SecOC Freshness Value (Profile 1)";
CM_ SG_ 1298 RRR_Obj01A_MAC "SecOC MAC (Profile 1)";
CM_ SG_ 1298 RRR_Obj01A_Dz "Object position in Z direction";
CM_ SG_ 1298 RRR_Obj01A_Dy "Object position in Y direction";
CM_ SG_ 1298 RRR_Obj01A_Valid "Object is valid or not";
CM_ SG_ 1298 RRR_Obj01A_Vx "Object velocity in X direction";
CM_ SG_ 1298 RRR_Obj01A_Vy "Object velocity in Y direction";
CM_ SG_ 1298 RRR_Obj01A_Ax "Object acceleration in X direction";
CM_ SG_ 1299 RRR_Obj01B_CRC "CRC - Autosar E2E Profile 5";
CM_ SG_ 1299 RRR_Obj01B_MAC "SecOC MAC (Profile 1)";
CM_ SG_ 1299 RRR_Obj01B_AliveCtr "Alive counter - Autosar E2E Profile 5";
CM_ SG_ 1299 RRR_Obj01B_BlockCtr "Block-Counter";
CM_ SG_ 1299 RRR_Obj01B_ProbMob4PlusWhl "Probability of a mobile object which has 4 or more wheels";
CM_ SG_ 1299 RRR_Obj01B_ProbMob2Whl "Probability of a mobile object being 2-wheels vehicle";
CM_ SG_ 1299 RRR_Obj01B_ProbMobPed "Probability of a mobile object being a pedestrian";
CM_ SG_ 1299 RRR_Obj01B_Prob4PlusWhlCAR "Probability of a mobile object which has 4 or more wheels--passenger car";
CM_ SG_ 1299 RRR_Obj01B_Prob4PlusWhlbHGV "Probability of a mobile object which has 4 or more wheels--commercial vehicle(Turck)";
CM_ SG_ 1299 RRR_Obj01B_ProbGNDReflex "Probability of the object being a ground reflex";
CM_ SG_ 1299 RRR_Obj01B_ProbStatBarrier "Probability of the object being a stationary road barrier";
CM_ SG_ 1299 RRR_Obj01B_ProbStatObst "Probability of the object being a stationary obstacle";
CM_ SG_ 1299 RRR_Obj01B_MovingProbability "Object has been observed moving over the ground";
CM_ SG_ 1299 RRR_Obj01B_MovingObserved "Object has been observed moving over the ground since it was first detected";
CM_ SG_ 1299 RRR_Obj01B_FV "SecOC Freshness Value (Profile 1)";
CM_ SG_ 1300 RRR_Obj02A_CRC "CRC - Autosar E2E Profile 5";
CM_ SG_ 1300 RRR_Obj02A_Ay "Object acceleration in Y direction";
CM_ SG_ 1300 RRR_Obj02A_HeadingYawAngle "Object heading yaw angle";
CM_ SG_ 1300 RRR_Obj02A_Length "Object Length";
CM_ SG_ 1300 RRR_Obj02A_Width "Object Width";
CM_ SG_ 1300 RRR_Obj02A_Height "Object Height";
CM_ SG_ 1300 RRR_Obj02A_DxVnce "Variance of object position in X direction";
CM_ SG_ 1300 RRR_Obj02A_DyVnce "Variance of object position in Y direction";
CM_ SG_ 1300 RRR_Obj02A_DzVnce "Variance of object position in Z direction";
CM_ SG_ 1300 RRR_Obj02A_AliveCtr "Alive counter - Autosar E2E Profile 5";
CM_ SG_ 1300 RRR_Obj02A_VxVnce "Variance of object velocity in X direction";
CM_ SG_ 1300 RRR_Obj02A_VyVnce "Variance of object velocity in Y direction";
CM_ SG_ 1300 RRR_Obj02A_AxVnce "Variance of object acceleration in X direction";
CM_ SG_ 1300 RRR_Obj02A_AyVnce "Variance of object acceleration in Y direction";
CM_ SG_ 1300 RRR_Obj02A_RefPosIndex "Reference Position of the detected objects";
CM_ SG_ 1300 RRR_Obj02A_DxDyCoVnce "Correlation coefficient of Dx and Dy";
CM_ SG_ 1300 RRR_Obj02A_DxVxCoVnce "Correlation coefficient of Dx and Vx";
CM_ SG_ 1300 RRR_Obj02A_BlockCtr "Block-Counter";
CM_ SG_ 1300 RRR_Obj02A_DyVxCoVnce "Correlation coefficient of Dy and Ax";
CM_ SG_ 1300 RRR_Obj02A_DxVyCoVnce "Correlation coefficient of Dx and Vy";
CM_ SG_ 1300 RRR_Obj02A_DyVyCoVnce "Correlation coefficient of Dy and Vy";
CM_ SG_ 1300 RRR_Obj02A_VxVyCoVnce "Correlation coefficient of Vx and Vy";
CM_ SG_ 1300 RRR_Obj02A_DxAxCoVnce "Correlation coefficient of Dx and Ax";
CM_ SG_ 1300 RRR_Obj02A_DyAxCoVnce "Correlation coefficient of Dy and Ax";
CM_ SG_ 1300 RRR_Obj02A_VxAxCoVnce "Correlation coefficient of Vx and Ax";
CM_ SG_ 1300 RRR_Obj02A_ObjectID "Unique Object ID";
CM_ SG_ 1300 RRR_Obj02A_VyAxCoVnce "Correlation coefficient of Vy and Ax";
CM_ SG_ 1300 RRR_Obj02A_DxAyCoVnce "Correlation coefficient of Dx and Ay";
CM_ SG_ 1300 RRR_Obj02A_DyAyCoVnce "Correlation coefficient of Dy and Ay";
CM_ SG_ 1300 RRR_Obj02A_VxAyCoVnce "Correlation coefficient of Vx and Ay";
CM_ SG_ 1300 RRR_Obj02A_VyAyCoVnce "Correlation coefficient of Vy and Ay";
CM_ SG_ 1300 RRR_Obj02A_AxAyCoVnce "Correlation coefficient of Ax and Ay";
CM_ SG_ 1300 RRR_Obj02A_Measured "Object is measured or not";
CM_ SG_ 1300 RRR_Obj02A_HeadingYawVnce "Variance of Object heading yaw angle";
CM_ SG_ 1300 RRR_Obj02A_Dx "Object position in X direction";
CM_ SG_ 1300 RRR_Obj02A_LengthVnce "Variance of Object Length";
CM_ SG_ 1300 RRR_Obj02A_WidthVnce "Variance of Object Width";
CM_ SG_ 1300 RRR_Obj02A_HeightVnce "Variance of Object Height";
CM_ SG_ 1300 RRR_Obj02A_ExistProb "Existence probability of object";
CM_ SG_ 1300 RRR_Obj02A_ProbObstacle "Probability of the object being an Obstacle";
CM_ SG_ 1300 RRR_Obj02A_ProbNonObstacle "Probability of the object being a Non-Obstacle";
CM_ SG_ 1300 RRR_Obj02A_ProbMobileObst "Probability of the object being a mobile obstacle";
CM_ SG_ 1300 RRR_Obj02A_FV "SecOC Freshness Value (Profile 1)";
CM_ SG_ 1300 RRR_Obj02A_MAC "SecOC MAC (Profile 1)";
CM_ SG_ 1300 RRR_Obj02A_Dz "Object position in Z direction";
CM_ SG_ 1300 RRR_Obj02A_Dy "Object position in Y direction";
CM_ SG_ 1300 RRR_Obj02A_Valid "Object is valid or not";
CM_ SG_ 1300 RRR_Obj02A_Vx "Object velocity in X direction";
CM_ SG_ 1300 RRR_Obj02A_Vy "Object velocity in Y direction";
CM_ SG_ 1300 RRR_Obj02A_Ax "Object acceleration in X direction";
CM_ SG_ 1301 RRR_Obj02B_CRC "CRC - Autosar E2E Profile 5";
CM_ SG_ 1301 RRR_Obj02B_MAC "SecOC MAC (Profile 1)";
CM_ SG_ 1301 RRR_Obj02B_AliveCtr "Alive counter - Autosar E2E Profile 5";
CM_ SG_ 1301 RRR_Obj02B_BlockCtr "Block-Counter";
CM_ SG_ 1301 RRR_Obj02B_ProbMob4PlusWhl "Probability of a mobile object which has 4 or more wheels";
CM_ SG_ 1301 RRR_Obj02B_ProbMob2Whl "Probability of a mobile object being 2-wheels vehicle";
CM_ SG_ 1301 RRR_Obj02B_ProbMobPed "Probability of a mobile object being a pedestrian";
CM_ SG_ 1301 RRR_Obj02B_Prob4PlusWhlCAR "Probability of a mobile object which has 4 or more wheels--passenger car";
CM_ SG_ 1301 RRR_Obj02B_Prob4PlusWhlbHGV "Probability of a mobile object which has 4 or more wheels--commercial vehicle(Turck)";
CM_ SG_ 1301 RRR_Obj02B_ProbGNDReflex "Probability of the object being a ground reflex";
CM_ SG_ 1301 RRR_Obj02B_ProbStatBarrier "Probability of the object being a stationary road barrier";
CM_ SG_ 1301 RRR_Obj02B_ProbStatObst "Probability of the object being a stationary obstacle";
CM_ SG_ 1301 RRR_Obj02B_MovingProbability "Object has been observed moving over the ground";
CM_ SG_ 1301 RRR_Obj02B_MovingObserved "Object has been observed moving over the ground since it was first detected";
CM_ SG_ 1301 RRR_Obj02B_FV "SecOC Freshness Value (Profile 1)";
CM_ SG_ 1302 RRR_Obj03A_CRC "CRC - Autosar E2E Profile 5";
CM_ SG_ 1302 RRR_Obj03A_Ay "Object acceleration in Y direction";
CM_ SG_ 1302 RRR_Obj03A_HeadingYawAngle "Object heading yaw angle";
CM_ SG_ 1302 RRR_Obj03A_Length "Object Length";
CM_ SG_ 1302 RRR_Obj03A_Width "Object Width";
CM_ SG_ 1302 RRR_Obj03A_Height "Object Height";
CM_ SG_ 1302 RRR_Obj03A_DxVnce "Variance of object position in X direction";
CM_ SG_ 1302 RRR_Obj03A_DyVnce "Variance of object position in Y direction";
CM_ SG_ 1302 RRR_Obj03A_DzVnce "Variance of object position in Z direction";
CM_ SG_ 1302 RRR_Obj03A_AliveCtr "Alive counter - Autosar E2E Profile 5";
CM_ SG_ 1302 RRR_Obj03A_VxVnce "Variance of object velocity in X direction";
CM_ SG_ 1302 RRR_Obj03A_VyVnce "Variance of object velocity in Y direction";
CM_ SG_ 1302 RRR_Obj03A_AxVnce "Variance of object acceleration in X direction";
CM_ SG_ 1302 RRR_Obj03A_AyVnce "Variance of object acceleration in Y direction";
CM_ SG_ 1302 RRR_Obj03A_RefPosIndex "Reference Position of the detected objects";
CM_ SG_ 1302 RRR_Obj03A_DxDyCoVnce "Correlation coefficient of Dx and Dy";
CM_ SG_ 1302 RRR_Obj03A_DxVxCoVnce "Correlation coefficient of Dx and Vx";
CM_ SG_ 1302 RRR_Obj03A_BlockCtr "Block-Counter";
CM_ SG_ 1302 RRR_Obj03A_DyVxCoVnce "Correlation coefficient of Dy and Ax";
CM_ SG_ 1302 RRR_Obj03A_DxVyCoVnce "Correlation coefficient of Dx and Vy";
CM_ SG_ 1302 RRR_Obj03A_DyVyCoVnce "Correlation coefficient of Dy and Vy";
CM_ SG_ 1302 RRR_Obj03A_VxVyCoVnce "Correlation coefficient of Vx and Vy";
CM_ SG_ 1302 RRR_Obj03A_DxAxCoVnce "Correlation coefficient of Dx and Ax";
CM_ SG_ 1302 RRR_Obj03A_DyAxCoVnce "Correlation coefficient of Dy and Ax";
CM_ SG_ 1302 RRR_Obj03A_VxAxCoVnce "Correlation coefficient of Vx and Ax";
CM_ SG_ 1302 RRR_Obj03A_ObjectID "Unique Object ID";
CM_ SG_ 1302 RRR_Obj03A_VyAxCoVnce "Correlation coefficient of Vy and Ax";
CM_ SG_ 1302 RRR_Obj03A_DxAyCoVnce "Correlation coefficient of Dx and Ay";
CM_ SG_ 1302 RRR_Obj03A_DyAyCoVnce "Correlation coefficient of Dy and Ay";
CM_ SG_ 1302 RRR_Obj03A_VxAyCoVnce "Correlation coefficient of Vx and Ay";
CM_ SG_ 1302 RRR_Obj03A_VyAyCoVnce "Correlation coefficient of Vy and Ay";
CM_ SG_ 1302 RRR_Obj03A_AxAyCoVnce "Correlation coefficient of Ax and Ay";
CM_ SG_ 1302 RRR_Obj03A_Measured "Object is measured or not";
CM_ SG_ 1302 RRR_Obj03A_HeadingYawVnce "Variance of Object heading yaw angle";
CM_ SG_ 1302 RRR_Obj03A_Dx "Object position in X direction";
CM_ SG_ 1302 RRR_Obj03A_LengthVnce "Variance of Object Length";
CM_ SG_ 1302 RRR_Obj03A_WidthVnce "Variance of Object Width";
CM_ SG_ 1302 RRR_Obj03A_HeightVnce "Variance of Object Height";
CM_ SG_ 1302 RRR_Obj03A_ExistProb "Existence probability of object";
CM_ SG_ 1302 RRR_Obj03A_ProbObstacle "Probability of the object being an Obstacle";
CM_ SG_ 1302 RRR_Obj03A_ProbNonObstacle "Probability of the object being a Non-Obstacle";
CM_ SG_ 1302 RRR_Obj03A_ProbMobileObst "Probability of the object being a mobile obstacle";
CM_ SG_ 1302 RRR_Obj03A_FV "SecOC Freshness Value (Profile 1)";
CM_ SG_ 1302 RRR_Obj03A_MAC "SecOC MAC (Profile 1)";
CM_ SG_ 1302 RRR_Obj03A_Dz "Object position in Z direction";
CM_ SG_ 1302 RRR_Obj03A_Dy "Object position in Y direction";
CM_ SG_ 1302 RRR_Obj03A_Valid "Object is valid or not";
CM_ SG_ 1302 RRR_Obj03A_Vx "Object velocity in X direction";
CM_ SG_ 1302 RRR_Obj03A_Vy "Object velocity in Y direction";
CM_ SG_ 1302 RRR_Obj03A_Ax "Object acceleration in X direction";
CM_ SG_ 1303 RRR_Obj03B_CRC "CRC - Autosar E2E Profile 5";
CM_ SG_ 1303 RRR_Obj03B_MAC "SecOC MAC (Profile 1)";
CM_ SG_ 1303 RRR_Obj03B_AliveCtr "Alive counter - Autosar E2E Profile 5";
CM_ SG_ 1303 RRR_Obj03B_BlockCtr "Block-Counter";
CM_ SG_ 1303 RRR_Obj03B_ProbMob4PlusWhl "Probability of a mobile object which has 4 or more wheels";
CM_ SG_ 1303 RRR_Obj03B_ProbMob2Whl "Probability of a mobile object being 2-wheels vehicle";
CM_ SG_ 1303 RRR_Obj03B_ProbMobPed "Probability of a mobile object being a pedestrian";
CM_ SG_ 1303 RRR_Obj03B_Prob4PlusWhlCAR "Probability of a mobile object which has 4 or more wheels--passenger car";
CM_ SG_ 1303 RRR_Obj03B_Prob4PlusWhlbHGV "Probability of a mobile object which has 4 or more wheels--commercial vehicle(Turck)";
CM_ SG_ 1303 RRR_Obj03B_ProbGNDReflex "Probability of the object being a ground reflex";
CM_ SG_ 1303 RRR_Obj03B_ProbStatBarrier "Probability of the object being a stationary road barrier";
CM_ SG_ 1303 RRR_Obj03B_ProbStatObst "Probability of the object being a stationary obstacle";
CM_ SG_ 1303 RRR_Obj03B_MovingProbability "Object has been observed moving over the ground";
CM_ SG_ 1303 RRR_Obj03B_MovingObserved "Object has been observed moving over the ground since it was first detected";
CM_ SG_ 1303 RRR_Obj03B_FV "SecOC Freshness Value (Profile 1)";
CM_ SG_ 1304 RRR_Obj04A_CRC "CRC - Autosar E2E Profile 5";
CM_ SG_ 1304 RRR_Obj04A_Ay "Object acceleration in Y direction";
CM_ SG_ 1304 RRR_Obj04A_HeadingYawAngle "Object heading yaw angle";
CM_ SG_ 1304 RRR_Obj04A_Length "Object Length";
CM_ SG_ 1304 RRR_Obj04A_Width "Object Width";
CM_ SG_ 1304 RRR_Obj04A_Height "Object Height";
CM_ SG_ 1304 RRR_Obj04A_DxVnce "Variance of object position in X direction";
CM_ SG_ 1304 RRR_Obj04A_DyVnce "Variance of object position in Y direction";
CM_ SG_ 1304 RRR_Obj04A_DzVnce "Variance of object position in Z direction";
CM_ SG_ 1304 RRR_Obj04A_AliveCtr "Alive counter - Autosar E2E Profile 5";
CM_ SG_ 1304 RRR_Obj04A_VxVnce "Variance of object velocity in X direction";
CM_ SG_ 1304 RRR_Obj04A_VyVnce "Variance of object velocity in Y direction";
CM_ SG_ 1304 RRR_Obj04A_AxVnce "Variance of object acceleration in X direction";
CM_ SG_ 1304 RRR_Obj04A_AyVnce "Variance of object acceleration in Y direction";
CM_ SG_ 1304 RRR_Obj04A_RefPosIndex "Reference Position of the detected objects";
CM_ SG_ 1304 RRR_Obj04A_DxDyCoVnce "Correlation coefficient of Dx and Dy";
CM_ SG_ 1304 RRR_Obj04A_DxVxCoVnce "Correlation coefficient of Dx and Vx";
CM_ SG_ 1304 RRR_Obj04A_BlockCtr "Block-Counter";
CM_ SG_ 1304 RRR_Obj04A_DyVxCoVnce "Correlation coefficient of Dy and Ax";
CM_ SG_ 1304 RRR_Obj04A_DxVyCoVnce "Correlation coefficient of Dx and Vy";
CM_ SG_ 1304 RRR_Obj04A_DyVyCoVnce "Correlation coefficient of Dy and Vy";
CM_ SG_ 1304 RRR_Obj04A_VxVyCoVnce "Correlation coefficient of Vx and Vy";
CM_ SG_ 1304 RRR_Obj04A_DxAxCoVnce "Correlation coefficient of Dx and Ax";
CM_ SG_ 1304 RRR_Obj04A_DyAxCoVnce "Correlation coefficient of Dy and Ax";
CM_ SG_ 1304 RRR_Obj04A_VxAxCoVnce "Correlation coefficient of Vx and Ax";
CM_ SG_ 1304 RRR_Obj04A_ObjectID "Unique Object ID";
CM_ SG_ 1304 RRR_Obj04A_VyAxCoVnce "Correlation coefficient of Vy and Ax";
CM_ SG_ 1304 RRR_Obj04A_DxAyCoVnce "Correlation coefficient of Dx and Ay";
CM_ SG_ 1304 RRR_Obj04A_DyAyCoVnce "Correlation coefficient of Dy and Ay";
CM_ SG_ 1304 RRR_Obj04A_VxAyCoVnce "Correlation coefficient of Vx and Ay";
CM_ SG_ 1304 RRR_Obj04A_VyAyCoVnce "Correlation coefficient of Vy and Ay";
CM_ SG_ 1304 RRR_Obj04A_AxAyCoVnce "Correlation coefficient of Ax and Ay";
CM_ SG_ 1304 RRR_Obj04A_Measured "Object is measured or not";
CM_ SG_ 1304 RRR_Obj04A_HeadingYawVnce "Variance of Object heading yaw angle";
CM_ SG_ 1304 RRR_Obj04A_Dx "Object position in X direction";
CM_ SG_ 1304 RRR_Obj04A_LengthVnce "Variance of Object Length";
CM_ SG_ 1304 RRR_Obj04A_WidthVnce "Variance of Object Width";
CM_ SG_ 1304 RRR_Obj04A_HeightVnce "Variance of Object Height";
CM_ SG_ 1304 RRR_Obj04A_ExistProb "Existence probability of object";
CM_ SG_ 1304 RRR_Obj04A_ProbObstacle "Probability of the object being an Obstacle";
CM_ SG_ 1304 RRR_Obj04A_ProbNonObstacle "Probability of the object being a Non-Obstacle";
CM_ SG_ 1304 RRR_Obj04A_ProbMobileObst "Probability of the object being a mobile obstacle";
CM_ SG_ 1304 RRR_Obj04A_FV "SecOC Freshness Value (Profile 1)";
CM_ SG_ 1304 RRR_Obj04A_MAC "SecOC MAC (Profile 1)";
CM_ SG_ 1304 RRR_Obj04A_Dz "Object position in Z direction";
CM_ SG_ 1304 RRR_Obj04A_Dy "Object position in Y direction";
CM_ SG_ 1304 RRR_Obj04A_Valid "Object is valid or not";
CM_ SG_ 1304 RRR_Obj04A_Vx "Object velocity in X direction";
CM_ SG_ 1304 RRR_Obj04A_Vy "Object velocity in Y direction";
CM_ SG_ 1304 RRR_Obj04A_Ax "Object acceleration in X direction";
CM_ SG_ 1305 RRR_Obj04B_CRC "CRC - Autosar E2E Profile 5";
CM_ SG_ 1305 RRR_Obj04B_MAC "SecOC MAC (Profile 1)";
CM_ SG_ 1305 RRR_Obj04B_AliveCtr "Alive counter - Autosar E2E Profile 5";
CM_ SG_ 1305 RRR_Obj04B_BlockCtr "Block-Counter";
CM_ SG_ 1305 RRR_Obj04B_ProbMob4PlusWhl "Probability of a mobile object which has 4 or more wheels";
CM_ SG_ 1305 RRR_Obj04B_ProbMob2Whl "Probability of a mobile object being 2-wheels vehicle";
CM_ SG_ 1305 RRR_Obj04B_ProbMobPed "Probability of a mobile object being a pedestrian";
CM_ SG_ 1305 RRR_Obj04B_Prob4PlusWhlCAR "Probability of a mobile object which has 4 or more wheels--passenger car";
CM_ SG_ 1305 RRR_Obj04B_Prob4PlusWhlbHGV "Probability of a mobile object which has 4 or more wheels--commercial vehicle(Turck)";
CM_ SG_ 1305 RRR_Obj04B_ProbGNDReflex "Probability of the object being a ground reflex";
CM_ SG_ 1305 RRR_Obj04B_ProbStatBarrier "Probability of the object being a stationary road barrier";
CM_ SG_ 1305 RRR_Obj04B_ProbStatObst "Probability of the object being a stationary obstacle";
CM_ SG_ 1305 RRR_Obj04B_MovingProbability "Object has been observed moving over the ground";
CM_ SG_ 1305 RRR_Obj04B_MovingObserved "Object has been observed moving over the ground since it was first detected";
CM_ SG_ 1305 RRR_Obj04B_FV "SecOC Freshness Value (Profile 1)";
CM_ SG_ 1306 RRR_Obj05A_CRC "CRC - Autosar E2E Profile 5";
CM_ SG_ 1306 RRR_Obj05A_Ay "Object acceleration in Y direction";
CM_ SG_ 1306 RRR_Obj05A_HeadingYawAngle "Object heading yaw angle";
CM_ SG_ 1306 RRR_Obj05A_Length "Object Length";
CM_ SG_ 1306 RRR_Obj05A_Width "Object Width";
CM_ SG_ 1306 RRR_Obj05A_Height "Object Height";
CM_ SG_ 1306 RRR_Obj05A_DxVnce "Variance of object position in X direction";
CM_ SG_ 1306 RRR_Obj05A_DyVnce "Variance of object position in Y direction";
CM_ SG_ 1306 RRR_Obj05A_DzVnce "Variance of object position in Z direction";
CM_ SG_ 1306 RRR_Obj05A_AliveCtr "Alive counter - Autosar E2E Profile 5";
CM_ SG_ 1306 RRR_Obj05A_VxVnce "Variance of object velocity in X direction";
CM_ SG_ 1306 RRR_Obj05A_VyVnce "Variance of object velocity in Y direction";
CM_ SG_ 1306 RRR_Obj05A_AxVnce "Variance of object acceleration in X direction";
CM_ SG_ 1306 RRR_Obj05A_AyVnce "Variance of object acceleration in Y direction";
CM_ SG_ 1306 RRR_Obj05A_RefPosIndex "Reference Position of the detected objects";
CM_ SG_ 1306 RRR_Obj05A_DxDyCoVnce "Correlation coefficient of Dx and Dy";
CM_ SG_ 1306 RRR_Obj05A_DxVxCoVnce "Correlation coefficient of Dx and Vx";
CM_ SG_ 1306 RRR_Obj05A_BlockCtr "Block-Counter";
CM_ SG_ 1306 RRR_Obj05A_DyVxCoVnce "Correlation coefficient of Dy and Ax";
CM_ SG_ 1306 RRR_Obj05A_DxVyCoVnce "Correlation coefficient of Dx and Vy";
CM_ SG_ 1306 RRR_Obj05A_DyVyCoVnce "Correlation coefficient of Dy and Vy";
CM_ SG_ 1306 RRR_Obj05A_VxVyCoVnce "Correlation coefficient of Vx and Vy";
CM_ SG_ 1306 RRR_Obj05A_DxAxCoVnce "Correlation coefficient of Dx and Ax";
CM_ SG_ 1306 RRR_Obj05A_DyAxCoVnce "Correlation coefficient of Dy and Ax";
CM_ SG_ 1306 RRR_Obj05A_VxAxCoVnce "Correlation coefficient of Vx and Ax";
CM_ SG_ 1306 RRR_Obj05A_ObjectID "Unique Object ID";
CM_ SG_ 1306 RRR_Obj05A_VyAxCoVnce "Correlation coefficient of Vy and Ax";
CM_ SG_ 1306 RRR_Obj05A_DxAyCoVnce "Correlation coefficient of Dx and Ay";
CM_ SG_ 1306 RRR_Obj05A_DyAyCoVnce "Correlation coefficient of Dy and Ay";
CM_ SG_ 1306 RRR_Obj05A_VxAyCoVnce "Correlation coefficient of Vx and Ay";
CM_ SG_ 1306 RRR_Obj05A_VyAyCoVnce "Correlation coefficient of Vy and Ay";
CM_ SG_ 1306 RRR_Obj05A_AxAyCoVnce "Correlation coefficient of Ax and Ay";
CM_ SG_ 1306 RRR_Obj05A_Measured "Object is measured or not";
CM_ SG_ 1306 RRR_Obj05A_HeadingYawVnce "Variance of Object heading yaw angle";
CM_ SG_ 1306 RRR_Obj05A_Dx "Object position in X direction";
CM_ SG_ 1306 RRR_Obj05A_LengthVnce "Variance of Object Length";
CM_ SG_ 1306 RRR_Obj05A_WidthVnce "Variance of Object Width";
CM_ SG_ 1306 RRR_Obj05A_HeightVnce "Variance of Object Height";
CM_ SG_ 1306 RRR_Obj05A_ExistProb "Existence probability of object";
CM_ SG_ 1306 RRR_Obj05A_ProbObstacle "Probability of the object being an Obstacle";
CM_ SG_ 1306 RRR_Obj05A_ProbNonObstacle "Probability of the object being a Non-Obstacle";
CM_ SG_ 1306 RRR_Obj05A_ProbMobileObst "Probability of the object being a mobile obstacle";
CM_ SG_ 1306 RRR_Obj05A_FV "SecOC Freshness Value (Profile 1)";
CM_ SG_ 1306 RRR_Obj05A_MAC "SecOC MAC (Profile 1)";
CM_ SG_ 1306 RRR_Obj05A_Dz "Object position in Z direction";
CM_ SG_ 1306 RRR_Obj05A_Dy "Object position in Y direction";
CM_ SG_ 1306 RRR_Obj05A_Valid "Object is valid or not";
CM_ SG_ 1306 RRR_Obj05A_Vx "Object velocity in X direction";
CM_ SG_ 1306 RRR_Obj05A_Vy "Object velocity in Y direction";
CM_ SG_ 1306 RRR_Obj05A_Ax "Object acceleration in X direction";
CM_ SG_ 1307 RRR_Obj05B_CRC "CRC - Autosar E2E Profile 5";
CM_ SG_ 1307 RRR_Obj05B_MAC "SecOC MAC (Profile 1)";
CM_ SG_ 1307 RRR_Obj05B_AliveCtr "Alive counter - Autosar E2E Profile 5";
CM_ SG_ 1307 RRR_Obj05B_BlockCtr "Block-Counter";
CM_ SG_ 1307 RRR_Obj05B_ProbMob4PlusWhl "Probability of a mobile object which has 4 or more wheels";
CM_ SG_ 1307 RRR_Obj05B_ProbMob2Whl "Probability of a mobile object being 2-wheels vehicle";
CM_ SG_ 1307 RRR_Obj05B_ProbMobPed "Probability of a mobile object being a pedestrian";
CM_ SG_ 1307 RRR_Obj05B_Prob4PlusWhlCAR "Probability of a mobile object which has 4 or more wheels--passenger car";
CM_ SG_ 1307 RRR_Obj05B_Prob4PlusWhlbHGV "Probability of a mobile object which has 4 or more wheels--commercial vehicle(Turck)";
CM_ SG_ 1307 RRR_Obj05B_ProbGNDReflex "Probability of the object being a ground reflex";
CM_ SG_ 1307 RRR_Obj05B_ProbStatBarrier "Probability of the object being a stationary road barrier";
CM_ SG_ 1307 RRR_Obj05B_ProbStatObst "Probability of the object being a stationary obstacle";
CM_ SG_ 1307 RRR_Obj05B_MovingProbability "Object has been observed moving over the ground";
CM_ SG_ 1307 RRR_Obj05B_MovingObserved "Object has been observed moving over the ground since it was first detected";
CM_ SG_ 1307 RRR_Obj05B_FV "SecOC Freshness Value (Profile 1)";
CM_ SG_ 1308 RRR_Obj06A_CRC "CRC - Autosar E2E Profile 5";
CM_ SG_ 1308 RRR_Obj06A_Ay "Object acceleration in Y direction";
CM_ SG_ 1308 RRR_Obj06A_HeadingYawAngle "Object heading yaw angle";
CM_ SG_ 1308 RRR_Obj06A_Length "Object Length";
CM_ SG_ 1308 RRR_Obj06A_Width "Object Width";
CM_ SG_ 1308 RRR_Obj06A_Height "Object Height";
CM_ SG_ 1308 RRR_Obj06A_DxVnce "Variance of object position in X direction";
CM_ SG_ 1308 RRR_Obj06A_DyVnce "Variance of object position in Y direction";
CM_ SG_ 1308 RRR_Obj06A_DzVnce "Variance of object position in Z direction";
CM_ SG_ 1308 RRR_Obj06A_AliveCtr "Alive counter - Autosar E2E Profile 5";
CM_ SG_ 1308 RRR_Obj06A_VxVnce "Variance of object velocity in X direction";
CM_ SG_ 1308 RRR_Obj06A_VyVnce "Variance of object velocity in Y direction";
CM_ SG_ 1308 RRR_Obj06A_AxVnce "Variance of object acceleration in X direction";
CM_ SG_ 1308 RRR_Obj06A_AyVnce "Variance of object acceleration in Y direction";
CM_ SG_ 1308 RRR_Obj06A_RefPosIndex "Reference Position of the detected objects";
CM_ SG_ 1308 RRR_Obj06A_DxDyCoVnce "Correlation coefficient of Dx and Dy";
CM_ SG_ 1308 RRR_Obj06A_DxVxCoVnce "Correlation coefficient of Dx and Vx";
CM_ SG_ 1308 RRR_Obj06A_BlockCtr "Block-Counter";
CM_ SG_ 1308 RRR_Obj06A_DyVxCoVnce "Correlation coefficient of Dy and Ax";
CM_ SG_ 1308 RRR_Obj06A_DxVyCoVnce "Correlation coefficient of Dx and Vy";
CM_ SG_ 1308 RRR_Obj06A_DyVyCoVnce "Correlation coefficient of Dy and Vy";
CM_ SG_ 1308 RRR_Obj06A_VxVyCoVnce "Correlation coefficient of Vx and Vy";
CM_ SG_ 1308 RRR_Obj06A_DxAxCoVnce "Correlation coefficient of Dx and Ax";
CM_ SG_ 1308 RRR_Obj06A_DyAxCoVnce "Correlation coefficient of Dy and Ax";
CM_ SG_ 1308 RRR_Obj06A_VxAxCoVnce "Correlation coefficient of Vx and Ax";
CM_ SG_ 1308 RRR_Obj06A_ObjectID "Unique Object ID";
CM_ SG_ 1308 RRR_Obj06A_VyAxCoVnce "Correlation coefficient of Vy and Ax";
CM_ SG_ 1308 RRR_Obj06A_DxAyCoVnce "Correlation coefficient of Dx and Ay";
CM_ SG_ 1308 RRR_Obj06A_DyAyCoVnce "Correlation coefficient of Dy and Ay";
CM_ SG_ 1308 RRR_Obj06A_VxAyCoVnce "Correlation coefficient of Vx and Ay";
CM_ SG_ 1308 RRR_Obj06A_VyAyCoVnce "Correlation coefficient of Vy and Ay";
CM_ SG_ 1308 RRR_Obj06A_AxAyCoVnce "Correlation coefficient of Ax and Ay";
CM_ SG_ 1308 RRR_Obj06A_Measured "Object is measured or not";
CM_ SG_ 1308 RRR_Obj06A_HeadingYawVnce "Variance of Object heading yaw angle";
CM_ SG_ 1308 RRR_Obj06A_Dx "Object position in X direction";
CM_ SG_ 1308 RRR_Obj06A_LengthVnce "Variance of Object Length";
CM_ SG_ 1308 RRR_Obj06A_WidthVnce "Variance of Object Width";
CM_ SG_ 1308 RRR_Obj06A_HeightVnce "Variance of Object Height";
CM_ SG_ 1308 RRR_Obj06A_ExistProb "Existence probability of object";
CM_ SG_ 1308 RRR_Obj06A_ProbObstacle "Probability of the object being an Obstacle";
CM_ SG_ 1308 RRR_Obj06A_ProbNonObstacle "Probability of the object being a Non-Obstacle";
CM_ SG_ 1308 RRR_Obj06A_ProbMobileObst "Probability of the object being a mobile obstacle";
CM_ SG_ 1308 RRR_Obj06A_FV "SecOC Freshness Value (Profile 1)";
CM_ SG_ 1308 RRR_Obj06A_MAC "SecOC MAC (Profile 1)";
CM_ SG_ 1308 RRR_Obj06A_Dz "Object position in Z direction";
CM_ SG_ 1308 RRR_Obj06A_Dy "Object position in Y direction";
CM_ SG_ 1308 RRR_Obj06A_Valid "Object is valid or not";
CM_ SG_ 1308 RRR_Obj06A_Vx "Object velocity in X direction";
CM_ SG_ 1308 RRR_Obj06A_Vy "Object velocity in Y direction";
CM_ SG_ 1308 RRR_Obj06A_Ax "Object acceleration in X direction";
CM_ SG_ 1309 RRR_Obj06B_CRC "CRC - Autosar E2E Profile 5";
CM_ SG_ 1309 RRR_Obj06B_MAC "SecOC MAC (Profile 1)";
CM_ SG_ 1309 RRR_Obj06B_AliveCtr "Alive counter - Autosar E2E Profile 5";
CM_ SG_ 1309 RRR_Obj06B_BlockCtr "Block-Counter";
CM_ SG_ 1309 RRR_Obj06B_ProbMob4PlusWhl "Probability of a mobile object which has 4 or more wheels";
CM_ SG_ 1309 RRR_Obj06B_ProbMob2Whl "Probability of a mobile object being 2-wheels vehicle";
CM_ SG_ 1309 RRR_Obj06B_ProbMobPed "Probability of a mobile object being a pedestrian";
CM_ SG_ 1309 RRR_Obj06B_Prob4PlusWhlCAR "Probability of a mobile object which has 4 or more wheels--passenger car";
CM_ SG_ 1309 RRR_Obj06B_Prob4PlusWhlbHGV "Probability of a mobile object which has 4 or more wheels--commercial vehicle(Turck)";
CM_ SG_ 1309 RRR_Obj06B_ProbGNDReflex "Probability of the object being a ground reflex";
CM_ SG_ 1309 RRR_Obj06B_ProbStatBarrier "Probability of the object being a stationary road barrier";
CM_ SG_ 1309 RRR_Obj06B_ProbStatObst "Probability of the object being a stationary obstacle";
CM_ SG_ 1309 RRR_Obj06B_MovingProbability "Object has been observed moving over the ground";
CM_ SG_ 1309 RRR_Obj06B_MovingObserved "Object has been observed moving over the ground since it was first detected";
CM_ SG_ 1309 RRR_Obj06B_FV "SecOC Freshness Value (Profile 1)";
BA_DEF_ BO_  "GenMsgCycleTime" INT 0 65535;
BA_DEF_ BO_  "GenMsgSendType" ENUM  "Event","Cycle";
BA_DEF_ SG_  "GenSigStartValue" FLOAT 0 100000000000;
BA_DEF_ BO_  "CANFD_BRS" ENUM  "0","1";
BA_DEF_ BO_  "VFrameFormat" ENUM  "StandardCAN","ExtendedCAN","reserved","reserved","reserved","reserved","reserved","reserved","reserved","reserved","reserved","reserved","reserved","reserved","StandardCAN_FD","ExtendedCAN_FD";
BA_DEF_DEF_  "GenMsgCycleTime" 0;
BA_DEF_DEF_  "GenMsgSendType" "";
BA_DEF_DEF_  "GenSigStartValue" 0;
BA_DEF_DEF_  "CANFD_BRS" "1";
BA_DEF_DEF_  "VFrameFormat" "StandardCAN";
BA_ "GenMsgSendType" BO_ 810 0;
BA_ "VFrameFormat" BO_ 810 14;
BA_ "GenMsgSendType" BO_ 811 0;
BA_ "VFrameFormat" BO_ 811 14;
BA_ "GenMsgSendType" BO_ 812 0;
BA_ "VFrameFormat" BO_ 812 14;
BA_ "GenMsgSendType" BO_ 813 0;
BA_ "VFrameFormat" BO_ 813 14;
BA_ "GenMsgSendType" BO_ 814 0;
BA_ "VFrameFormat" BO_ 814 14;
BA_ "GenMsgSendType" BO_ 815 0;
BA_ "VFrameFormat" BO_ 815 14;
BA_ "GenMsgSendType" BO_ 816 0;
BA_ "VFrameFormat" BO_ 816 14;
BA_ "GenMsgSendType" BO_ 817 0;
BA_ "VFrameFormat" BO_ 817 14;
BA_ "GenMsgSendType" BO_ 818 0;
BA_ "VFrameFormat" BO_ 818 14;
BA_ "GenMsgSendType" BO_ 819 0;
BA_ "VFrameFormat" BO_ 819 14;
BA_ "GenMsgSendType" BO_ 820 0;
BA_ "VFrameFormat" BO_ 820 14;
BA_ "GenMsgSendType" BO_ 821 0;
BA_ "VFrameFormat" BO_ 821 14;
BA_ "GenMsgSendType" BO_ 822 0;
BA_ "VFrameFormat" BO_ 822 14;
BA_ "GenMsgSendType" BO_ 823 0;
BA_ "VFrameFormat" BO_ 823 14;
BA_ "GenMsgSendType" BO_ 1280 0;
BA_ "VFrameFormat" BO_ 1280 14;
BA_ "GenMsgSendType" BO_ 1296 0;
BA_ "VFrameFormat" BO_ 1296 14;
BA_ "GenMsgSendType" BO_ 1297 0;
BA_ "VFrameFormat" BO_ 1297 14;
BA_ "GenMsgSendType" BO_ 1298 0;
BA_ "VFrameFormat" BO_ 1298 14;
BA_ "GenMsgSendType" BO_ 1299 0;
BA_ "VFrameFormat" BO_ 1299 14;
BA_ "GenMsgSendType" BO_ 1300 0;
BA_ "VFrameFormat" BO_ 1300 14;
BA_ "GenMsgSendType" BO_ 1301 0;
BA_ "VFrameFormat" BO_ 1301 14;
BA_ "GenMsgSendType" BO_ 1302 0;
BA_ "VFrameFormat" BO_ 1302 14;
BA_ "GenMsgSendType" BO_ 1303 0;
BA_ "VFrameFormat" BO_ 1303 14;
BA_ "GenMsgSendType" BO_ 1304 0;
BA_ "VFrameFormat" BO_ 1304 14;
BA_ "GenMsgSendType" BO_ 1305 0;
BA_ "VFrameFormat" BO_ 1305 14;
BA_ "GenMsgSendType" BO_ 1306 0;
BA_ "VFrameFormat" BO_ 1306 14;
BA_ "GenMsgSendType" BO_ 1307 0;
BA_ "VFrameFormat" BO_ 1307 14;
BA_ "GenMsgSendType" BO_ 1308 0;
BA_ "VFrameFormat" BO_ 1308 14;
BA_ "GenMsgSendType" BO_ 1309 0;
BA_ "VFrameFormat" BO_ 1309 14;
BA_ "GenSigStartValue" SG_ 810 RRL_Obj13A_Ay 256;
BA_ "GenSigStartValue" SG_ 810 RRL_Obj13A_HeadingYawAngle 256;
BA_ "GenSigStartValue" SG_ 810 RRL_Obj13A_Dx 4096;
BA_ "GenSigStartValue" SG_ 810 RRL_Obj13A_Dz 20;
BA_ "GenSigStartValue" SG_ 810 RRL_Obj13A_Dy 1024;
BA_ "GenSigStartValue" SG_ 810 RRL_Obj13A_Vx 2048;
BA_ "GenSigStartValue" SG_ 810 RRL_Obj13A_Vy 512;
BA_ "GenSigStartValue" SG_ 810 RRL_Obj13A_Ax 512;
BA_ "GenSigStartValue" SG_ 812 RRL_Obj14A_Ay 256;
BA_ "GenSigStartValue" SG_ 812 RRL_Obj14A_HeadingYawAngle 256;
BA_ "GenSigStartValue" SG_ 812 RRL_Obj14A_Dx 4096;
BA_ "GenSigStartValue" SG_ 812 RRL_Obj14A_Dz 20;
BA_ "GenSigStartValue" SG_ 812 RRL_Obj14A_Dy 1024;
BA_ "GenSigStartValue" SG_ 812 RRL_Obj14A_Vx 2048;
BA_ "GenSigStartValue" SG_ 812 RRL_Obj14A_Vy 512;
BA_ "GenSigStartValue" SG_ 812 RRL_Obj14A_Ax 512;
BA_ "GenSigStartValue" SG_ 814 RRL_Obj15A_Ay 256;
BA_ "GenSigStartValue" SG_ 814 RRL_Obj15A_HeadingYawAngle 256;
BA_ "GenSigStartValue" SG_ 814 RRL_Obj15A_Dx 4096;
BA_ "GenSigStartValue" SG_ 814 RRL_Obj15A_Dz 20;
BA_ "GenSigStartValue" SG_ 814 RRL_Obj15A_Dy 1024;
BA_ "GenSigStartValue" SG_ 814 RRL_Obj15A_Vx 2048;
BA_ "GenSigStartValue" SG_ 814 RRL_Obj15A_Vy 512;
BA_ "GenSigStartValue" SG_ 814 RRL_Obj15A_Ax 512;
BA_ "GenSigStartValue" SG_ 816 RRL_Obj16A_Ay 256;
BA_ "GenSigStartValue" SG_ 816 RRL_Obj16A_HeadingYawAngle 256;
BA_ "GenSigStartValue" SG_ 816 RRL_Obj16A_Dx 4096;
BA_ "GenSigStartValue" SG_ 816 RRL_Obj16A_Dz 20;
BA_ "GenSigStartValue" SG_ 816 RRL_Obj16A_Dy 1024;
BA_ "GenSigStartValue" SG_ 816 RRL_Obj16A_Vx 2048;
BA_ "GenSigStartValue" SG_ 816 RRL_Obj16A_Vy 512;
BA_ "GenSigStartValue" SG_ 816 RRL_Obj16A_Ax 512;
BA_ "GenSigStartValue" SG_ 818 RRL_Obj17A_Ay 256;
BA_ "GenSigStartValue" SG_ 818 RRL_Obj17A_HeadingYawAngle 256;
BA_ "GenSigStartValue" SG_ 818 RRL_Obj17A_Dx 4096;
BA_ "GenSigStartValue" SG_ 818 RRL_Obj17A_Dz 20;
BA_ "GenSigStartValue" SG_ 818 RRL_Obj17A_Dy 1024;
BA_ "GenSigStartValue" SG_ 818 RRL_Obj17A_Vx 2048;
BA_ "GenSigStartValue" SG_ 818 RRL_Obj17A_Vy 512;
BA_ "GenSigStartValue" SG_ 818 RRL_Obj17A_Ax 512;
BA_ "GenSigStartValue" SG_ 820 RRL_Obj18A_Ay 256;
BA_ "GenSigStartValue" SG_ 820 RRL_Obj18A_HeadingYawAngle 256;
BA_ "GenSigStartValue" SG_ 820 RRL_Obj18A_Dx 4096;
BA_ "GenSigStartValue" SG_ 820 RRL_Obj18A_Dz 20;
BA_ "GenSigStartValue" SG_ 820 RRL_Obj18A_Dy 1024;
BA_ "GenSigStartValue" SG_ 820 RRL_Obj18A_Vx 2048;
BA_ "GenSigStartValue" SG_ 820 RRL_Obj18A_Vy 512;
BA_ "GenSigStartValue" SG_ 820 RRL_Obj18A_Ax 512;
BA_ "GenSigStartValue" SG_ 822 RRL_Obj19A_Ay 256;
BA_ "GenSigStartValue" SG_ 822 RRL_Obj19A_HeadingYawAngle 256;
BA_ "GenSigStartValue" SG_ 822 RRL_Obj19A_Dx 4096;
BA_ "GenSigStartValue" SG_ 822 RRL_Obj19A_Dz 20;
BA_ "GenSigStartValue" SG_ 822 RRL_Obj19A_Dy 1024;
BA_ "GenSigStartValue" SG_ 822 RRL_Obj19A_Vx 2048;
BA_ "GenSigStartValue" SG_ 822 RRL_Obj19A_Vy 512;
BA_ "GenSigStartValue" SG_ 822 RRL_Obj19A_Ax 512;
BA_ "GenSigStartValue" SG_ 1280 RRR_Hdr_YawAngleUpper 16384;
BA_ "GenSigStartValue" SG_ 1280 RRR_Hdr_YawMountAngle 32768;
BA_ "GenSigStartValue" SG_ 1280 RRR_Hdr_YawAngleLower 16384;
BA_ "GenSigStartValue" SG_ 1280 RRR_Hdr_PitchMountAngle 2048;
BA_ "GenSigStartValue" SG_ 1280 RRR_Hdr_PitchAngleLower 2048;
BA_ "GenSigStartValue" SG_ 1280 RRR_Hdr_PitchAngleUpper 2048;
BA_ "GenSigStartValue" SG_ 1280 RRR_Hdr_RollMountAngle 2048;
BA_ "GenSigStartValue" SG_ 1280 RRR_Hdr_MountingPosY 128;
BA_ "GenSigStartValue" SG_ 1280 RRR_Hdr_MountingPosX 256;
BA_ "GenSigStartValue" SG_ 1296 RRR_Obj00A_Ay 256;
BA_ "GenSigStartValue" SG_ 1296 RRR_Obj00A_HeadingYawAngle 256;
BA_ "GenSigStartValue" SG_ 1296 RRR_Obj00A_Dx 4096;
BA_ "GenSigStartValue" SG_ 1296 RRR_Obj00A_Dz 20;
BA_ "GenSigStartValue" SG_ 1296 RRR_Obj00A_Dy 1024;
BA_ "GenSigStartValue" SG_ 1296 RRR_Obj00A_Vx 2048;
BA_ "GenSigStartValue" SG_ 1296 RRR_Obj00A_Vy 512;
BA_ "GenSigStartValue" SG_ 1296 RRR_Obj00A_Ax 512;
BA_ "GenSigStartValue" SG_ 1298 RRR_Obj01A_Ay 256;
BA_ "GenSigStartValue" SG_ 1298 RRR_Obj01A_HeadingYawAngle 256;
BA_ "GenSigStartValue" SG_ 1298 RRR_Obj01A_Dx 4096;
BA_ "GenSigStartValue" SG_ 1298 RRR_Obj01A_Dz 20;
BA_ "GenSigStartValue" SG_ 1298 RRR_Obj01A_Dy 1024;
BA_ "GenSigStartValue" SG_ 1298 RRR_Obj01A_Vx 2048;
BA_ "GenSigStartValue" SG_ 1298 RRR_Obj01A_Vy 512;
BA_ "GenSigStartValue" SG_ 1298 RRR_Obj01A_Ax 512;
BA_ "GenSigStartValue" SG_ 1300 RRR_Obj02A_Ay 256;
BA_ "GenSigStartValue" SG_ 1300 RRR_Obj02A_HeadingYawAngle 256;
BA_ "GenSigStartValue" SG_ 1300 RRR_Obj02A_Dx 4096;
BA_ "GenSigStartValue" SG_ 1300 RRR_Obj02A_Dz 20;
BA_ "GenSigStartValue" SG_ 1300 RRR_Obj02A_Dy 1024;
BA_ "GenSigStartValue" SG_ 1300 RRR_Obj02A_Vx 2048;
BA_ "GenSigStartValue" SG_ 1300 RRR_Obj02A_Vy 512;
BA_ "GenSigStartValue" SG_ 1300 RRR_Obj02A_Ax 512;
BA_ "GenSigStartValue" SG_ 1302 RRR_Obj03A_Ay 256;
BA_ "GenSigStartValue" SG_ 1302 RRR_Obj03A_HeadingYawAngle 256;
BA_ "GenSigStartValue" SG_ 1302 RRR_Obj03A_Dx 4096;
BA_ "GenSigStartValue" SG_ 1302 RRR_Obj03A_Dz 20;
BA_ "GenSigStartValue" SG_ 1302 RRR_Obj03A_Dy 1024;
BA_ "GenSigStartValue" SG_ 1302 RRR_Obj03A_Vx 2048;
BA_ "GenSigStartValue" SG_ 1302 RRR_Obj03A_Vy 512;
BA_ "GenSigStartValue" SG_ 1302 RRR_Obj03A_Ax 512;
BA_ "GenSigStartValue" SG_ 1304 RRR_Obj04A_Ay 256;
BA_ "GenSigStartValue" SG_ 1304 RRR_Obj04A_HeadingYawAngle 256;
BA_ "GenSigStartValue" SG_ 1304 RRR_Obj04A_Dx 4096;
BA_ "GenSigStartValue" SG_ 1304 RRR_Obj04A_Dz 20;
BA_ "GenSigStartValue" SG_ 1304 RRR_Obj04A_Dy 1024;
BA_ "GenSigStartValue" SG_ 1304 RRR_Obj04A_Vx 2048;
BA_ "GenSigStartValue" SG_ 1304 RRR_Obj04A_Vy 512;
BA_ "GenSigStartValue" SG_ 1304 RRR_Obj04A_Ax 512;
BA_ "GenSigStartValue" SG_ 1306 RRR_Obj05A_Ay 256;
BA_ "GenSigStartValue" SG_ 1306 RRR_Obj05A_HeadingYawAngle 256;
BA_ "GenSigStartValue" SG_ 1306 RRR_Obj05A_Dx 4096;
BA_ "GenSigStartValue" SG_ 1306 RRR_Obj05A_Dz 20;
BA_ "GenSigStartValue" SG_ 1306 RRR_Obj05A_Dy 1024;
BA_ "GenSigStartValue" SG_ 1306 RRR_Obj05A_Vx 2048;
BA_ "GenSigStartValue" SG_ 1306 RRR_Obj05A_Vy 512;
BA_ "GenSigStartValue" SG_ 1306 RRR_Obj05A_Ax 512;
BA_ "GenSigStartValue" SG_ 1308 RRR_Obj06A_Ay 256;
BA_ "GenSigStartValue" SG_ 1308 RRR_Obj06A_HeadingYawAngle 256;
BA_ "GenSigStartValue" SG_ 1308 RRR_Obj06A_Dx 4096;
BA_ "GenSigStartValue" SG_ 1308 RRR_Obj06A_Dz 20;
BA_ "GenSigStartValue" SG_ 1308 RRR_Obj06A_Dy 1024;
BA_ "GenSigStartValue" SG_ 1308 RRR_Obj06A_Vx 2048;
BA_ "GenSigStartValue" SG_ 1308 RRR_Obj06A_Vy 512;
BA_ "GenSigStartValue" SG_ 1308 RRR_Obj06A_Ax 512;
VAL_ 810 RRL_Obj13A_RefPosIndex 0 "Front corner left" 1 "Front center" 2 "Front corner right" 3 "Front wheelcase left" 4 "Front wheelcase right" 5 "Side middle left" 6 "Side middle right" 7 "Rear wheelcase left" 8 "Rear wheelcase right" 9 "Rear corner left" 10 "Rear center" 11 "Rear corner right" 12 "Object center" 13 "Rear wheelcase center" 14 "Front wheelcase center" 15 "Invalid" ;
VAL_ 810 RRL_Obj13A_Measured 0 "not measured" 1 "measured" ;
VAL_ 810 RRL_Obj13A_Valid 0 "not valid" 1 "valid" ;
VAL_ 812 RRL_Obj14A_RefPosIndex 0 "Front corner left" 1 "Front center" 2 "Front corner right" 3 "Front wheelcase left" 4 "Front wheelcase right" 5 "Side middle left" 6 "Side middle right" 7 "Rear wheelcase left" 8 "Rear wheelcase right" 9 "Rear corner left" 10 "Rear center" 11 "Rear corner right" 12 "Object center" 13 "Rear wheelcase center" 14 "Front wheelcase center" 15 "Invalid" ;
VAL_ 812 RRL_Obj14A_Measured 0 "not measured" 1 "measured" ;
VAL_ 812 RRL_Obj14A_Valid 0 "not valid" 1 "valid" ;
VAL_ 814 RRL_Obj15A_RefPosIndex 0 "Front corner left" 1 "Front center" 2 "Front corner right" 3 "Front wheelcase left" 4 "Front wheelcase right" 5 "Side middle left" 6 "Side middle right" 7 "Rear wheelcase left" 8 "Rear wheelcase right" 9 "Rear corner left" 10 "Rear center" 11 "Rear corner right" 12 "Object center" 13 "Rear wheelcase center" 14 "Front wheelcase center" 15 "Invalid" ;
VAL_ 814 RRL_Obj15A_Measured 0 "not measured" 1 "measured" ;
VAL_ 814 RRL_Obj15A_Valid 0 "not valid" 1 "valid" ;
VAL_ 816 RRL_Obj16A_RefPosIndex 0 "Front corner left" 1 "Front center" 2 "Front corner right" 3 "Front wheelcase left" 4 "Front wheelcase right" 5 "Side middle left" 6 "Side middle right" 7 "Rear wheelcase left" 8 "Rear wheelcase right" 9 "Rear corner left" 10 "Rear center" 11 "Rear corner right" 12 "Object center" 13 "Rear wheelcase center" 14 "Front wheelcase center" 15 "Invalid" ;
VAL_ 816 RRL_Obj16A_Measured 0 "not measured" 1 "measured" ;
VAL_ 816 RRL_Obj16A_Valid 0 "not valid" 1 "valid" ;
VAL_ 818 RRL_Obj17A_RefPosIndex 0 "Front corner left" 1 "Front center" 2 "Front corner right" 3 "Front wheelcase left" 4 "Front wheelcase right" 5 "Side middle left" 6 "Side middle right" 7 "Rear wheelcase left" 8 "Rear wheelcase right" 9 "Rear corner left" 10 "Rear center" 11 "Rear corner right" 12 "Object center" 13 "Rear wheelcase center" 14 "Front wheelcase center" 15 "Invalid" ;
VAL_ 818 RRL_Obj17A_Measured 0 "not measured" 1 "measured" ;
VAL_ 818 RRL_Obj17A_Valid 0 "not valid" 1 "valid" ;
VAL_ 820 RRL_Obj18A_RefPosIndex 0 "Front corner left" 1 "Front center" 2 "Front corner right" 3 "Front wheelcase left" 4 "Front wheelcase right" 5 "Side middle left" 6 "Side middle right" 7 "Rear wheelcase left" 8 "Rear wheelcase right" 9 "Rear corner left" 10 "Rear center" 11 "Rear corner right" 12 "Object center" 13 "Rear wheelcase center" 14 "Front wheelcase center" 15 "Invalid" ;
VAL_ 820 RRL_Obj18A_Measured 0 "not measured" 1 "measured" ;
VAL_ 820 RRL_Obj18A_Valid 0 "not valid" 1 "valid" ;
VAL_ 822 RRL_Obj19A_RefPosIndex 0 "Front corner left" 1 "Front center" 2 "Front corner right" 3 "Front wheelcase left" 4 "Front wheelcase right" 5 "Side middle left" 6 "Side middle right" 7 "Rear wheelcase left" 8 "Rear wheelcase right" 9 "Rear corner left" 10 "Rear center" 11 "Rear corner right" 12 "Object center" 13 "Rear wheelcase center" 14 "Front wheelcase center" 15 "Invalid" ;
VAL_ 822 RRL_Obj19A_Measured 0 "not measured" 1 "measured" ;
VAL_ 822 RRL_Obj19A_Valid 0 "not valid" 1 "valid" ;
VAL_ 1280 RRR_Hdr_ElevOutOfSpec 0 "In Spec Elevation Alignment" 1 "Out of spec Elevation Alignement" ;
VAL_ 1280 RRR_Hdr_SensorState 0 "SENSOR FULLY OPERATIONAL" 1 "HW MALFUNCTION" 2 "DSP ISSUES" 3 "COMMUNICATION ERRORS" 4 "MISALIGNMENT (OUT OF SPEC)" 5 "SENSOR BLIDNESS DETECTED" 6 "SENSOR DISTUBED" 7 "OTHER ISSUES" 8 "RESERVED1" 9 "RESERVED2" 10 "RESERVED3" 11 "RESERVED4" 12 "RESERVED5" 13 "RESERVED6" 14 "RESERVED7" 15 "INVALID" ;
VAL_ 1280 RRR_Hdr_TimeSyncFailure 0 "TIMESYNC_NO_FAILURE" 1 "TIMESYNC_FAILURE" ;
VAL_ 1280 RRR_Hdr_ObjectDownSel 0 "no downselection" 1 "downselected" ;
VAL_ 1280 RRR_Hdr_AziOutOfSpec 0 "In spec Azimuth Alignemdn" 1 "Out of spec Azimuth Alignement" ;
VAL_ 1296 RRR_Obj00A_RefPosIndex 0 "Front corner left" 1 "Front center" 2 "Front corner right" 3 "Front wheelcase left" 4 "Front wheelcase right" 5 "Side middle left" 6 "Side middle right" 7 "Rear wheelcase left" 8 "Rear wheelcase right" 9 "Rear corner left" 10 "Rear center" 11 "Rear corner right" 12 "Object center" 13 "Rear wheelcase center" 14 "Front wheelcase center" 15 "Invalid" ;
VAL_ 1296 RRR_Obj00A_Measured 0 "not measured" 1 "measured" ;
VAL_ 1296 RRR_Obj00A_Valid 0 "not valid" 1 "valid" ;
VAL_ 1298 RRR_Obj01A_RefPosIndex 0 "Front corner left" 1 "Front center" 2 "Front corner right" 3 "Front wheelcase left" 4 "Front wheelcase right" 5 "Side middle left" 6 "Side middle right" 7 "Rear wheelcase left" 8 "Rear wheelcase right" 9 "Rear corner left" 10 "Rear center" 11 "Rear corner right" 12 "Object center" 13 "Rear wheelcase center" 14 "Front wheelcase center" 15 "Invalid" ;
VAL_ 1298 RRR_Obj01A_Measured 0 "not measured" 1 "measured" ;
VAL_ 1298 RRR_Obj01A_Valid 0 "not valid" 1 "valid" ;
VAL_ 1300 RRR_Obj02A_RefPosIndex 0 "Front corner left" 1 "Front center" 2 "Front corner right" 3 "Front wheelcase left" 4 "Front wheelcase right" 5 "Side middle left" 6 "Side middle right" 7 "Rear wheelcase left" 8 "Rear wheelcase right" 9 "Rear corner left" 10 "Rear center" 11 "Rear corner right" 12 "Object center" 13 "Rear wheelcase center" 14 "Front wheelcase center" 15 "Invalid" ;
VAL_ 1300 RRR_Obj02A_Measured 0 "not measured" 1 "measured" ;
VAL_ 1300 RRR_Obj02A_Valid 0 "not valid" 1 "valid" ;
VAL_ 1302 RRR_Obj03A_RefPosIndex 0 "Front corner left" 1 "Front center" 2 "Front corner right" 3 "Front wheelcase left" 4 "Front wheelcase right" 5 "Side middle left" 6 "Side middle right" 7 "Rear wheelcase left" 8 "Rear wheelcase right" 9 "Rear corner left" 10 "Rear center" 11 "Rear corner right" 12 "Object center" 13 "Rear wheelcase center" 14 "Front wheelcase center" 15 "Invalid" ;
VAL_ 1302 RRR_Obj03A_Measured 0 "not measured" 1 "measured" ;
VAL_ 1302 RRR_Obj03A_Valid 0 "not valid" 1 "valid" ;
VAL_ 1304 RRR_Obj04A_RefPosIndex 0 "Front corner left" 1 "Front center" 2 "Front corner right" 3 "Front wheelcase left" 4 "Front wheelcase right" 5 "Side middle left" 6 "Side middle right" 7 "Rear wheelcase left" 8 "Rear wheelcase right" 9 "Rear corner left" 10 "Rear center" 11 "Rear corner right" 12 "Object center" 13 "Rear wheelcase center" 14 "Front wheelcase center" 15 "Invalid" ;
VAL_ 1304 RRR_Obj04A_Measured 0 "not measured" 1 "measured" ;
VAL_ 1304 RRR_Obj04A_Valid 0 "not valid" 1 "valid" ;
VAL_ 1306 RRR_Obj05A_RefPosIndex 0 "Front corner left" 1 "Front center" 2 "Front corner right" 3 "Front wheelcase left" 4 "Front wheelcase right" 5 "Side middle left" 6 "Side middle right" 7 "Rear wheelcase left" 8 "Rear wheelcase right" 9 "Rear corner left" 10 "Rear center" 11 "Rear corner right" 12 "Object center" 13 "Rear wheelcase center" 14 "Front wheelcase center" 15 "Invalid" ;
VAL_ 1306 RRR_Obj05A_Measured 0 "not measured" 1 "measured" ;
VAL_ 1306 RRR_Obj05A_Valid 0 "not valid" 1 "valid" ;
VAL_ 1308 RRR_Obj06A_RefPosIndex 0 "Front corner left" 1 "Front center" 2 "Front corner right" 3 "Front wheelcase left" 4 "Front wheelcase right" 5 "Side middle left" 6 "Side middle right" 7 "Rear wheelcase left" 8 "Rear wheelcase right" 9 "Rear corner left" 10 "Rear center" 11 "Rear corner right" 12 "Object center" 13 "Rear wheelcase center" 14 "Front wheelcase center" 15 "Invalid" ;
VAL_ 1308 RRR_Obj06A_Measured 0 "not measured" 1 "measured" ;
VAL_ 1308 RRR_Obj06A_Valid 0 "not valid" 1 "valid" ;
